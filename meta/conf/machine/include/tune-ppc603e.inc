## meta/conf/machine/include/tune-ppc603e.inc
```bitbake
DEFAULTTUNE ?= "ppc603e"

require conf/machine/include/powerpc/arch-powerpc.inc

TUNEVALID[ppc603e] = "Enable ppc603e specific processor optimizations"
TUNE_CCARGS += "${@bb.utils.contains("TUNE_FEATURES", "ppc603e", "-mcpu=603e", "", d)}"
TUNE_PKGARCH .= "${@bb.utils.contains("TUNE_FEATURES", "ppc603e", "ppc603e", "", d)}"

AVAILTUNES += "ppc603e"
TUNE_FEATURES_tune-ppc603e = "m32 fpu-hard ppc603e"
PACKAGE_EXTRA_ARCHS_tune-ppc603e = "powerpc ppc603e"
```

## meta/conf/machine/include/tune-ppce300c2.inc
```bitbake
require conf/machine/include/powerpc/arch-powerpc.inc

TUNE_CCARGS = "-mcpu=e300c2 -msoft-float"
TUNE_PKGARCH = "ppce300"
PACKAGE_EXTRA_ARCHS = "powerpc ppce300"
```

## meta/conf/machine/include/tune-ppce300c3.inc
```bitbake
DEFAULTTUNE ?= "ppce300c3"

require conf/machine/include/powerpc/arch-powerpc.inc

TUNEVALID[ppce300c3] = "Enable ppce300c3 specific processor optimizations"
TUNE_CCARGS .= "${@bb.utils.contains("TUNE_FEATURES", "ppce300c3", " -mcpu=e300c3", "", d)}"

AVAILTUNES += "ppce300c3"
TUNE_FEATURES_tune-ppce300c3 = "m32 fpu-soft ppce300c3"
TUNE_PKGARCH_tune-ppce300c3 = "ppce300c3"
PACKAGE_EXTRA_ARCHS_tune-ppce300c3 = "${PACKAGE_EXTRA_ARCHS_tune-powerpc-nf} ppce300c3"
```

## meta/conf/machine/include/tune-ppce500.inc
```bitbake
DEFAULTTUNE ?= "ppce500"

require conf/machine/include/powerpc/arch-powerpc.inc

TUNEVALID[ppce500] = "Enable ppce500 specific processor optimizations"
TUNE_CCARGS += "${@bb.utils.contains("TUNE_FEATURES", "ppce500", "-mcpu=8540", "", d)}"
TUNE_PKGARCH .= "${@bb.utils.contains("TUNE_FEATURES", "ppce500", "ppce500", "", d)}"

TUNEVALID[spe] = "Enable SPE ABI extensions"
TUNE_CCARGS += "${@bb.utils.contains("TUNE_FEATURES", "spe", "-mabi=spe -mspe", "", d)}"

TARGET_FPU = "ppc-efs"

AVAILTUNES += "ppce500"
TUNE_FEATURES_tune-ppce500 = "m32 spe ppce500"
PACKAGE_EXTRA_ARCHS_tune-ppce500 = "ppce500"
```

## meta/conf/machine/include/tune-ppce500mc.inc
```bitbake
DEFAULTTUNE ?= "ppce500mc"

require conf/machine/include/powerpc/arch-powerpc.inc

TUNEVALID[ppce500mc] = "Enable ppce500mc specific processor optimizations"
TUNE_CCARGS += "${@bb.utils.contains("TUNE_FEATURES", "ppce500mc", "-mcpu=e500mc", "", d)}"
TUNE_PKGARCH = "${@bb.utils.contains("TUNE_FEATURES", "ppce500mc", "ppce500mc", "${PPCPKGARCH}", d)}"

AVAILTUNES = "ppce500mc"
TUNE_FEATURES_tune-ppce500mc = "m32 fpu-hard ppce500mc"
PACKAGE_EXTRA_ARCHS_tune-ppce500mc = "powerpc ppce500mc"

# glibc configure options to get e500mc specific library (for sqrt)
GLIBC_EXTRA_OECONF += "${@bb.utils.contains("TUNE_FEATURES", "ppce500mc", "-with-cpu=e500mc", "", d)}"
```

## meta/conf/machine/include/tune-ppce500v2.inc
```bitbake
DEFAULTTUNE ?= "ppce500v2"

require conf/machine/include/powerpc/arch-powerpc.inc

TUNEVALID[ppce500v2] = "Enable ppce500v2 specific processor optimizations"
TUNE_CCARGS += "${@bb.utils.contains("TUNE_FEATURES", "ppce500v2", "-mcpu=8548", "", d)}"
TUNE_PKGARCH = "${@bb.utils.contains("TUNE_FEATURES", "ppce500v2", "ppce500v2", "${PPCPKGARCH}", d)}"

TUNEVALID[spe] = "Enable SPE ABI extensions"
TUNE_CCARGS += "${@bb.utils.contains("TUNE_FEATURES", "spe", "-mabi=spe -mspe", "", d)}"

TARGET_FPU = "ppc-efd"

AVAILTUNES += "ppce500v2"
TUNE_FEATURES_tune-ppce500v2 = "m32 spe ppce500v2"
PACKAGE_EXTRA_ARCHS_tune-ppce500v2 = "ppce500v2"
```

## meta/conf/machine/include/tune-ppce5500-32b.inc
```bitbake
DEFAULTTUNE ?= "ppce5500"

require conf/machine/include/powerpc/arch-powerpc64.inc

TUNEVALID[ppce5500] = "Enable ppce5500 specific processor optimizations"
TUNE_CCARGS += "${@bb.utils.contains("TUNE_FEATURES", "ppce5500", "-mcpu=e5500", "", d)}"
TUNE_PKGARCH = "${@bb.utils.contains("TUNE_FEATURES", "ppce5500", "ppce5500", "${PPCPKGARCH}", d)}"

AVAILTUNES = "ppce5500"
TUNE_FEATURES_tune-ppce5500 = "m32 ppce5500"
PACKAGE_EXTRA_ARCHS_tune-ppce5500 = "powerpc ppce5500"
BASE_LIB_tune-ppce5500 = "lib"

# glibc configure options to get e5500 specific library (for sqrt)
GLIBC_EXTRA_OECONF += "${@bb.utils.contains("TUNE_FEATURES", "ppce5500", "--with-cpu=e5500", "", d)}"
```

## meta/conf/machine/include/tune-ppce5500-64b.inc
```bitbake
DEFAULTTUNE ?= "ppc64e5500"

require conf/machine/include/powerpc/arch-powerpc64.inc

TUNEVALID[ppc64e5500] = "Enable ppc64e5500 specific processor optimizations"
TUNE_CCARGS += "${@bb.utils.contains("TUNE_FEATURES", "ppc64e5500", "-mcpu=e5500", "", d)}"
TUNE_PKGARCH = "${@bb.utils.contains("TUNE_FEATURES", "ppc64e5500", "ppc64e5500", "${PPCPKGARCH}", d)}"

AVAILTUNES = "ppc64e5500"
TUNE_FEATURES_tune-ppc64e5500 = "m64 ppc64e5500"
PACKAGE_EXTRA_ARCHS_tune-ppc64e5500 = "powerpc64 ppc64e5500"
BASE_LIB_tune-ppc64e5500 = "lib64"

# glibc configure options to get e5500 specific library (for sqrt)
GLIBC_EXTRA_OECONF += "${@bb.utils.contains("TUNE_FEATURES", "ppc64e5500", "--with-cpu=e5500", "", d)}"
```

## meta/conf/machine/include/tune-sh4.inc
```bitbake
TUNE_ARCH = "sh4"

# NOTE: If you want to optimize to sh4a, conf/machine/include/tune-sh4a.inc.
# But it is not compatible for sh4.
# The binary optimized by m4a doesn't operate on sh4. It works on sh4a only.

TUNE_CCARGS = "-ml -m4"
TUNE_PKGARCH = "sh4"
```

## meta/conf/machine/include/tune-strongarm1100.inc
```bitbake
DEFAULTTUNE ?= "strongarm"

require conf/machine/include/arm/arch-armv4.inc

TUNEVALID[strongarm] = "Enable Strongarm 1100 series processor optimizations"
TUNE_CCARGS += "${@bb.utils.contains("TUNE_FEATURES", "strongarm", "-mtune=strongarm1100", "", d)}"

AVAILTUNES += "strongarm"
TUNE_FEATURES_tune-strongarm = "${TUNE_FEATURES_tune-armv4} strongarm"
PACKAGE_EXTRA_ARCHS_tune-strongarm = "${PACKAGE_EXTRA_ARCHS_tune-armv4}"
```

## meta/conf/machine/include/tune-supersparc.inc
```bitbake
TUNE_ARCH = "sparc"

TARGET_CC_ARCH = "-mcpu=supersparc"
TUNE_PKGARCH = "supersparc"
```

## meta/conf/machine/include/tune-thumb.inc
```bitbake
#tune file for thumb instructions

ARM_INSTRUCTION_SET ?= "arm"
# "arm" "thumb"
#    The instruction set the compiler should use when generating application
#    code.  The kernel is always compiled with arm code at present.  arm code
#    is the original 32 bit ARM instruction set, thumb code is the 16 bit
#    encoded RISC sub-set.  Thumb code is smaller (maybe 70% of the ARM size)
#    but requires more instructions (140% for 70% smaller code) so may be
#    slower.

THUMB_INTERWORK ?= "yes"
# "yes" "no"
#    Whether to compile with code to allow interworking between the two
#    instruction sets.  This allows thumb code to be executed on a primarily
#    arm system and vice versa.  It is strongly recommended that DISTROs not
#    turn this off - the actual cost is very small.

OVERRIDE_THUMB = "${@['', ':thumb'][d.getVar('ARM_INSTRUCTION_SET', True) == 'thumb']}"
OVERRIDE_INTERWORK = "${@['', ':thumb-interwork'][d.getVar('THUMB_INTERWORK', True) == 'yes']}"
OVERRIDES .= "${OVERRIDE_THUMB}${OVERRIDE_INTERWORK}"

#    Compiler and linker options for application code and kernel code.  These
#    options ensure that the compiler has the correct settings for the selected
#    instruction set and interworking.
ARM_INTERWORK_M_OPT = "${@['-mno-thumb-interwork', '-mthumb-interwork'][d.getVar('THUMB_INTERWORK', True) == 'yes']}"
ARM_THUMB_M_OPT = "${@['-marm', '-mthumb'][d.getVar('ARM_INSTRUCTION_SET', True) == 'thumb']}"

#
TUNE_CCARGS +=  "${ARM_INTERWORK_M_OPT} ${ARM_THUMB_M_OPT}"
TARGET_CC_KERNEL_ARCH  += "-mno-thumb-interwork -marm"
```

## meta/conf/machine/include/tune-xscale.inc
```bitbake
DEFAULTTUNE ?= "xscale"

require conf/machine/include/arm/arch-armv5-dsp.inc

TUNEVALID[xscale] = "Enable PXA255/PXA26x Xscale specific processor optimizations"
TUNE_CCARGS += "${@bb.utils.contains("TUNE_FEATURES", "xscale", "-mtune=xscale", "", d)}"

AVAILTUNES += "xscale"
ARMPKGARCH_tune-xscale = "xscale"
TUNE_FEATURES_tune-xscale = "${TUNE_FEATURES_tune-armv5te} xscale"
PACKAGE_EXTRA_ARCHS_tune-xscale = "${PACKAGE_EXTRA_ARCHS_tune-armv5te}"

AVAILTUNES += "xscale-be"
ARMPKGARCH_tune-xscale-be = "xscale-be"
TUNE_FEATURES_tune-xscale-be = "${TUNE_FEATURES_tune-armv5teb} xscale bigendian"
PACKAGE_EXTRA_ARCHS_tune-xscale-be = "${PACKAGE_EXTRA_ARCHS_tune-armv5teb}"

# webkit-gtk has alignment issues with double instructions on armv5 so
# disable them here
TUNE_CCARGS_pn-webkit-gtk = "${@bb.utils.contains("TUNE_FEATURES", "xscale", "-march=armv4t", "", d)}"
TUNE_CCARGS_pn-cairo = "${@bb.utils.contains("TUNE_FEATURES", "xscale", "-march=armv4t", "", d)}"
```

## meta/conf/machine/include/zaurus-2.6.inc
```bitbake
# Zaurus specific configuration for kernel 2.6
# Additionally, clamshell specific stuff in zaurus-clamshell.inc

TARGET_ARCH = "arm"
PACKAGE_EXTRA_ARCHS = "armv4 armv4t armv5e armv5te"
PACKAGE_EXTRA_ARCHS_collie = ""

MACHINE_KERNEL_VERSION = "2.6"

ERASEBLOCKSIZE = "0x4000"
ERASEBLOCKSIZE_akita = "0x20000"

EXTRA_IMAGECMD_jffs2 = "--little-endian --eraseblock=${ERASEBLOCKSIZE} --pad --faketime -n" 
IMAGE_CMD_jffs2 = "mkfs.jffs2 -x lzo --root=${IMAGE_ROOTFS} --output=${DEPLOY_DIR_IMAGE}/${IMAGE_NAME}.rootfs.jffs2 ${EXTRA_IMAGECMD}"
EXTRA_IMAGEDEPENDS += "zaurus-updater"

SERIAL_CONSOLE = "115200 ttyS0"
SERIAL_CONSOLE_collie = "115200 ttySA0"

PREFERRED_PROVIDER_virtual/kernel = "linux-rp"
PREFERRED_PROVIDER_xserver = "xserver-kdrive"

PCMCIA_MANAGER ?= "pcmciautils"

MACHINE_FEATURES = "kernel26 apm alsa pcmcia irda usbgadget keyboard touchscreen screen vfat"
MACHINE_FEATURES_append_tosa  = " usbhost wifi "
MACHINE_FEATURES_append_akita = " usbhost "
MACHINE_FEATURES_append_spitz = " usbhost ext2 "

MACHINE_EXTRA_RDEPENDS = "zaurusd"
MACHINE_EXTRA_RRECOMMENDS_c7x0   = "kernel-module-snd-soc-corgi kernel-module-pxa2xx-cs kernel-module-pcmcia"
MACHINE_EXTRA_RRECOMMENDS_akita  = "kernel-module-snd-soc-spitz kernel-module-pxa2xx-cs kernel-module-pcmcia"
MACHINE_EXTRA_RRECOMMENDS_spitz  = "kernel-module-snd-soc-spitz"
MACHINE_EXTRA_RRECOMMENDS_poodle = "kernel-module-snd-soc-poodle"

GUI_MACHINE_CLASS = "bigscreen"
GUI_MACHINE_CLASS_collie = "smallscreen"
GUI_MACHINE_CLASS_poodle = "smallscreen"

KERNEL_IMAGE_MAXSIZE = "1294336"
KERNEL_IMAGE_MAXSIZE_collie = "1048576"

MACHINE_POSTPROCESS_COMMAND = "zaurus_make_installkit"

zaurus_make_installkit () {
    cd ${DEPLOY_DIR_IMAGE}
    rm -rf ${DEPLOY_DIR_IMAGE}/${IMAGE_NAME}-installkit/         
    mkdir ${IMAGE_NAME}-installkit/

    # Get the latest kernel using the zImage-<machine>.bin symlink
    cp zImage-${MACHINE}.bin ${IMAGE_NAME}-installkit/zImage

    if [ "${MACHINE}" = "spitz" ]; then
        cp gnu-tar ${IMAGE_NAME}-installkit/
        cp ${IMAGE_NAME}.rootfs.tar.gz ${IMAGE_NAME}-installkit/hdimage1.tgz
    else
        [ -f ${IMAGE_NAME}.rootfs.jffs2 ] && cp ${IMAGE_NAME}.rootfs.jffs2 ${IMAGE_NAME}-installkit/initrd.bin
    fi

    # All zaurus machines except collie need updater.sh
    if [ "${MACHINE}" != "collie" ]; then
        cp updater.sh.${MACHINE} ${IMAGE_NAME}-installkit/updater.sh
    fi
 
    tar czf ${DEPLOY_DIR_IMAGE}/${IMAGE_NAME}-installkit.tgz ${IMAGE_NAME}-installkit/
    md5sum ${DEPLOY_DIR_IMAGE}/${IMAGE_NAME}-installkit.tgz > ${DEPLOY_DIR_IMAGE}/${IMAGE_NAME}-installkit.tgz.md5
    rm -rf ${DEPLOY_DIR_IMAGE}/${IMAGE_NAME}-installkit/     
}

# Don't include kernels in standard images for Zaurus machines
RDEPENDS_kernel-base = ""
KERNEL_IMAGETYPE = "zImage"
```

## meta/conf/machine/include/zaurus-clamshell-2.6.conf
```bitbake
# Zaurus Clamshell specific configuration for kernel 2.6
# Don't forget to include zaurus-clamshell.conf as well

PREFERRED_PROVIDER_virtual/kernel = "linux-openzaurus"
PREFERRED_VERSION_wpa_supplicant = "0.4.7"

PCMCIA_MANAGER ?= "pcmciautils"

MACHINE_FEATURES = "kernel26 apm alsa pcmcia bluetooth irda usbgadget"
MACHINE_FEATURES_akita = "kernel26 apm alsa pcmcia bluetooth irda usbgadget usbhost"
MACHINE_FEATURES_spitz = "kernel26 apm alsa pcmcia bluetooth irda usbgadget usbhost ext2"


MACHINE_EXTRA_RDEPENDS = "zaurusd"
MACHINE_EXTRA_RRECOMMENDS_c7x0 = "kernel-module-snd-soc-corgi"
MACHINE_EXTRA_RRECOMMENDS_akita = "kernel-module-snd-soc-spitz"
MACHINE_EXTRA_RRECOMMENDS_spitz = "kernel-module-snd-soc-spitz"
MACHINE_EXTRA_RRECOMMENDS_poodle = "kernel-module-snd-soc-poodle"

MACHINE_TASK_PROVIDER = "task-base"
```

## meta/conf/machine/include/zaurus-clamshell.conf
```bitbake
TARGET_ARCH = "arm"
PACKAGE_EXTRA_ARCHS = "armv4 armv4t armv5e armv5te"

PREFERRED_PROVIDER_xserver = "xserver-kdrive"

EXTRA_IMAGEDEPENDS += "sharp-flash-header-c700 zaurus-updater"

ERASEBLOCKSIZE = "0x4000"
ERASEBLOCKSIZE_akita = "0x20000"

IMAGE_CMD_jffs2 = "mkfs.jffs2 --root=${IMAGE_ROOTFS} --faketime \
		   --output=${T}/${IMAGE_NAME}.rootfs.jffs2 --pad --little-endian --eraseblock=${ERASEBLOCKSIZE} -n \
		   && sumtool -i ${T}/${IMAGE_NAME}.rootfs.jffs2 \
                   -o ${T}/${IMAGE_NAME}.rootfs.jffs2.summary \
                   --eraseblock=${ERASEBLOCKSIZE} -l -p; \
		   cat ${STAGING_LIBDIR}/sharp-flash-header/header-c700.bin \
		   ${T}/${IMAGE_NAME}.rootfs.jffs2 > ${DEPLOY_DIR_IMAGE}/${IMAGE_NAME}.rootfs.jffs2; \
		   rm ${T}/${IMAGE_NAME}.rootfs.jffs2; \
		   cat ${STAGING_LIBDIR}/sharp-flash-header/header-c700.bin \
                   ${T}/${IMAGE_NAME}.rootfs.jffs2.summary > ${DEPLOY_DIR_IMAGE}/${IMAGE_NAME}.rootfs.summary.jffs2; \
                   rm ${T}/${IMAGE_NAME}.rootfs.jffs2.summary"

GUI_MACHINE_CLASS = "bigscreen"
GPE_EXTRA_INSTALL += "gaim sylpheed"

# Use tune-xscale per default. Machine independent feeds should be built with tune-strongarm.
include conf/machine/include/tune-xscale.conf

SERIAL_CONSOLE = "115200 ttyS0"
```

## meta/conf/machine/include/zaurus-clamshell.inc
```bitbake
EXTRA_IMAGEDEPENDS += "sharp-flash-header-c700"

IMAGE_CMD_jffs2 = "mkfs.jffs2 --root=${IMAGE_ROOTFS} --faketime -m favourlzo \
                   --output=${T}/${IMAGE_NAME}.rootfs.jffs2 --pad --little-endian --eraseblock=${ERASEBLOCKSIZE} -n \
                   && sumtool -i ${T}/${IMAGE_NAME}.rootfs.jffs2 \
                   -o ${T}/${IMAGE_NAME}.rootfs.jffs2.summary \
                   --eraseblock=${ERASEBLOCKSIZE} -l -p; \
                   cat ${STAGING_LIBDIR}/sharp-flash-header/header-c700.bin \
                   ${T}/${IMAGE_NAME}.rootfs.jffs2 > ${DEPLOY_DIR_IMAGE}/${IMAGE_NAME}.rootfs.jffs2; \
                   rm ${T}/${IMAGE_NAME}.rootfs.jffs2; \
                   cat ${STAGING_LIBDIR}/sharp-flash-header/header-c700.bin \
                   ${T}/${IMAGE_NAME}.rootfs.jffs2.summary > ${DEPLOY_DIR_IMAGE}/${IMAGE_NAME}.rootfs.summary.jffs2; \
                   rm ${T}/${IMAGE_NAME}.rootfs.jffs2.summary;"
```

## meta/conf/machine/mpc8315e-rdb.conf
```bitbake
#@TYPE: Machine
#@DESCRIPTION: Machine configuration for running 

TARGET_ARCH = "powerpc"
TARGET_FPU = "spe"

require conf/machine/include/tune-ppc603e.inc

KERNEL_IMAGETYPE = "uImage"

SERIAL_CONSOLE = "115200 ttyS0"

MACHINE_FEATURES = "kernel26 keyboard pci ext2 ext3 serial"

PREFERRED_PROVIDER_virtual/kernel = "linux-yocto"
PREFERRED_PROVIDER_linux-libc-headers ?= "linux-libc-headers-yocto"

UBOOT_ENTRYPOINT = "0x00000000"

KERNEL_DEVICETREE = "${S}/arch/powerpc/boot/dts/mpc8315erdb.dts"
```

## meta/conf/machine/mx31ads.conf
```bitbake
#@TYPE: Machine
#@NAME: Freescale imx31 ADS Board
#@DESCRIPTION: Machine configuration for the imx31 based Freescale ADS Board
TARGET_ARCH = "arm"

PREFERRED_PROVIDER_virtual/kernel = "linux-mx31"

MACHINE_FEATURES = "kernel26 apm alsa bluetooth irda screen touchscreen"

IMAGE_FSTYPES ?= "tar.gz jffs2"
SERIAL_CONSOLE = "-L 115200 ttymxc0"

EXTRA_IMAGECMD_jffs2_mx31ads = "--pad --little-endian --eraseblock=0x20000 -n"

require conf/machine/include/tune-arm1136jf-s.inc
```

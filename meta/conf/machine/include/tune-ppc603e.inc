## meta/conf/machine/mx31litekit.conf
```bitbake
#@TYPE: Machine
#@NAME: imx31 Lite Kit
#@DESCRIPTION: Machine configuration for the imx31 based Lite Kit
TARGET_ARCH = "arm"
PACKAGE_EXTRA_ARCHS = "armv4 armv4t armv5te"

PREFERRED_PROVIDER_virtual/kernel = "linux-mx31"

MACHINE_FEATURES = "kernel26 apm alsa bluetooth irda screen touchscreen"

IMAGE_FSTYPES ?= "tar.gz"
SERIAL_CONSOLE = "-L 115200 ttymxc0"

require conf/machine/include/armv5te.inc
```

## meta/conf/machine/mx31phy.conf
```bitbake
#@TYPE: Machine
#@NAME: Phytec phyCORE-iMX31 Board
#@DESCRIPTION: Machine configuration for the imx31 based Phytec phyCORE-iMX31
TARGET_ARCH = "arm"

PREFERRED_PROVIDER_virtual/kernel = "linux-mx31"

MACHINE_FEATURES = "kernel26 apm alsa bluetooth irda screen touchscreen"

IMAGE_FSTYPES ?= "tar.gz jffs2"
KERNEL_IMAGETYPE = "uImage"
UBOOT_ENTRYPOINT = "80008000"
SERIAL_CONSOLE = "-L 115200 ttymxc0"
EXTRA_IMAGECMD_jffs2_mx31phy = "--pad --little-endian --eraseblock=0x20000 -n"

require conf/machine/include/tune-arm1136jf-s.inc
```

## meta/conf/machine/nokia770.conf
```bitbake
#@TYPE: Machine
#@NAME: Nokia 770 internet tablet
#@DESCRIPTION: Machine configuration for the Nokia 770, an omap 1710 based tablet
TARGET_ARCH = "arm"
PACKAGE_EXTRA_ARCHS = "armv4 armv4t armv5te"

PREFERRED_PROVIDER_virtual/xserver = "xserver-kdrive-xomap"
PREFERRED_PROVIDER_virtual/bootloader = ""

XSERVER = "xserver-kdrive-xomap"

# 800x480 is big enough for me
GUI_MACHINE_CLASS = "bigscreen"

# Use tune-arm926 per default. Machine independent feeds should be built with tune-strongarm.
include conf/machine/include/tune-arm926ejs.inc

#size of the root partition (yes, it is 123 MB)
ROOT_FLASH_SIZE = "123"
EXTRA_IMAGECMD_jffs2_nokia770 = "--pad --little-endian --eraseblock=0x20000"

IMAGE_FSTYPES ?= "jffs2"

# serial console port on devboard rev. B3
SERIAL_CONSOLE = "115200 ttyS0"

PREFERRED_PROVIDER_virtual/kernel = "linux-nokia770"

#use this if you are using the nokia initfs
ROOTFS_POSTPROCESS_COMMAND += " remove_init_link; "

MACHINE_FEATURES = "kernel26 apm alsa bluetooth usbgadget usbhost"
MACHINE_EXTRA_RDEPENDS = "usbinit"
MACHINE_ESSENTIAL_EXTRA_RDEPENDS = "nokia770-init"
```

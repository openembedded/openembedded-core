## meta/conf/machine/nokia800.conf
```bitbake
#@TYPE: Machine
#@NAME: Nokia 800/810 internet tablet
#@DESCRIPTION: Machine configuration for the Nokia 800/810
TARGET_ARCH = "arm"
PACKAGE_EXTRA_ARCHS = "armv4 armv4t armv5te armv6"

PREFERRED_PROVIDER_virtual/xserver = "xserver-kdrive-xomap"
XSERVER = "xserver-kdrive-xomap"

GUI_MACHINE_CLASS = "bigscreen"

require conf/machine/include/tune-arm1136jf-s.inc

ROOT_FLASH_SIZE = "174"
EXTRA_IMAGECMD_jffs2_nokia800 = "--pad --little-endian --eraseblock=0x20000 -n"

IMAGE_FSTYPES ?= "jffs2"

SERIAL_CONSOLE = "-L 115200 ttyS1"

PREFERRED_PROVIDER_virtual/kernel = "linux-nokia800"

#use this if you are using the nokia initfs
ROOTFS_POSTPROCESS_COMMAND += " remove_init_link; "

MACHINE_FEATURES = "kernel26 apm alsa bluetooth usbgadget usbhost vfat"
MACHINE_EXTRA_RDEPENDS = "cx3110x usbinit"
MACHINE_ESSENTIAL_EXTRA_RDEPENDS = "nokia770-init"

KERNEL_IMAGE_MAXSIZE = "2097152"
```

## meta/conf/machine/omap-3430ldp.conf
```bitbake
#@TYPE: Machine
#@NAME: TI OMAP 3430 LDP
#@DESCRIPTION: Machine configuration for the TI OMAP 3430 LDP (aka OMAP Zoom)
TARGET_ARCH = "arm"

PREFERRED_PROVIDER_virtual/kernel = "linux-omap"

MACHINE_FEATURES = "kernel26 apm alsa bluetooth screen touchscreen phone"
KERNEL_IMAGETYPE = "uImage"
IMAGE_FSTYPES ?= "tar.gz jffs2"
EXTRA_IMAGECMD_jffs2 = "--pad --little-endian --eraseblock=0x20000 -n"
SERIAL_CONSOLE = "-L 115200 ttyS2"

require conf/machine/include/tune-cortexa8.inc
#require conf/machine/include/tune-arm1136jf-s.inc

MACHINE_EXTRA_RRECOMMENDS = "\
    kernel-module-ads7846 \
    kernel-module-atkbd \
    kernel-module-g-ether \
    kernel-module-musb-hdrc \
    kernel-module-omap24xxlib \
    kernel-module-omap24xxvout \
    kernel-module-omap-hsmmc \
    kernel-module-snd-omap2-audio \
    "
```

## meta/conf/machine/omap-3430sdp.conf
```bitbake
#@TYPE: Machine
#@NAME: TI OMAP 3430 SDP
#@DESCRIPTION: Machine configuration for the TI OMAP 3430 SDP
TARGET_ARCH = "arm"

PREFERRED_PROVIDER_virtual/kernel = "linux-omap"

MACHINE_FEATURES = "kernel26 apm alsa bluetooth irda screen touchscreen"
KERNEL_IMAGETYPE = "uImage"
IMAGE_FSTYPES ?= "tar.gz jffs2"
EXTRA_IMAGECMD_jffs2 = "--pad --little-endian --eraseblock=0x20000 -n"
SERIAL_CONSOLE = "-L 115200 ttyS0"

require conf/machine/include/tune-cortexa8.inc
#require conf/machine/include/tune-arm1136jf-s.inc
```

## meta/conf/machine/omap-zoom.conf
```bitbake
#@TYPE: Machine
#@NAME: LogicPD OMAP 3430 Zoom Kit
#@DESCRIPTION: Machine configuration for the OMAP 3430 Zoom kit
TARGET_ARCH = "arm"
PACKAGE_EXTRA_ARCHS = "armv4 armv4t armv5te armv6"

PREFERRED_PROVIDER_virtual/kernel = "linux-omap-zoom"

MACHINE_FEATURES = "kernel26 apm alsa bluetooth irda screen touchscreen"
KERNEL_IMAGETYPE = "uImage"
IMAGE_FSTYPES ?= "tar.gz"
SERIAL_CONSOLE = "-L 115200 ttyS0"

require conf/machine/include/tune-arm1136jf-s.inc
```

## meta/conf/machine/overo.conf
```bitbake
#@TYPE: Machine
#@NAME: overo machine
#@DESCRIPTION: Machine configuration for the overo

include conf/machine/include/tune-cortexa8.inc

TARGET_ARCH = "arm"
MACHINE_FEATURES = "kernel26 apm usbgadget usbhost vfat alsa"

PREFERRED_VERSION_u-boot = "git"
UBOOT_ENTRYPOINT = "0x80008000"
UBOOT_LOADADDRESS = "0x80008000"

PREFERRED_PROVIDER_virtual/kernel = "linux-omap3"
KERNEL_IMAGETYPE = "uImage"
MACHINE_EXTRA_RRECOMMENDS = " kernel-modules"
SERIAL_CONSOLE = "115200 ttyS2"

IMAGE_FSTYPES += "tar.bz2 jffs2"
EXTRA_IMAGECMD_jffs2 = "-lnp "
EXTRA_IMAGEDEPENDS += "u-boot x-load"

PREFERRED_PROVIDER_virtual/xserver = "xserver-kdrive"
#XSERVER = "xserver-xorg \
#           xf86-input-evdev \
#           xf86-input-mouse \
#           xf86-video-fbdev \
#           xf86-input-keyboard"

XSERVER = "xserver-kdrive-fbdev"

GUI_MACHINE_CLASS = "bigscreen"

ANGSTROM_URI = "http://www.gumstix.net"
```

## meta/conf/machine/qemuarm.conf
```bitbake
#@TYPE: Machine
#@NAME: arm_versaile_926ejs
#@DESCRIPTION: arm_versaile_926ejs

require conf/machine/include/qemu.inc
require conf/machine/include/tune-arm926ejs.inc
#require conf/machine/include/tune-arm1136jf-s.inc

KERNEL_IMAGETYPE = "zImage"

SERIAL_CONSOLE = "115200 ttyAMA0"
```

## meta/conf/machine/qemumips.conf
```bitbake
#@TYPE: Machine
#@NAME: qemu MIPS (big-endian) Emulator setup
#@DESCRIPTION: Machine configuration for running an MIPS r4k platform system under qemu emulation 

TARGET_ARCH = "mips"

require conf/machine/include/qemu.inc
require conf/machine/include/tune-mips32.inc

KERNEL_IMAGETYPE = "vmlinux.bin"

SERIAL_CONSOLE = "115200 ttyS0"

MACHINE_EXTRA_RRECOMMENDS = " kernel-modules"
```

## meta/conf/machine/qemumips64.conf
```bitbake
#@TYPE: Machine
#@NAME: mti-malta64-be MIPS64
#@DESCRIPTION: mti-malta64-be

require conf/machine/include/qemu.inc
require conf/machine/include/tune-mips64r2.inc
require conf/machine/include/qemuboot-mips.inc

QB_CPU = "-cpu MIPS64R2-generic"

KERNEL_IMAGETYPE = "vmlinux"
KERNEL_ALT_IMAGETYPE = "vmlinux.bin"

SERIAL_CONSOLES ?= "115200;ttyS0 115200;ttyS1"
```

## meta/conf/machine/qemuppc.conf
```bitbake
#@TYPE: Machine
#@NAME: qemu PPC Emulator setup
#@DESCRIPTION: Machine configuration for running an PPC system under qemu emulation

PREFERRED_PROVIDER_virtual/libgl  = "mesa-xlib"

require conf/machine/include/qemu.inc
require conf/machine/include/tune-ppc603e.inc

KERNEL_IMAGETYPE = "zImage"

SERIAL_CONSOLE = "115200 ttyS0"
```

## meta/conf/machine/qemuriscv32.conf
```bitbake
#@TYPE: Machine
#@NAME: generic riscv32 machine
#@DESCRIPTION: Machine configuration for running a generic riscv32

require conf/machine/include/riscv/qemuriscv.inc

DEFAULTTUNE = "riscv32"

PREFERRED_VERSION_openocd-native = "riscv"
PREFERRED_VERSION_openocd = "riscv"

XVISOR_PLAT = "riscv/virt32"

# u-boot doesn't compile, error: "can't link hard-float modules with soft-float modules"
# EXTRA_IMAGEDEPENDS += "u-boot"
# UBOOT_MACHINE = "qemu-riscv32_smode_defconfig"
# UBOOT_ELF = "u-boot"
```

## meta/conf/machine/qemux86-64.conf
```bitbake
#@TYPE: Machine
#@NAME: common_pc
#@DESCRIPTION: Machine configuration for running a common x86

PREFERRED_PROVIDER_virtual/xserver ?= "xserver-xorg"
PREFERRED_PROVIDER_virtual/libgl ?= "mesa-dri"

require conf/machine/include/tune-x86_64.inc
require conf/machine/include/qemu.inc

MACHINE_FEATURES += "x86"

KERNEL_IMAGETYPE = "bzImage"

SERIAL_CONSOLE = "115200 ttyS0"

# We bypass swrast but we need it to be present for X to load correctly
XSERVER ?= "xserver-xorg \
           mesa-dri-driver-swrast \
           xf86-input-vmmouse \
           xf86-input-keyboard \
           xf86-input-evdev \
           xf86-video-vmware \
           qemugl"

GLIBC_ADDONS = "nptl"
GLIBC_EXTRA_OECONF = "--with-tls"

MACHINE_ESSENTIAL_EXTRA_RDEPENDS += "v86d"
```

## meta/conf/machine/qemux86.conf
```bitbake
#@TYPE: Machine
#@NAME: common_pc
#@DESCRIPTION: Machine configuration for running a common x86

PREFERRED_PROVIDER_virtual/xserver ?= "xserver-xorg"
PREFERRED_PROVIDER_virtual/libgl ?= "mesa-dri"
PREFERRED_PROVIDER_virtual/libgles1 ?= "mesa-dri"
PREFERRED_PROVIDER_virtual/libgles2 ?= "mesa-dri"

require conf/machine/include/tune-i586.inc

KERNEL_IMAGETYPE = "bzImage"

SERIAL_CONSOLE = "115200 ttyS0"

XSERVER ?= "xserver-xorg \
           mesa-dri-driver-swrast \
           xf86-input-vmmouse \
           xf86-input-keyboard \
           xf86-input-evdev \
           xf86-video-vmware"

require conf/machine/include/qemu.inc

MACHINE_FEATURES += "x86"

MACHINE_ESSENTIAL_EXTRA_RDEPENDS += "v86d"
```

## meta/conf/machine/routerstationpro.conf
```bitbake
#@TYPE: Machine
#@NAME: mti_malta32_be MIPS
#@DESCRIPTION: mti_malta32_be

TARGET_ARCH = "mips"

require conf/machine/include/tune-mips32.inc

MACHINE_FEATURES = "kernel26 screen keyboard pci usbhost ext2 ext3 \
                    serial usbgadget"

KERNEL_IMAGETYPE = "vmlinux"
KERNEL_ALT_IMAGETYPE = "vmlinux.bin"

PREFERRED_PROVIDER_virtual/kernel = "linux-yocto-stable"
#PREFERRED_PROVIDER_linux-libc-headers ?= "linux-libc-headers-yocto"

SERIAL_CONSOLE = "115200 ttyS0"

MACHINE_EXTRA_RRECOMMENDS = " kernel-modules"

IMAGE_ROOTFS_SIZE_ext3 = "2000000"
IMAGE_FSTYPES ?= "jffs2 tar.bz2"
```

## meta/conf/machine/spitz.conf
```bitbake
#@TYPE: Machine
#@NAME: Sharp Zaurus SL-C3000
#@DESCRIPTION: Machine configuration for the Sharp Zaurus SL-C3000 device

require conf/machine/include/zaurus-2.6.inc
require conf/machine/include/zaurus-clamshell.inc

MACHINE_FEATURES += "iwmmxt"

PIVOTBOOT_EXTRA_RDEPENDS += "pivotinit ${PCMCIA_MANAGER}"

IMAGE_FSTYPES ?= "tar.gz ext3"
IMAGE_ROOTFS_SIZE_ext3 = "250000"

ROOT_FLASH_SIZE = "100"
```

## meta/conf/machine/zoom2.conf
```bitbake
#@TYPE: Machine
#@NAME: Logic PD Zoom2
#@DESCRIPTION: Machine configuration for the OMAP3-powered Logic PD Zoom2
TARGET_ARCH = "arm"

PREFERRED_PROVIDER_virtual/kernel = "linux-omap-zoomsync"

MACHINE_FEATURES = "kernel26 apm alsa usbgadget usbhost screen touchscreen"

KERNEL_IMAGETYPE = "uImage"
IMAGE_FSTYPES ?= "tar.gz jffs2 ext2"
UBOOT_ENTRYPOINT ="0x80008000"
UBOOT_LOADADDRESS ="0x80008000"

EXTRA_IMAGECMD_jffs2 = "--pad --little-endian --eraseblock=0x20000 -n"
SERIAL_CONSOLE = "-L 115200 ttyS3"
#MACHINE_ESSENTIAL_EXTRA_RRECOMMENDS = "u-boot x-load"

require conf/machine/include/tune-cortexa8.inc
```

## meta/conf/machine/zylonite.conf
```bitbake
#@TYPE: Machine
#@NAME: Marvel PXA3xx Monahans Zylonite
#@DESCRIPTION: Machine configuration for the Zylonite Development board

require conf/machine/include/tune-xscale.inc

PACKAGE_EXTRA_ARCHS += "iwmmxt"

TARGET_ARCH = "arm"

EXTRA_IMAGECMD_jffs2 = "--little-endian --eraseblock=0x20000 -n -x lzo -p"

IMAGE_CMD_jffs2 = "mkdir -p ${DEPLOY_DIR_IMAGE}; \
                  mkfs.jffs2 --root=${IMAGE_ROOTFS} --faketime \
                   --output=${DEPLOY_DIR_IMAGE}/${IMAGE_NAME}.rootfs.jffs2 ${EXTRA_IMAGECMD}; "

IMAGE_FSTYPES ?= "tar.bz2 jffs2"

SERIAL_CONSOLE = "38400 ttyS0"

PREFERRED_PROVIDER_virtual/kernel = "linux-rp"
PREFERRED_PROVIDER_virtual/xserver = "xserver-kdrive"
XSERVER = "xserver-kdrive-fbdev"

MACHINE_FEATURES = "kernel26 apm usbgadget"
```

## openembedded/conf/distro/angstrom-2006.9.conf
```bitbake
#@--------------------------------------------------------------------
#@TYPE: Distribution
#@NAME: Angstrom <http://www.angstrom-distribution.org>
#@DESCRIPTION: The Linux Distribution for Kernel 2.6 based devices
#@MAINTAINER: Koen Kooi <koen@dominion.kabel.utwente.nl>
#@MAINTAINER: Michael 'Mickey' Lauer <mickey@Vanille.de>
#@--------------------------------------------------------------------

#DISTRO_VERSION = "2006.9"
DISTRO_VERSION = "test-${DATE}"

include conf/distro/angstrom.conf

DISTRO_TYPE = "debug"
#DISTRO_TYPE = "release"
#!!!!! DON'T FORGET TO ENABLE ZAPROOTPASSWD !!!!!


FEED_URIS += " \
		 base##${ANGSTROM_URI}/unstable/feed/base/"
#        base##${ANGSTROM_URI}/releases/${DISTRO_VERSION}/feed/base \
#        ${MACHINE}##${ANGSTROM_URI}/releases/${DISTRO_VERSION}/feed/${MACHINE} \
#        updates##${ANGSTROM_URI}/releases/${DISTRO_VERSION}/feed/updates"

SRCDATE = "20060518"
#SRCDATE_handhelds-pxa-2.6 = "20060516"

CVS_TARBALL_STASH = "\
http://ewi546.ewi.utwente.nl/mirror/www.openzaurus.org/official/unstable/3.5.4/sources/ \
http://www.oesources.org/source/current/"

# Opie
#use 1337 mt version of opie to have a webbrowser
PALMTOP_USE_MULTITHREADED_QT = "yes"
QTE_VERSION = "2.3.10"
OPIE_VERSION = "1.2.2"
include conf/distro/preferred-opie-versions.inc

# GPE
include conf/distro/preferred-gpe-versions-2.8.inc

#zap extra stuff taking place in $MACHINE.conf 
GPE_EXTRA_INSTALL = ""

# E
include conf/distro/preferred-e-versions.inc

PREFERRED_PROVIDERS += "virtual/xserver:xserver-kdrive"
PREFERRED_PROVIDERS += "virtual/gconf:gconf-dbus"
PREFERRED_PROVIDER_libx11 = "diet-x11"


#Make sure we use 2.6 on machines with a 2.4/2.6 selector
KERNEL = "kernel26"
ZKERNEL_VERSION = "2.6"

PREFERRED_PROVIDERS += "virtual/${TARGET_PREFIX}gcc-initial:gcc-cross-initial"
PREFERRED_PROVIDERS += "virtual/${TARGET_PREFIX}gcc:gcc-cross"
PREFERRED_PROVIDERS += "virtual/${TARGET_PREFIX}g++:gcc-cross"

PREFERRED_PROVIDER_virtual/libiconv = "glibc"
PREFERRED_PROVIDER_virtual/libintl = "glibc"

#EABI stuff
PREFERRED_PROVIDER_virtual/arm-angstrom-linux-gnueabi-libc-for-gcc = "glibc-intermediate"
PREFERRED_PROVIDER_virtual/arm-linux-libc-for-gcc = "glibc-intermediate"


#use EABI toolchain
PREFERRED_VERSION_gcc ?= "4.1.1"
PREFERRED_VERSION_gcc-cross ?= "4.1.1"
PREFERRED_VERSION_gcc-cross-initial ?= "4.1.1"
PREFERRED_VERSION_binutils ?= "2.16.91.0.7"
PREFERRED_VERSION_binutils-cross ?= "2.16.91.0.7"
PREFERRED_VERSION_linux-libc-headers ?= "2.6.15.99"
PREFERRED_VERSION_glibc ?= "2.4"
PREFERRED_VERSION_glibc-intermediate ?= "2.4"

# To use an EABI compatible version 3 series gcc, either uncomment 
# the lines below or set them in local.conf: 
#
# PREFERRED_VERSION_gcc-cross = "3.4.4+csl-arm-2005q3"
# PREFERRED_VERSION_gcc-cross-initial = "3.4.4+csl-arm-2005q3"


PREFERRED_VERSION_orinoco-modules_h3600 = "0.13e"
PREFERRED_VERSION_orinoco-modules_h3900 = "0.13e"
PREFERRED_VERSION_dbus ?= "0.61"
PREFERRED_VERSION_gstreamer ?= "0.10.6"

PREFERRED_PROVIDER_hostap-conf ?= "hostap-conf"
PREFERRED_PROVIDER_hostap-modules_h2200 ?= "hostap-modules"
PREFERRED_PROVIDER_hostap-modules_hx4700 ?= "hostap-modules"
PREFERRED_VERSION_hostap-modules ?= "0.4.7"

#Down here we put stuff we want to install into machines without polluting conf/machine/ with distro stuff
# c7x0, akita, spitz, nokia770, h2200, h6300, ipaq-pxa270, simpad

#### Bootstrap options ####

PCMCIA_MANAGER_c7x0 = "pcmciautils"
PCMCIA_MANAGER_akita = "pcmciautils"
PCMCIA_MANAGER_spitz = "pcmciautils"
PCMCIA_MANAGER_nokia770 = "pcmciautils"
PCMCIA_MANAGER_h2200 = "pcmciautils"
PCMCIA_MANAGER_h6300 = "pcmciautils"
PCMCIA_MANAGER_ipaq-pxa270 = "pcmciautils"



#### GPE section ###

#Install libgtkinput in devices without a keyboard
GPE_EXTRA_INSTALL_append_ipaq-pxa270 = " libgtkinput"
GPE_EXTRA_INSTALL_append_h2200 = " libgtkinput"
GPE_EXTRA_INSTALL_append_h6300 = " libgtkinput"
GPE_EXTRA_INSTALL_append_simpad =  " libgtkinput" 
GPE_EXTRA_INSTALL_append_nokia770 = " libgtkinput"

#As soon as a kill switch is in place we can add it to devices with a keyboard
#GPE_EXTRA_INSTALL_append_c7x0 = " libgtkinput"
#GPE_EXTRA_INSTALL_append_tosa = " libgtkinput"
#GPE_EXTRA_INSTALL_append_akita = " libgtkinput"
#GPE_EXTRA_INSTALL_append_spitz = " libgtkinput"
```

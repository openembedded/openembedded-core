## openembedded/conf/distro/familiar-0.8.3.conf
```bitbake
DISTRO = "familiar"
DISTRO_NAME = "Familiar Linux"
DISTRO_VERSION = "v0.8.3-unofficial-unsupported-snapshot-${DATE}"

include conf/distro/familiar.conf

"${@bb.fatal('This file is unmaintained in the org.oe.dev branch, use the org.openembedded.oz354fam083 branch instead. You can also remove this line, but don't complain if something breaks')}"



DISTRO_TYPE = "debug"
#DISTRO_TYPE = "release"

FEED_URIS += " \
        base##http://familiar.handhelds.org/releases/${DISTRO_VERSION}/feed/base \
	updates##http://familiar.handhelds.org/releases/${DISTRO_VERSION}/feed/updates"

#CVSDATE = 20050331

PREFERRED_PROVIDERS += "virtual/${TARGET_PREFIX}gcc-initial:gcc-cross-initial"
PREFERRED_PROVIDERS += "virtual/${TARGET_PREFIX}gcc:gcc-cross"
PREFERRED_PROVIDERS += "virtual/${TARGET_PREFIX}g++:gcc-cross"

PREFERRED_PROVIDER_virtual/libiconv=glibc
PREFERRED_PROVIDER_virtual/libintl=glibc
PREFERRED_PROVIDER_x11=diet-x11

PREFERRED_VERSION_hostap-modules ?= "0.3.9"

# The CSL compiler is unusable because
# 1) certain programs stop to compile
# 2) more programs segfault
PREFERRED_VERSION_gcc ?= "3.4.4"
PREFERRED_VERSION_gcc-cross ?= "3.4.4"
PREFERRED_VERSION_gcc-cross-initial ?= "3.4.4"

#
# Opie
#

PREFERRED_PROVIDERS += " virtual/libqpe:libqpe-opie"
PREFERRED_VERSION_qte = "2.3.10"

OPIE_VERSION = "1.2.1"
include conf/distro/preferred-opie-versions.inc

#
# GPE
#

PREFERRED_PROVIDERS += "virtual/xserver:xserver-kdrive"
PREFERRED_PROVIDERS += "virtual/gconf:gconf-dbus"
PREFERRED_PROVIDER_x11 = "diet-x11"

include conf/distro/preferred-gpe-versions-2.7.inc

#
# E
#


#23:57 < mickeyl> it's no longer necessary since our cleanup
#23:57 < mickeyl> it may be again when we add cvs versions, but until now, just don't include it

#include conf/distro/preferred-e-versions.inc
```

## openembedded/conf/distro/familiar-distro.conf
```bitbake
#@TYPE: Distribution
#@NAME: Familiar Linux
#@DESCRIPTION: Distribution configuration for Familiar Linux (handhelds.org)

INHERIT += "package_ipk debian"
TARGET_OS = "linux"

PARALLEL_INSTALL_MODULES = "1"

UDEV_DEVFS_RULES = "1"
```

## openembedded/conf/distro/familiar.conf
```bitbake
#@TYPE: Distribution
#@NAME: Familiar Linux
#@DESCRIPTION: Distribution configuration for Familiar Linux (handhelds.org)

MAINTAINER ?= "Familiar Developers <familiar-dev@handhelds.org>"

INHERIT += "package_ipk debian multimachine"
TARGET_OS = "linux"

BOOTSTRAP_EXTRA_RDEPENDS += "familiar-version"
IMAGE_NAME = "${IMAGE_BASENAME}-${DISTRO_VERSION}-${MACHINE}"

ENABLE_BINARY_LOCALE_GENERATION ?= "1"
PARALLEL_INSTALL_MODULES = "1"
UDEV_DEVFS_RULES = "1"

DISTRO_CHECK := "${@bb.data.getVar("DISTRO_VERSION",d,1) or bb.fatal('Remove this line or set a dummy DISTRO_VERSION if you really want to build an unversioned distro')}"
```

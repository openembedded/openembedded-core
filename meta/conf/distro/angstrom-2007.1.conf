## meta/conf/distro/angstrom-2007.1.conf
```bitbake
#@--------------------------------------------------------------------
#@TYPE: Distribution
#@NAME: Angstrom <http://www.angstrom-distribution.org>
#@DESCRIPTION: The Linux Distribution for Kernel 2.6 based devices
#@MAINTAINER: Koen Kooi <koen@dominion.kabel.utwente.nl>
#@MAINTAINER: Michael 'Mickey' Lauer <mickey@Vanille.de>
#@--------------------------------------------------------------------

#DISTRO_VERSION = "2007.1"
DISTRO_VERSION = "test-${DATE}"
DISTRO_REVISION = "10"

require conf/distro/include/angstrom.inc
require conf/distro/include/sane-srcdates.inc

DISTRO_TYPE = "debug"
#DISTRO_TYPE = "release"

#Set the right arch for the feeds
#Alphabetically sorted

FEED_ARCH ?= "${TARGET_ARCH}"

#armv4t machines

FEED_ARCH_ep93xx 	= "armv4t"
FEED_ARCH_h6300		= "armv4t"

#armv5t machines

FEED_ARCH_a780 		= "armv5te"
FEED_ARCH_akita		= "armv5te"
FEED_ARCH_c7x0		= "armv5te"
FEED_ARCH_h2200		= "armv5te"
FEED_ARCH_h4000		= "armv5te"
FEED_ARCH_h5xxx		= "armv5te"
FEED_ARCH_htcuniversal 	= "armv5te"
FEED_ARCH_hx2000	= "armv5te"
FEED_ARCH_hx4700	= "armv5te"
FEED_ARCH_ixp4xx	= "armv5te"
FEED_ARCH_magician	= "armv5te"
FEED_ARCH_netbook-pro	= "armv5te"
FEED_ARCH_nokia770	= "armv5te"
FEED_ARCH_poodle	= "armv5te"
FEED_ARCH_spitz		= "armv5te"
FEED_ARCH_tosa		= "armv5te"

#i686 machines

FEED_ARCH_guinness	= "i686"

FEED_URIS += " \
		no-arch##${ANGSTROM_URI}/unstable/feed/all \
		base##${ANGSTROM_URI}/unstable/feed/${FEED_ARCH}/base \
		perl##${ANGSTROM_URI}/unstable/feed/${FEED_ARCH}/perl \
		python##${ANGSTROM_URI}/unstable/feed/${FEED_ARCH}/python \
		debug##${ANGSTROM_URI}/unstable/feed/${FEED_ARCH}/debug \
		${MACHINE}##${ANGSTROM_URI}/unstable/feed/${FEED_ARCH}/machine/${MACHINE}"
#        base##${ANGSTROM_URI}/releases/${DISTRO_VERSION}/feed/${FEED_ARCH}/base \
#        ${MACHINE}##${ANGSTROM_URI}/releases/${DISTRO_VERSION}/feed/${FEED_ARCH}/machine/${MACHINE} \
#        updates##${ANGSTROM_URI}/releases/${DISTRO_VERSION}/feed/${FEED_ARCH}/updates"


# We will lock down a SRCDATE when we go into release mode
#SRCDATE = "20061029"

PREFERRED_VERSION_linux-handhelds-2.6 = "2.6.16-hh7"
PREFERRED_VERSION_linux-handhelds-2.6_htcuniversal = "2.6.17-hh2"


SRCDATE_gconf-dbus = "20060719"
SRCDATE_gnome-vfs-dbus = "20060803"

CVS_TARBALL_STASH = "\
http://ewi546.ewi.utwente.nl/mirror/www.openzaurus.org/official/unstable/3.5.4/sources/ \
"

# GPE
require conf/distro/include/preferred-gpe-versions-2.8.inc

PREFERRED_PROVIDER_dbus-glib = "dbus-glib"
PREFERRED_PROVIDER_virtual/libsdl       ?= "libsdl-x11"
PREFERRED_PROVIDER_virtual/libxine      ?= "libxine-x11"


PREFERRED_VERSION_fontconfig = "2.3.95"
PREFERRED_VERSION_freetype = "2.2.1"
#fix screen corruption issues
PREFERRED_VERSION_cairo = "1.3.2"

#Small machines prefer kdrive, but we might ship full Xorg in other images
PREFERRED_PROVIDER_virtual/xserver ?= "xserver-kdrive"
PREFERRED_PROVIDER_xserver ?= "xserver-kdrive"

require conf/distro/include/preferred-xorg-versions-X11R7.1.inc

PREFERRED_VERSION_xserver-kdrive = "X11R7.1-1.1.0"
PREFERRED_VERSION_gtk+ = "2.10.6"

#zap extra stuff taking place in $MACHINE.conf 
GPE_EXTRA_INSTALL = ""


# E
require conf/distro/include/preferred-e-versions.inc

#Make sure we use 2.6 on machines with a 2.4/2.6 selector
KERNEL = "kernel26"
MACHINE_KERNEL_VERSION = "2.6"

PREFERRED_PROVIDER_task-bootstrap = "task-bootstrap"

PREFERRED_PROVIDERS += "virtual/${TARGET_PREFIX}gcc-initial:gcc-cross-initial"
PREFERRED_PROVIDERS += "virtual/${TARGET_PREFIX}gcc:gcc-cross"
PREFERRED_PROVIDERS += "virtual/${TARGET_PREFIX}g++:gcc-cross"

# Virtuals:
PREFERRED_PROVIDER_virtual/db ?= "db"
PREFERRED_PROVIDER_virtual/db-native ?= "db-native"
PREFERRED_PROVIDER_virtual/xserver ?= "xserver-kdrive"

# Others:
PREFERRED_PROVIDER_virtual/libx11 ?= "diet-x11"
PREFERRED_PROVIDER_gconf ?= "gconf-dbus"
PREFERRED_PROVIDER_gnome-vfs ?= "gnome-vfs"
PREFERRED_PROVIDER_tslib ?= "tslib"
PREFERRED_PROVIDER_tslib-conf ?= "tslib"
PREFERRED_PROVIDER_libgpewidget ?= "libgpewidget"
PREFERRED_PROVIDER_ntp = "ntp"
PREFERRED_PROVIDER_hotplug = "udev"
PREFERRED_PROVIDER_libxss = "libxss"

#Machine related toolchain stuff
ARCH_BYTE_SEX_ixp4xx = "le"


#EABI stuff
PREFERRED_PROVIDER_virtual/${TARGET_PREFIX}-libc-for-gcc = "glibc-intermediate"
PREFERRED_PROVIDER_virtual/arm-angstrom-linux-gnueabi-libc-for-gcc = "glibc-intermediate"
PREFERRED_PROVIDER_virtual/arm-linux-libc-for-gcc = "glibc-intermediate"

#shouldn't that be uclibc-initial????
PREFERRED_PROVIDER_virtual/arm-angstrom-linux-uclibcgnueabi-libc-for-gcc = "uclibc-initial"

#use EABI toolchain
PREFERRED_VERSION_gcc ?= "4.1.1"
PREFERRED_VERSION_gcc-cross ?= "4.1.1"
PREFERRED_VERSION_gcc-cross-sdk ?= "4.1.1"
PREFERRED_VERSION_gcc-cross-initial ?= "4.1.1"

PREFERRED_VERSION_binutils ?= "2.17.50.0.5"
PREFERRED_VERSION_binutils-cross ?= "2.17.50.0.5"
PREFERRED_VERSION_binutils-cross-sdk ?= "2.17.50.0.5"

PREFERRED_VERSION_linux-libc-headers_guinness ?= "2.6.18"
PREFERRED_VERSION_linux-libc-headers ?= "2.6.15.99"

PREFERRED_VERSION_glibc ?= "2.5"
PREFERRED_VERSION_glibc-intermediate ?= "2.5"

# To use an EABI compatible version 3 series gcc, either uncomment 
# the lines below or set them in local.conf: 
#
# PREFERRED_VERSION_gcc-cross = "3.4.4+csl-arm-2005q3"
# PREFERRED_VERSION_gcc-cross-initial = "3.4.4+csl-arm-2005q3"


# Busybox <1.1.0 doesn't have EABI support
PREFERRED_VERSION_busybox = "1.2.1"

PREFERRED_VERSION_orinoco-modules_h3600 = "0.13e"
PREFERRED_VERSION_orinoco-modules_h3900 = "0.13e"

PREFERRED_VERSION_dbus ?= "1.0.1"
PREFERRED_VERSION_dbus-glib ?= "0.71"

PREFERRED_VERSION_gstreamer ?= "0.10.6"

PREFERRED_PROVIDER_hostap-conf ?= "hostap-conf"
PREFERRED_PROVIDER_hostap-modules_h2200 ?= "hostap-modules"
PREFERRED_PROVIDER_hostap-modules_hx4700 ?= "hostap-modules"
PREFERRED_VERSION_hostap-modules ?= "0.4.7"
PREFERRED_VERSION_hostap-utils ?= "0.4.7"

#Down here we put stuff we want to install into machines without polluting conf/machine/ with distro stuff
# c7x0, akita, spitz, nokia770, h2200, h6300, hx4700, simpad


# add altboot to compatible models, will be replaced with angstrom-bootmanager
#EXTRA_STUFF_append_c7x0 = "altboot"
#EXTRA_STUFF_append_akita = "altboot"
#EXTRA_STUFF_append_spitz = "altboot"
#EXTRA_STUFF_append_poodle = "altboot"
#EXTRA_STUFF_append_tosa = "altboot"


# do some task-base stuff here

# We want to ship extra debug utils in the rootfs when doing a debug build 
DEBUG_APPS ?= ""
DEBUG_APPS += '${@base_conditional("DISTRO_TYPE", "release", "", "tslib-tests tslib-calibrate gdb strace procps",d)}'

#this should go away soon
EXTRA_STUFF ?= ""


# Angstrom want to ship some extra stuff. This should be moved into task-base eventually
DISTRO_EXTRA_RDEPENDS = "\
    update-modules module-init-tools modutils-initscripts \
    sysvinit initscripts sysvinit-pidof \
    psplash \
    netbase dropbear \
    angstrom-version \
    ipkg ipkg-collateral \
    util-linux-mount util-linux-umount \
    ${EXTRA_STUFF} \
    ${DEBUG_APPS} \
    "
```

## meta/conf/distro/angstrom.conf
```bitbake
#@TYPE: Distribution
#@NAME: Angstrom 
#@DESCRIPTION: Distribution configuration for Angstrom

DISTRO = "angstrom"
DISTRO_NAME = "Angstrom"

#Use this variable in feeds and other parts that need a URI
ANGSTROM_URI = "http://www.angstrom-distribution.org/"

#Set the default maintainer to angstrom-dev
MAINTAINER = "Angstrom Developers <angstrom-dev@handhelds.org>"

#use ipkg package format with debian style naming
#use multimachine buildrules 
INHERIT += "package_ipk debian multimachine"

#Generate locales on the buildsystem instead of on the target. Speeds up first boot, set to "1" to enable
PREFERRED_PROVIDER_qemu-native = "qemu-qop-nogfx-native"
ENABLE_BINARY_LOCALE_GENERATION ?= ""


#Use the ARM EABI when building for an ARM cpu. We can't use overrides
#here because this breaks all places where ":=" is used.
TARGET_VENDOR = "${@['','-angstrom'][bb.data.getVar('TARGET_ARCH',d,1)=='arm']}"
TARGET_OS = "linux${@['','-gnueabi'][bb.data.getVar('TARGET_ARCH',d,1)=='arm']}"

#mess with compiler flags to use -Os instead of -O2
#Please see http://free-electrons.com/doc/embedded_linux_optimizations/img47.html for some more info
FULL_OPTIMIZATION = "-fexpensive-optimizations -fomit-frame-pointer -frename-registers -Os"
BUILD_OPTIMIZATION = "-Os"

#ARM EABI is softfloat by default, but let's make sure :)
TARGET_FPU_arm = "soft"

#Always ship these packages
BOOTSTRAP_EXTRA_DEPENDS += "angstrom-version coreutils dropbear sysvinit"
BOOTSTRAP_EXTRA_RDEPENDS += "angstrom-version coreutils dropbear sysvinit"

#Name the generated images in a sane way
IMAGE_NAME = "${DISTRO_NAME}-${IMAGE_BASENAME}-${DISTRO_VERSION}-${MACHINE}"
DEPLOY_DIR_IMAGE = ${DEPLOY_DIR}/images/${MACHINE}

# Angstrom *always* has some form of release config, so error out if someone thinks he knows better 
DISTRO_CHECK := "${@bb.data.getVar("DISTRO_VERSION",d,1) or bb.fatal('Remove this line or set a dummy DISTRO_VERSION if you really want to build an unversioned distro')}"
```

## meta/conf/distro/defaultsetup.conf
```bitbake
include conf/distro/include/default-providers.inc
include conf/distro/include/default-versions.inc
include conf/distro/include/default-distrovars.inc
include conf/distro/include/world-broken.inc

TCMODE ?= "default"
require conf/distro/include/tcmode-${TCMODE}.inc

TCLIBC ?= "eglibc"
require conf/distro/include/tclibc-${TCLIBC}.inc

# Allow single libc distros to disable this code
TCLIBCAPPEND ?= "-${TCLIBC}"
TMPDIR .= "${TCLIBCAPPEND}"

CACHE = "${TMPDIR}/cache/${TCMODE}-${TCLIBC}${@['', '/' + str(bb.data.getVar('MACHINE', d, 1))][bool(bb.data.getVar('MACHINE', d, 1))]}${@['', '/' + str(bb.data.getVar('SDKMACHINE', d, 1))][bool(bb.data.getVar('SDKMACHINE', d, 1))]}"

USER_CLASSES ?= ""
PACKAGE_CLASSES ?= "package_ipk"
INHERIT_INSANE ?= "insane"
INHERIT_DISTRO ?= "debian devshell sstate license"
INHERIT += "${PACKAGE_CLASSES} ${USER_CLASSES} ${INHERIT_INSANE} ${INHERIT_DISTRO}"
```

## meta/conf/distro/familiar-unstable.conf
```bitbake
DISTRO = "familiar"
DISTRO_NAME = "Familiar Linux"
DISTRO_VERSION = "unstable-${DATE}"

require conf/distro/include/familiar.inc

DISTRO_TYPE = "debug"
#DISTRO_TYPE = "release"
#!!!!! DON'T FORGET TO ENABLE ZAPROOTPASSWD !!!!!

FEED_URIS += " \
    base##http://familiar.handhelds.org/releases/${DISTRO_VERSION}/feed/base \
	${MACHINE}##http://familiar.handhelds.org/releases/${DISTRO_VERSION}/feed/machine/${MACHINE} \
	updates##http://familiar.handhelds.org/releases/${DISTRO_VERSION}/feed/updates \
	locale-en##http://familiar.handhelds.org/releases/${DISTRO_VERSION}/feed/locale/en \
	locale-fr##http://familiar.handhelds.org/releases/${DISTRO_VERSION}/feed/locale/fr \
	locale-de##http://familiar.handhelds.org/releases/${DISTRO_VERSION}/feed/locale/de"

#SRCDATE = 20050331
#SRCDATE = "now"

PREFERRED_PROVIDERS += "virtual/${TARGET_PREFIX}gcc-initial:gcc-cross-initial"
PREFERRED_PROVIDERS += "virtual/${TARGET_PREFIX}gcc:gcc-cross"
PREFERRED_PROVIDERS += "virtual/${TARGET_PREFIX}g++:gcc-cross"

PREFERRED_PROVIDER_virtual/libiconv = "glibc"
PREFERRED_PROVIDER_virtual/libintl = "glibc"

PREFERRED_VERSION_hostap-modules ?= "0.3.9"

#2.4 machines prefer 0.13e ones
PREFERRED_VERSION_orinoco-modules ?= "0.13e"

#but 0.13e doesn't build against 2.6
PREFERRED_VERSION_orinoco-modules_h2200 ?= "0.15"
PREFERRED_VERSION_orinoco-modules_ipaq-pxa270 ?= "0.15"

# The CSL compiler is unusable because
# 1) certain programs stop to compile
# 2) more programs segfault
PREFERRED_VERSION_gcc ?= "3.4.4"
PREFERRED_VERSION_gcc-cross ?= "3.4.4"
PREFERRED_VERSION_gcc-cross-initial ?= "3.4.4"

#
# PIN the familiar build to a version
#
PREFERRED_VERSION_binutils-cross ?= "2.15.94.0.1"
PREFERRED_VERSION_binutils ?= "2.15.94.0.1"


#
# Base
#
PREFERRED_PROVIDER_hostap-conf = "hostap-conf"
PREFERRED_PROVIDER_task-bootstrap = "task-bootstrap"
require conf/distro/include/sane-srcdates.inc

#
# Opie
#

OPIE_VERSION = "1.2.2"
QTE_VERSION = "2.3.10"
PALMTOP_USE_MULTITHREADED_QT = "yes"
require conf/distro/include/preferred-opie-versions.inc

#
# GPE
#

PREFERRED_PROVIDERS += "virtual/xserver:xserver-kdrive"
PREFERRED_PROVIDERS += "virtual/gconf:gconf-dbus"
PREFERRED_PROVIDER_virtual/libx11 = "diet-x11"
require conf/distro/include/preferred-gpe-versions-2.8.inc

#
# E
#
require conf/distro/include/preferred-e-versions.inc
```

## meta/conf/distro/include/angstrom.inc
```bitbake
#@TYPE: Distribution
#@NAME: Angstrom 
#@DESCRIPTION: Distribution configuration for Angstrom

DISTRO = "angstrom"
DISTRO_NAME = "Angstrom"

TARGET_VENDOR = "-angstrom"
MACHINE_TASK_PROVIDER = "task-base"

# Can be "glibc" and "uclibc"
ANGSTROM_MODE ?= "glibc"

DEPLOY_DIR = "${TMPDIR}/deploy/${ANGSTROM_MODE}"
require conf/distro/include/angstrom-${ANGSTROM_MODE}.inc

#Use this variable in feeds and other parts that need a URI
ANGSTROM_URI = "http://www.angstrom-distribution.org"

#Set the default maintainer to angstrom-dev
MAINTAINER = "Angstrom Developers <angstrom-distro-devel@linuxtogo.org>"

#use ipkg package format with debian style naming
#use multimachine buildrules 
INHERIT += "package_ipk debian multimachine sanity"

#Generate locales on the buildsystem instead of on the target. Speeds up first boot, set to "1" to enable
PREFERRED_PROVIDER_qemu-native = "qemu-native"
ENABLE_BINARY_LOCALE_GENERATION ?= "1"

#qemu doesn't like armv6/eabi/vfp
ENABLE_BINARY_LOCALE_GENERATION_mx31ads = "0"

#ARM EABI is softfloat by default, but let's make sure :)
#make it overridable for platforms with FPU, like ep93xx or i.mx31
TARGET_FPU_arm ?= "soft"
TARGET_FPU_ixp4xx ?= "soft"


#Make a LE jffs2 image
SLUGOS_IMAGESEX = "little-endian"

#Name the generated images in a sane way
IMAGE_NAME = "${DISTRO_NAME}-${IMAGE_BASENAME}-${DISTRO_VERSION}-${MACHINE}"
DEPLOY_DIR_IMAGE = "${DEPLOY_DIR}/images/${MACHINE}"

# Angstrom *always* has some form of release config, so error out if someone thinks he knows better 
DISTRO_CHECK := "${@bb.data.getVar("DISTRO_VERSION",d,1) or bb.fatal('Remove this line or set a dummy DISTRO_VERSION if you really want to build an unversioned distro')}"

# We want images supporting the following features (for task-base)
DISTRO_FEATURES = "nfs smbfs wifi ppp alsa bluetooth ext2 irda pcmcia usbgadget usbhost"
```

## meta/conf/distro/include/debug-optimize.inc
```bitbake
# Override SELECTED_OPTIMIZATION and BUILD_OPTIMIZATION when fragment 'core/yocto/debug-optimize' is enabled.
DEBUG_OPTIMIZATION ?= "-Og ${DEBUG_LEVELFLAG}"
SELECTED_OPTIMIZATION ?= "${DEBUG_OPTIMIZATION}"
# compiler flags for native/nativesdk
BUILD_OPTIMIZATION ?= "-Og -g"
```

## meta/conf/distro/include/debug_build.inc
```bitbake
# Override SELECTED_OPTIMIZATION and BUILD_OPTIMIZATION when DEBUG_BUILD is enabled.
DEBUG_OPTIMIZATION ?= "-Og ${DEBUG_LEVELFLAG}"
SELECTED_OPTIMIZATION ?= "${DEBUG_OPTIMIZATION}"
# compiler flags for native/nativesdk
BUILD_OPTIMIZATION ?= "-Og -g"
```

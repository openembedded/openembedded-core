## meta/conf/distro/include/poky-default-revisions.inc
```bitbake
SRCREV_pn-aaina ??= "4b267533ce16656cba4104fc39dc12709c1bdddf"
SRCDATE_abiword ??= "20070130"
SRCREV_pn-blktrace ??= "1e09f6e9012826fca69fa07222b7bc53c3e629ee"
SRCREV_pn-calibrateproto ??= "1da6fd1e2c7a49648245c98481fabea8b9690a8c"
SRCREV_pn-clipboard-manager ??= "14994"
SRCREV_pn-clutter ??= "e957e277b8a4893ce8c99e94402036d42a8b3748"
SRCREV_pn-clutter-0.6 ??= "62e852a51e29dd42c84d6b34fe23b80b2542be59"
SRCREV_pn-clutter-0.8 ??= "3ba37ff115ed3fbe6c94195775941091a3ac2b30"
SRCREV_pn-clutter-1.0 ??= "ce5025d0a2b701541ca9343686f9dac858905da4"
SRCREV_pn-clutter-box2d ??= "2bcf5b836548dc4909e13b8ae7f60dc64c93d559"
SRCREV_pn-clutter-gst-0.10 ??= "8a087fabc888a6a4a939760c392109dbb610adbf"
SRCREV_pn-clutter-gtk-0.10 ??= "b92329c4c1288019e2dea6567e2b5e98eb0a9992"
SRCREV_pn-clutter-imcontext ??= "2cb6f0ff153db639a489e58e36802e0e928b1968"
SRCREV_pn-clutter-mozembed ??= "738d017beb5579b2ff6e4d992d4889b61c974751"
SRCREV_pn-clutter-cairo-0.6 ??= "4dc4ef712ddc890d828a1cb65a69a835285af548"
SRCREV_pn-clutter-cairo-0.8 ??= "e27e507dedddec3f279a2902ecee0da1011c78eb"
SRCREV_pn-clutter-cairo ??= "7b45e0de2d4b9f1cd47486e5de71a1a26e8fdf27"
SRCREV_pn-clutter-gst-0.6 ??= "1c3dc539057dbcd6dd75f2cb5b4ba39b741892bd"
SRCREV_pn-clutter-gst-0.8 ??= "7a60a435fb0930d911e26158928ab53bda090f3e"
SRCREV_pn-clutter-gst-0.10 ??= "8a087fabc888a6a4a939760c392109dbb610adbf"
SRCREV_pn-clutter-gst-1.0 ??= "d48c6fc67b48304f90e51b520631c1ecc10410af"
SRCREV_pn-clutter-helix ??= "b4514a7bae2a059f4e63de64245238a246ed10bd"
SRCREV_pn-clutter-gtk-0.6 ??= "2ba362a1a223c2b28541030a80aa11191615340a"
SRCREV_pn-clutter-gtk-0.8 ??= "7d3c3230376e731c06c21afa9d8c1d44dbea27cd"
SRCREV_pn-clutter-gtk-0.10 ??= "b92329c4c1288019e2dea6567e2b5e98eb0a9992"
SRCREV_pn-clutter-gtk-1.0 ??= "e8d828ba1d87937baa571e68fdff22f3e2d79ca8"
SRCREV_pn-clutter-mozembed ??= "738d017beb5579b2ff6e4d992d4889b61c974751"
SRCREV_pn-connman ??= "36e877dece72577a3ae6197eafd505d0e6e0c1d2"
SRCREV_pn-connman-gnome ??= "b589f4f89bff20d54682cc6b49efa86feac8adb4"
SRCREV_pn-contacts ??= "19853893fdb595de6aa59db0d9dc2f9451ed2933"
SRCREV_pn-dates ??= "514185dc1f6588085fda41eb59898b93d0487dd4"
SRCREV_pn-dbus-wait ??= "426"
SRCREV_pn-devicekit ??= "014d168ba4bf40c9bae487bacff8bf2aa054b5f6"
SRCREV_pn-dri2proto ??= "66c56ab10d917e3f47f93178d7eac6430970d3c4"
SRCREV_pn-dtc ??= "73dca9ae0b9abe6924ba640164ecce9f8df69c5a"
SRCREV_pn-dtc-native ??= "73dca9ae0b9abe6924ba640164ecce9f8df69c5a"
SRCREV_pn-eds-dbus ??= "7337d11aed576e7caaa12b4e881ad8d33668799f"
SRCREV_pn-eds-tools ??= "2008-02-04"
SRCREV_pn-eee-acpi-scripts ??= "e224937ba51165e2a52252f9a113c8a82c01bb36"
EGLIBCREV = "11982"
SRCREV_pn-eglibc ??= "${EGLIBCREV}"
SRCREV_pn-eglibc-initial ??= "${EGLIBCREV}"
SRCREV_pn-eglibc-nativesdk ??= "${EGLIBCREV}"
SRCREV_pn-eglibc-initial-nativesdk ??= "${EGLIBCREV}"
SRCREV_pn-exmap-console ??= "405"
SRCREV_pn-fstests ??= "426"
SRCREV_pn-gaku ??= "399"
SRCREV_pn-gconf-dbus ??= "705"
SRCREV_pn-gconf-dbus-native ??= "705"
SRCREV_pn-gtkhtml2 ??= "1144"
SRCREV_pn-gtk-sato-engine ??= "163"
SRCREV_pn-gtk-theme-torturer ??= "99962ae39bb5aadb31929b25c58e1a053f9c9545"
SRCREV_pn-gtk-theme-darkilouche ??= "b4ce102a303d1176107a9d9d28c14f7da78feedd"
SRCREV_pn-gobject-introspection ??= "efa7266bcf78478ce62e8dd778a4f0417bfd4d15"
SRCREV_pn-gobject-introspection-native ??= "efa7266bcf78478ce62e8dd778a4f0417bfd4d15"
SRCREV_pn-gypsy ??= "147"
SRCREV_pn-inputproto ??= "7203036522ba9d4b224d282d6afc2d0b947711ee"
SRCREV_pn-inputproto-native ??= "7203036522ba9d4b224d282d6afc2d0b947711ee"
SRCREV_pn-inputproto-nativesdk ??= "7203036522ba9d4b224d282d6afc2d0b947711ee"
SRCREV_pn-kern-tools-native ??= "8832b75dc2e494ae96ca3e1dee7bfde2f3096904"
SRCREV_pn-libdrm ??= "3f3c5be6f908272199ccf53f108b1124bfe0a00e"
SRCREV_pn-libfakekey ??= "2031"
SRCREV_pn-libgdbus ??= "aeab6e3c0185b271ca343b439470491b99cc587f"
SRCREV_pn-libgsmd ??= "5394"
SRCREV_pn-libmatchbox ??= "1531"
SRCREV_pn-libowl ??= "408"
SRCREV_pn-libowl-av ??= "416"
SRCREV_pn-libx11 ??= "d23aad31338e7d869d878d5aa1b6b91d20287005"
SRCREV_pn-libx11-diet ??= "d23aad31338e7d869d878d5aa1b6b91d20287005"
SRCREV_pn-libx11-native ??= "d23aad31338e7d869d878d5aa1b6b91d20287005"
SRCREV_pn-libx11-nativesdk ??= "d23aad31338e7d869d878d5aa1b6b91d20287005"
SRCREV_pn-libx11-trim ??= "d23aad31338e7d869d878d5aa1b6b91d20287005"
SRCREV_pn-libxcalibrate ??= "209d83af61ed38a002c8096377deac292b3e396c"
SRCREV_pn-libxcb ??= "625ed596cae6dd8175aeb6cb6f26784928042f22"
SRCREV_pn-libxcb-nativesdk ??= "625ed596cae6dd8175aeb6cb6f26784928042f22"
SRCREV_pn-libxext ??= "d1f3bc77a48c8e42771579e3fdf3370b35d3209d"
SRCREV_pn-libxext-nativesdk ??= "d1f3bc77a48c8e42771579e3fdf3370b35d3209d"
SRCREV_pn-libxi ??= "d0326fe8cdbb08d4f52d79fd3fd4e1b2a0951d5e"
SRCREV_pn-libzypp = "4494797d5b0369365b1af63921de45b197ead64f"
SRCREV_pn-linux-firmware ??= "40c0f950be7040614dc45df54e25e54d00e3b73b"
SRCREV_pn-linux-openmoko ??= "5ccaca2adb1c37b5955a4733f68ae08a755e3d78"
SRCREV_pn-linux-omap ??= "58cf2f1425abfd3a449f9fe985e48be2d2555022"
SRCREV_pn-linux-omap-zoomsync ??= "015cbaf1035cd9a61d33a27de2a22902555db3c5"
SRCREV_pn-linux-omap2 ??= "d3b3ae0fe6c71641da19c8de466ec366d39847e3"
SRCREV_pn-linux-omap3 ??= "de1121fdb899f762b9e717f44eaf3fae7c00cd3e"
SRCREV_pn-linux-omap3-pm ??= "totallybroken"
SRCREV_machine_pn-linux-yocto-stable_qemuarm ?= "a2fb081b44d6368eff8d28e2fdb991c61b1f428e"
SRCREV_machine_pn-linux-yocto-stable_qemumips ?= "c32d40f960e3c89d07f079bec4c96dcbfc749f0b"
SRCREV_machine_pn-linux-yocto-stable_qemuppc ?= "96d6bc31d3caaf62a966255479cc5cee0e76b1e9"
SRCREV_machine_pn-linux-yocto-stable_qemux86 ?= "72ca49ab08b8eb475cec82a10049503602325791"
SRCREV_machine_pn-linux-yocto-stable_qemux86-64 ?= "72ca49ab08b8eb475cec82a10049503602325791"
SRCREV_machine_pn-linux-yocto-stable_atom-pc ?= "72ca49ab08b8eb475cec82a10049503602325791"
SRCREV_machine_pn-linux-yocto-stable_routerstationpro ?= "49745cd45c92a89e70c6e2334caa80818c134562"
SRCREV_machine_pn-linux-yocto-stable_mpc8315e-rdb ?= "a1c0ed6bf4060c10874b2a8547d81b3169dcf16a"
SRCREV_machine_pn-linux-yocto-stable_beagleboard ?= "ef7f944e773950d4016b7643f9ecf052bbe250cd"
SRCREV_meta_pn-linux-yocto-stable ?= "e1f85a470934a0cf6abde5d95533e74501822c6b"
# development SRCREVs
SRCREV_machine_pn-linux-yocto_qemuarm ?= "4f86b5a0cb23faa4134cc004730d673f6640614b"
SRCREV_machine_pn-linux-yocto_qemumips ?= "2b43d84250a582b61397ad5f59a6445ce1258615"
SRCREV_machine_pn-linux-yocto_qemuppc ?= "20f182db27f3e6fc6bd55bfc9e24c8c023fbff7f"
SRCREV_machine_pn-linux-yocto_qemux86 ?= "a9d833fda90e2f1257888a97e092135610b5f259"
SRCREV_machine_pn-linux-yocto_qemux86-64 ?= "a9d833fda90e2f1257888a97e092135610b5f259"
SRCREV_machine_pn-linux-yocto_emenlow ?= "c19e556f79f03c8f1e5e84ccd9b5436c2001fcce"
SRCREV_machine_pn-linux-yocto_atom-pc ?= "a9d833fda90e2f1257888a97e092135610b5f259"
SRCREV_machine_pn-linux-yocto_routerstationpro ?= "219a5f9dc6e5beced36184e141f80b2df61ae32f"
SRCREV_machine_pn-linux-yocto_mpc8315e-rdb ?= "3f01b98238c2ff7913ce9f68f9db5ae9538717bc"
SRCREV_machine_pn-linux-yocto_beagleboard ?= "a9d833fda90e2f1257888a97e092135610b5f259"
SRCREV_meta_pn-linux-yocto ?= "8a49ef6f1a43dabbce34a9ee9a1be08b26fc511c"
SRCREV_pn-linux-libc-headers-yocto ??= "a9d833fda90e2f1257888a97e092135610b5f259"
SRCREV_pn-matchbox-config-gtk ??= "2081"
SRCREV_pn-matchbox-desktop-sato ??= "76"
SRCREV_pn-matchbox-desktop ??= "2096"
SRCREV_pn-matchbox-keyboard ??= "2075"
SRCREV_pn-matchbox-panel-2 ??= "2111"
SRCREV_pn-matchbox-panel ??= "1364"
SRCREV_pn-matchbox-stroke ??= "1820"
SRCREV_pn-matchbox-terminal ??= "1816"
SRCREV_pn-matchbox-theme-sato-2 ??= "164"
SRCREV_pn-matchbox-theme-sato ??= "90"
SRCREV_pn-matchbox-themes-extra ??= "1524"
SRCREV_pn-matchbox-wm-2 ??= "2106"
SRCREV_pn-matchbox-wm ??= "1819"
SRCREV_pn-mesa-dri ??= "1bf94d419805538ac23a4d0b04d31ac5e4487aca"
SRCREV_pn-mesa-xlib ??= "1bf94d419805538ac23a4d0b04d31ac5e4487aca"
SRCDATE_minimo ??= "20070510"
SRCREV_pn-moblin-proto ??= "8f2cb524fe06555182c25b4ba3202d7b368ac0ce"
SRCREV_pn-mozilla-headless ??= "177d8b8bda61"
SRCREV_pn-mozilla-headless-services ??= "c679b95dd8c2807b70186d233b3833861a499315"
SRCREV_pn-mutter ??= "c96345dd81176f171c2d15dd9d5c5b20f334f842"
SRCREV_pn-networkmanager-applet ??= "263"
SRCREV_pn-networkmanager ??= "2984"
SRCREV_pn-ofono ??= "14544d5996836f628613c2ce544380ee6fc8f514"
SRCREV_pn-oh-puzzles ??= "23"
SRCREV_pn-ohm ??= "edfe25d49d67884bf004de7ae0724c162bb5e65e"
OPKGSRCREV = "590"
SRCREV_pn-opkg ??= "${OPKGSRCREV}"
SRCREV_pn-opkg-native ??= "${OPKGSRCREV}"
SRCREV_pn-opkg-nativesdk ??= "${OPKGSRCREV}"
SRCREV_pn-opkg-nogpg ??= "${OPKGSRCREV}"
SRCREV_pn-opkg-nogpg-native ??= "${OPKGSRCREV}"
SRCREV_pn-opkg-nogpg-nativesdk ??= "${OPKGSRCREV}"
SRCREV_pn-opkg-utils-native ??= "4747"
SRCREV_pn-opkg-utils ??= "4747"
SRCREV_pn-oprofileui ??= "197"
SRCREV_pn-tcf-agent ??= "1078"
SRCREV_pn-osc-native ??= "9096"
SRCREV_pn-owl-video ??= "394"
SRCREV_pn-pkgconfig ??= "66d49f1375fec838bcd301bb4ca2ef76cee0e47c"
PRELINKSRCREV ??= "909470ee441237563d6236c505cb2d02ddc48704"
SRCREV_pn-prelink ??= "${PRELINKSRCREV}"
SRCREV_pn-prelink-native ??= "${PRELINKSRCREV}"
SRCREV_pn-psplash ??= "424"
PSEUDOSRCREV ??= "bcb42d80c0817da5479ab9c4f2cd8c4727e98ef8"
SRCREV_pn-pseudo ??= "${PSEUDOSRCREV}"
SRCREV_pn-pseudo-native ??= "${PSEUDOSRCREV}"
SRCREV_pn-pseudo-nativesdk ??= "${PSEUDOSRCREV}"
QEMUSRCREV ??= "72bb3c7571226af13cfe9eec020a56add3d30a70"
SRCREV_pn-qemu-native ??= "${QEMUSRCREV}"
SRCREV_pn-qemu-nativesdk ??= "${QEMUSRCREV}"
SRCREV_pn-qemu ??= "${QEMUSRCREV}"
SRCREV_pn-qemugl ??= "d888bbc723c00d197d34a39b5b7448660ec1b1c0"
SRCREV_pn-qemugl-nativesdk ??= "d888bbc723c00d197d34a39b5b7448660ec1b1c0"
SRCREV_pn-sat-solver = "aa799f7bae0ec055e0e527203635001bb7346dbc"
SRCREV_pn-screenshot ??= "292"
SRCREV_pn-settings-daemon ??= "2059"
SRCREV_pn-swabber-native ??= "a0792390c5d6d5a5bade7ab155c80eef3f30fa52"
SRCREV_pn-sysprof ??= "38a6af1f0a45e528fd2842983da71e0f23c70d6a"
SRCREV_pn-systemtap ??= "4ab3a1863bf4f472acae7a809bf2b38d91658aa8"
SRCREV_pn-table ??= "4b267533ce16656cba4104fc39dc12709c1bdddf"
SRCREV_pn-tasks ??= "ea52d46d691c5fce4473ea4e24a35411381f3a65"
TRACECMDREV ?= "6c696cec3f264a9399241b6e648f58bc97117d49"
SRCREV_pn-trace-cmd ??= ${TRACECMDREV}
SRCREV_pn-kernelshark ??= ${TRACECMDREV}
SRCREV_pn-tidy ??= "e25416e1293e1074bfa6727c80527dcff5b1f3cb"
SRCREV_pn-u-boot-omap3 ??= "f40f6db278f602b55820693634a7256b0b4e4b80"
SRCREV_pn-u-boot ??= "v2010.12"
SRCREV_pn-ubootchart ??= "10"
SRCREV_pn-webkit-gtk ??= "72836"
SRCREV_pn-web-webkit ??= "130"
SRCREV_pn-web ??= "129"
SRCREV_pn-xcb-proto ??= "d81ca233e98be8fa59e8c90d262c0516944c5a66"
SRCREV_pn-xcb-proto-native ??= "d81ca233e98be8fa59e8c90d262c0516944c5a66"
SRCREV_pn-xf86-video-intel ??= "87ea531c5dc5b39809395b277c330854aaaaf019"
SRCREV_pn-xf86-video-intel-dri2 ??= "3dd7f0f9423bb891bc99cd3b77dc3d57e057a7ef"
SRCREV_pn-xf86-video-omapfb ??= "6cff996abcb305460e9fa2c75569b776f099c9d5"
SRCREV_pn-xf86-input-keyboard ??= "3e28d68b50d291938734e9684b8296ca864f3892"
SRCREV_pn-xf86-input-mouse ??= "ea5cfe804e112f320f14ad896c7802d53551d3e6"
SRCREV_pn-xf86-input-synaptics ??= "934bc0012f948c52aadc8eda912f7728fb7394a2"
SRCREV_pn-xserver-kdrive-glamo ??= "a51364e2f23d4b6331c5ed613ce3f7e15f8e540f"
SRCREV_pn-xserver-xf86-dri-lite ??= "251d0d8090322b2c9dc0c8b7bef001f338d19433"
SRCREV_pn-xserver-xf86-dri2-lite ??= "251d0d8090322b2c9dc0c8b7bef001f338d19433"
SRCREV_pn-xvideo-tests ??= "270"
SRCREV_pn-x-load ??= "6f3a26101303051e0f91b6213735b68ce804e94e"
SRCDATE_yaffs2-utils-native ??= "20071107"
SRCDATE_yaffs2-utils ??= "20071107"
SRCREV_pn-zaurusd ??= "426"
SRCREV_pn-zypper ??= "9eb0e248e06c8d20ad054be2439149d9ede37531"
```

## meta/conf/distro/include/poky-default.inc
```bitbake
#
# Poky's default configuration
#

TARGET_VENDOR = "-poky"

PREFERRED_PROVIDER_virtual/${TARGET_PREFIX}libc-for-gcc = "${POKYLIBC}"
PREFERRED_PROVIDER_virtual/${TARGET_PREFIX}binutils = "binutils-cross"
PREFERRED_PROVIDER_virtual/${TARGET_PREFIX}gcc-initial = "gcc-cross-initial"
PREFERRED_PROVIDER_virtual/${TARGET_PREFIX}gcc-intermediate = "gcc-cross-intermediate"
PREFERRED_PROVIDER_virtual/${TARGET_PREFIX}gcc = "gcc-cross"
PREFERRED_PROVIDER_virtual/${TARGET_PREFIX}g++ = "gcc-cross"
PREFERRED_PROVIDER_virtual/${TARGET_PREFIX}compilerlibs = "gcc-runtime"
PREFERRED_PROVIDER_virtual/${TARGET_PREFIX}libc-initial = "${POKYLIBC}-initial"
PREFERRED_PROVIDER_virtual/${SDK_PREFIX}libc-for-gcc-nativesdk ?= "${POKYLIBC}-nativesdk"


GCCVERSION ?= "4.5.1"
SDKGCCVERSION ?= "4.5.1"
BINUVERSION ?= "2.21"
GLIBCVERSION ?= "2.10.1"
LINUXLIBCVERSION ?= "2.6.36"

# Temporary preferred version overrides for PPC
PREFERRED_VERSION_u-boot-mkimage-native_powerpc ?= "2009.08"

PREFERRED_VERSION_gcc ?= "${GCCVERSION}"
PREFERRED_VERSION_gcc-cross ?= "${GCCVERSION}"
PREFERRED_VERSION_gcc-cross-initial ?= "${GCCVERSION}"
PREFERRED_VERSION_gcc-cross-intermediate ?= "${GCCVERSION}"
PREFERRED_VERSION_gcc-crosssdk ?= "${SDKGCCVERSION}"
PREFERRED_VERSION_gcc-crosssdk-initial ?= "${SDKGCCVERSION}"
PREFERRED_VERSION_gcc-crosssdk-intermediate ?= "${SDKGCCVERSION}"
PREFERRED_VERSION_gcc-cross-canadian ?= "${GCCVERSION}"
PREFERRED_VERSION_gcc-runtime ?= "${GCCVERSION}"
PREFERRED_VERSION_gcc-runtime-nativesdk ?= "${SDKGCCVERSION}"
PREFERRED_VERSION_binutils ?= "${BINUVERSION}"
PREFERRED_VERSION_binutils-cross ?= "${BINUVERSION}"
PREFERRED_VERSION_binutils-crosssdk ?= "${BINUVERSION}"
PREFERRED_VERSION_binutils-cross-canadian ?= "${BINUVERSION}"
PREFERRED_VERSION_linux-libc-headers ?= "${LINUXLIBCVERSION}"
PREFERRED_VERSION_linux-libc-headers-nativesdk ?= "${LINUXLIBCVERSION}"
PREFERRED_VERSION_glibc ?= "${GLIBCVERSION}"
PREFERRED_VERSION_glibc-nativesdk ?= "${GLIBCVERSION}"
PREFERRED_VERSION_glibc-initial ?= "${GLIBCVERSION}"
PREFERRED_VERSION_glibc-initial-nativesdk ?= "${GLIBCVERSION}"
PREFERRED_VERSION_elfutils ?= "0.148"
# don't use version earlier than 1.4 for gzip-native, as it's necessary for
# some packages using an archive format incompatible with earlier gzip
PREFERRED_VERSION_gzip-native ?= "1.4"

require conf/distro/include/as-needed.inc
```

## meta/conf/distro/include/poky-eabi-csl2005q3-2.inc
```bitbake
#
# Poky configuration to use CSL 2005q3-2 derived toolchain (ARM EABI)
#

PREFERRED_PROVIDER_virtual/${TARGET_PREFIX}libc-for-gcc = "glibc-intermediate"
PREFERRED_PROVIDER_virtual/${TARGET_PREFIX}binutils = "binutils-cross"
PREFERRED_PROVIDER_virtual/${TARGET_PREFIX}gcc-initial = "gcc-cross-initial"
PREFERRED_PROVIDER_virtual/${TARGET_PREFIX}gcc = "gcc-cross"
PREFERRED_PROVIDER_virtual/${TARGET_PREFIX}g++ = "gcc-cross"

PREFERRED_VERSION_gcc ?= "3.4.4+csl-arm-2005q3-2"
PREFERRED_VERSION_gcc-cross ?= "3.4.4+csl-arm-2005q3-2"
PREFERRED_VERSION_gcc-cross-initial ?= "3.4.4+csl-arm-2005q3-2"
PREFERRED_VERSION_binutils ?= "2.16+csl-arm-2005q3-2"
PREFERRED_VERSION_binutils-cross ?= "2.16+csl-arm-2005q3-2"
PREFERRED_VERSION_glibc ?= "2.3.6+csl-arm-2005q3-2"
PREFERRED_VERSION_glibc-intermediate ?= "2.3.6+csl-arm-2005q3-2"
PREFERRED_VERSION_elfutils ?= "0.108"

PREFERRED_VERSION_linux-libc-headers ?= "2.6.12rc3+csl-arm-2005q3-2"
```

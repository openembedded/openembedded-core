## meta/conf/distro/include/private/distro_toolchain_devel.inc
```bitbake
RECIPE_STATUS_pn-binutils="green" # upgraded
RECIPE_LATEST_VERSION_pn-binutils="2.20.1"
RECIPE_NO_OF_PATCHES_pn-binutils="8"
RECIPE_TIME_BETWEEN_LAST_TWO_RELEASES_pn-binutils="1 months"
RECIPE_LATEST_RELEASE_DATE_pn-binutils="2010/05/28"
RECIPE_MAINTAINER_pn-binutils = "Nitin A Kamble <nitin.a.kamble@intel.com>"

RECIPE_STATUS_pn-gcc="red" # recipe building is failing
RECIPE_LATEST_VERSION_pn-gcc="4.5.0"
RECIPE_NO_OF_PATCHES_pn-gcc="8"
RECIPE_TIME_BETWEEN_LAST_TWO_RELEASES_pn-gcc="5 months"
RECIPE_LATEST_RELEASE_DATE_pn-gcc="2010/03/03"
RECIPE_MAINTAINER_pn-gcc = "Nitin A Kamble <nitin.a.kamble@intel.com>"

RECIPE_STATUS_pn-autoconf="green" # no update needed
RECIPE_LATEST_VERSION_pn-autoconf="2.65"
RECIPE_NO_OF_PATCHES_pn-autoconf="10"
RECIPE_TIME_BETWEEN_LAST_TWO_RELEASES_pn-autoconf="4 months"
RECIPE_LATEST_RELEASE_DATE_pn-autoconf="2009/11/21"
RECIPE_MAINTAINER_pn-autoconf = "Nitin A Kamble <nitin.a.kamble@intel.com>"

RECIPE_STATUS_pn-automake="green" # no update needed
RECIPE_LATEST_VERSION_pn-automake="1.11.1"
RECIPE_NO_OF_PATCHES_pn-automake="1"
RECIPE_TIME_BETWEEN_LAST_TWO_RELEASES_pn-automake="7 months"
RECIPE_LATEST_RELEASE_DATE_pn-automake="2009/12/08"
RECIPE_MAINTAINER_pn-automake = "Nitin A Kamble <nitin.a.kamble@intel.com>"

RECIPE_STATUS_pn-bison="green" # upgraded
RECIPE_LATEST_VERSION_pn-bison="2.4.2"
RECIPE_NO_OF_PATCHES_pn-bison="1"
RECIPE_TIME_BETWEEN_LAST_TWO_RELEASES_pn-bison="15 months"
RECIPE_LATEST_RELEASE_DATE_pn-bison="2010/03/20"
RECIPE_MAINTAINER_pn-bison = "Nitin A Kamble <nitin.a.kamble@intel.com>"

RECIPE_STATUS_pn-diffstat="green" # upgraded
RECIPE_LATEST_VERSION_pn-diffstat="1.47"
RECIPE_NO_OF_PATCHES_pn-diffstat="0"
RECIPE_TIME_BETWEEN_LAST_TWO_RELEASES_pn-diffstat="20 months"
RECIPE_LATEST_RELEASE_DATE_pn-diffstat="2009/05/04"
RECIPE_MAINTAINER_pn-diffstat = "Nitin A Kamble <nitin.a.kamble@intel.com>"

RECIPE_STATUS_pn-distcc="green" # no update needed
RECIPE_LATEST_VERSION_pn-distcc="2.18.3"
RECIPE_NO_OF_PATCHES_pn-distcc="2"
RECIPE_TIME_BETWEEN_LAST_TWO_RELEASES_pn-distcc="1 months"
RECIPE_LATEST_RELEASE_DATE_pn-distcc="2004/11/30"
RECIPE_MAINTAINER_pn-distcc = "Nitin A Kamble <nitin.a.kamble@intel.com>"

RECIPE_STATUS_pn-exmap-console="green" # no update needed
RECIPE_LATEST_VERSION_pn-exmap-console="0.4.1"
RECIPE_NO_OF_PATCHES_pn-exmap-console="0"
RECIPE_TIME_BETWEEN_LAST_TWO_RELEASES_pn-exmap-console="2 months"
RECIPE_LATEST_RELEASE_DATE_pn-exmap-console="2007/02/26"
RECIPE_MAINTAINER_pn-exmap-console = "Nitin A Kamble <nitin.a.kamble@intel.com>"

RECIPE_STATUS_pn-flex="green" # upgraded
RECIPE_LATEST_VERSION_pn-flex="2.5.35"
RECIPE_NO_OF_PATCHES_pn-flex="3"
RECIPE_TIME_BETWEEN_LAST_TWO_RELEASES_pn-flex="2 months"
RECIPE_LATEST_RELEASE_DATE_pn-flex="2008/02/26"
RECIPE_MAINTAINER_pn-flex = "Nitin A Kamble <nitin.a.kamble@intel.com>"

RECIPE_STATUS_pn-fstests="yellow"  
RECIPE_NO_UPDATE_REASON_pn-fstest="svnr266 is poky default"
RECIPE_LATEST_VERSION_pn-fstests="0.0+svnr426"
RECIPE_NO_OF_PATCHES_pn-fstests="0"
RECIPE_MAINTAINER_pn-fstests = "Nitin A Kamble <nitin.a.kamble@intel.com>"

RECIPE_STATUS_pn-gdb="green" # upgraded
RECIPE_LATEST_VERSION_pn-gdb="7.1"
RECIPE_NO_OF_PATCHES_pn-gdb="8"
RECIPE_TIME_BETWEEN_LAST_TWO_RELEASES_pn-gdb="3 months"
RECIPE_LATEST_RELEASE_DATE_pn-gdb="2010/03/18"
RECIPE_MAINTAINER_pn-gdb = "Nitin A Kamble <nitin.a.kamble@intel.com>"

RECIPE_STATUS_pn-gtk-theme-torturer="green" # no update needed git tree
RECIPE_LATEST_VERSION_pn-gtk-theme-torturer="???"
RECIPE_NO_OF_PATCHES_pn-gtk-theme-torturer="0"
RECIPE_MAINTAINER_pn-gtk-theme-tourturer = "Nitin A Kamble <nitin.a.kamble@intel.com>"

RECIPE_STATUS_pn-intltool="green" # upgraded
RECIPE_LATEST_VERSION_pn-intltool="0.40.6"
RECIPE_NO_OF_PATCHES_pn-intltool="1"
RECIPE_TIME_BETWEEN_LAST_TWO_RELEASES_pn-intltool="5 months"
RECIPE_LATEST_RELEASE_DATE_pn-intltool="2009/03/14"
RECIPE_MAINTAINER_pn-intltool = "Nitin A Kamble <nitin.a.kamble@intel.com>"

RECIPE_STATUS_pn-libtool="green" # upgraded
RECIPE_LATEST_VERSION_pn-libtool="2.2.10"
RECIPE_NO_OF_PATCHES_pn-libtool="5"
RECIPE_TIME_BETWEEN_LAST_TWO_RELEASES_pn-libtool="7 months"
RECIPE_LATEST_RELEASE_DATE_pn-libtool="2010/06/09"
RECIPE_MAINTAINER_pn-libtool = "Nitin A Kamble <nitin.a.kamble@intel.com>"

RECIPE_STATUS_pn-linux-libc-headers="green" # upgraded
RECIPE_LATEST_VERSION_pn-linux-libc-headers="2.6.34"
RECIPE_NO_OF_PATCHES_pn-linux-libc-headers="1"
RECIPE_TIME_BETWEEN_LAST_TWO_RELEASES_pn-linux-libc-headers="3 months"
RECIPE_LATEST_RELEASE_DATE_pn-linux-libc-headers="2010/05/16"
RECIPE_MAINTAINER_pn-linux-libc-headers = "Nitin A Kamble <nitin.a.kamble@intel.com>"

RECIPE_STATUS_pn-lsof="green" # upgraded
RECIPE_LATEST_VERSION_pn-lsof="4.83"
RECIPE_NO_OF_PATCHES_pn-lsof="0"
RECIPE_TIME_BETWEEN_LAST_TWO_RELEASES_pn-lsof="10 months"
RECIPE_LATEST_RELEASE_DATE_pn-lsof="2010/01/18"
RECIPE_MAINTAINER_pn-lsof = "Nitin A Kamble <nitin.a.kamble@intel.com>"

RECIPE_STATUS_pn-make="green" # already at the latest version
RECIPE_LATEST_VERSION_pn-make="3.81"
RECIPE_NO_OF_PATCHES_pn-make="1"
RECIPE_TIME_BETWEEN_LAST_TWO_RELEASES_pn-make="42 months"
RECIPE_LATEST_RELEASE_DATE_pn-make="2006/04/01"
RECIPE_MAINTAINER_pn-make = "Nitin A Kamble <nitin.a.kamble@intel.com>"

RECIPE_STATUS_pn-run-postinsts="green" # all local code
RECIPE_LATEST_VERSION_pn-postinsts="1.0"
RECIPE_NO_OF_PATCHES_pn-postinsts="2"
RECIPE_TIME_BETWEEN_LAST_TWO_RELEASES_pn-postinsts="6 months"
RECIPE_LATEST_RELEASE_DATE_pn-postinsts="2008/05/20"
RECIPE_MAINTAINER_pn-postinsts = "Nitin A Kamble <nitin.a.kamble@intel.com>"

RECIPE_STATUS_pn-staging-linkage="green" # no code
RECIPE_LATEST_VERSION_pn-staging-linkage="1.0"
RECIPE_NO_OF_PATCHES_pn-staging-linkage="0"
RECIPE_TIME_BETWEEN_LAST_TWO_RELEASES_pn-staging-linkage="2 months"
RECIPE_LATEST_RELEASE_DATE_pn-staging-linkage="2009/11/19"
RECIPE_MAINTAINER_pn-staging-linkage = "Nitin A Kamble <nitin.a.kamble@intel.com>"

RECIPE_STATUS_pn-nasm="green" # upgraded
RECIPE_LATEST_VERSION_pn-nasm="2.07"
RECIPE_NO_OF_PATCHES_pn-nasm="0"
RECIPE_TIME_BETWEEN_LAST_TWO_RELEASES_pn-nasm="1 months"
RECIPE_LATEST_RELEASE_DATE_pn-nasm="2009/07/21"
RECIPE_MAINTAINER_pn-nasm = "Nitin A Kamble <nitin.a.kamble@intel.com>"

RECIPE_STATUS_pn-oprofile="green" # upgraded
RECIPE_LATEST_VERSION_pn-oprofile="0.9.6"
RECIPE_NO_OF_PATCHES_pn-oprofile="2"
RECIPE_TIME_BETWEEN_LAST_TWO_RELEASES_pn-oprofile="4 months"
RECIPE_LATEST_RELEASE_DATE_pn-oprofile="2009/11/24"

RECIPE_STATUS_pn-perl="red" # upgrade needed
RECIPE_LATEST_VERSION_pn-perl="5.12.1"
RECIPE_NO_OF_PATCHES_pn-perl="33"
RECIPE_TIME_BETWEEN_LAST_TWO_RELEASES_pn-perl="1 months"
RECIPE_LATEST_RELEASE_DATE_pn-perl="2010/05/16"
RECIPE_MAINTAINER_pn-perl = "Nitin A Kamble <nitin.a.kamble@intel.com>"

RECIPE_STATUS_pn-prelink="green" # upgraded
RECIPE_LATEST_VERSION_pn-prelink="1.0+git0+0x909470ee441237563d6236c505cb2d02ddc48704"
RECIPE_NO_OF_PATCHES_pn-prelink="3"
RECIPE_MAINTAINER_pn-prelink = "Nitin A Kamble <nitin.a.kamble@intel.com>"

RECIPE_STATUS_pn-python-dbus="green" # upgraded
RECIPE_LATEST_VERSION_pn-python-dbus="0.83.1"
RECIPE_NO_OF_PATCHES_pn-python-dbus="0"
RECIPE_TIME_BETWEEN_LAST_TWO_RELEASES_pn-python-dbus="19 months"
RECIPE_LATEST_RELEASE_DATE_pn-python-dbus="2010/02/18"
RECIPE_MAINTAINER_pn-python-dbus = "Nitin A Kamble <nitin.a.kamble@intel.com>"

RECIPE_STATUS_pn-python-gst="green" # upgraded
DISTRO_PN_ALIAS_pn-python-gst = "OpenSuSE=python-gstreamer Ubuntu=gst0.10-python Debian=gst0.10-python"
RECIPE_LATEST_VERSION_pn-python-gst="0.10.18"
RECIPE_NO_OF_PATCHES_pn-python-gst="1"
RECIPE_LATEST_RELEASE_DATE_pn-python-gst="2010/02/11"
RECIPE_TIME_BETWEEN_LAST_TWO_RELEASES_pn-python-gst="4 months"
RECIPE_MAINTAINER_pn-python-gst = "Nitin A Kamble <nitin.a.kamble@intel.com>"

RECIPE_STATUS_pn-python-imaging="green" # upgraded
RECIPE_LATEST_VERSION_pn-python-imaging="1.1.7"
RECIPE_NO_OF_PATCHES_pn-python-imaging="1"
RECIPE_LATEST_RELEASE_DATE_pn-python-imaging="2009/11/15"
RECIPE_TIME_BETWEEN_LAST_TWO_RELEASES_pn-python-imaging="37 months"
RECIPE_MAINTAINER_pnpython--imaging = "Nitin A Kamble <nitin.a.kamble@intel.com>"

RECIPE_STATUS_pn-python-iniparse="green" # upgraded
RECIPE_LATEST_VERSION_pn-python-iniparse="0.3.2"
RECIPE_NO_OF_PATCHES_pn-python-iniparse="0"
RECIPE_LATEST_RELEASE_DATE_pn-python-iniparse="2010/04/17"
RECIPE_TIME_BETWEEN_LAST_TWO_RELEASES_pn-python-iniparse="13 months"
RECIPE_MAINTAINER_pn-python-iniparse = "Nitin A Kamble <nitin.a.kamble@intel.com>"

RECIPE_STATUS_pn-python-pycurl="green" # already at the latest release
RECIPE_LATEST_VERSION_pn-python-pycurl="7.19.0"
RECIPE_NO_OF_PATCHES_pn-python-pycurl="1"
RECIPE_LATEST_RELEASE_DATE_pn-python-pycurl="2008/09/09"
RECIPE_TIME_BETWEEN_LAST_TWO_RELEASES_pn-python-pycurl="3 months"
RECIPE_MAINTAINER_pn-python-pycurl = "Nitin A Kamble <nitin.a.kamble@intel.com>"

RECIPE_STATUS_pn-python-pygobject="green" # upgraded
DISTRO_PN_ALIAS_pn-python-pygobject = "Meego=pygobject2 Fedora=pygobject2 Ubuntu=pygobject Debian=pygobject"
RECIPE_LATEST_VERSION_pn-python-pygobject="2.21.1"
RECIPE_NO_OF_PATCHES_pn-python-pygobject="1"
RECIPE_LATEST_RELEASE_DATE_pn-python-pygobject="2010/01/03"
RECIPE_TIME_BETWEEN_LAST_TWO_RELEASES_pn-python-pygobject="1 months"
RECIPE_MAINTAINER_pn-python-pygobject = "Nitin A Kamble <nitin.a.kamble@intel.com>"

RECIPE_STATUS_pn-python-pygtk="green" # upgraded
DISTRO_PN_ALIAS_pn-python-pygtk = "OpenSuSE=python-gtk"
RECIPE_LATEST_VERSION_pn-python-pygtk="2.17.0"
RECIPE_NO_OF_PATCHES_pn-python-pygtk="4"
RECIPE_LATEST_RELEASE_DATE_pn-python-pygtk="2009/12/26"
RECIPE_TIME_BETWEEN_LAST_TWO_RELEASES_pn-python-pygtk="4 months"
RECIPE_MAINTAINER_pn-python-pygtk = "Nitin A Kamble <nitin.a.kamble@intel.com>"

RECIPE_STATUS_pn-python-pyrex="green" # upgraded
RECIPE_LATEST_VERSION_pn-python-pyrex="0.9.9"
RECIPE_NO_OF_PATCHES_pn-python-pyrex="1"
RECIPE_LATEST_RELEASE_DATE_pn-python-pyrex="2010/04/12"
RECIPE_TIME_BETWEEN_LAST_TWO_RELEASES_pn-python-pyrex="23 months"
RECIPE_MAINTAINER_pn-python-pyrex = "Nitin A Kamble <nitin.a.kamble@intel.com>"

RECIPE_STATUS_pn-python-scons="green" # upgraded
DISTRO_PN_ALIAS_pn-python-scons = "Fedora=scons OpenSuSE=scons Ubuntu=scons Mandriva=scons Debian=scons"
RECIPE_LATEST_VERSION_pn-python-scons="1.3.0"
RECIPE_NO_OF_PATCHES_pn-python-scons="0"
RECIPE_LATEST_RELEASE_DATE_pn-python-scons="2010/06/06"
RECIPE_TIME_BETWEEN_LAST_TWO_RELEASES_pn-python-scons="3 months"
RECIPE_MAINTAINER_pn-python-scons = "Nitin A Kamble <nitin.a.kamble@intel.com>"

RECIPE_STATUS_pn-python-urlgrabber="green" # already @ the latest version
RECIPE_LATEST_VERSION_pn-python-urlgrabber="3.9.1"
RECIPE_NO_OF_PATCHES_pn-python-urlgrabber="2"
RECIPE_LATEST_RELEASE_DATE_pn-python-urlgrabber="2009/09/25"
RECIPE_TIME_BETWEEN_LAST_TWO_RELEASES_pn-python-urlgrabber="2 months"
RECIPE_MAINTAINER_pn-python-urlgrabber = "Nitin A Kamble <nitin.a.kamble@intel.com>"

RECIPE_STATUS_pn-python="green" # upgraded
DISTRO_PN_ALIAS_pn-python-gst = "OpenSuSE=python-gstreamer Ubuntu=gst0.10-python Debian=gst0.10-python"
RECIPE_LATEST_VERSION_pn-python="2.6.5"
RECIPE_NO_OF_PATCHES_pn-python="8"
RECIPE_LATEST_RELEASE_DATE_pn-python="2010/03/18"
RECIPE_TIME_BETWEEN_LAST_TWO_RELEASES_pn-python="5 months"
RECIPE_MAINTAINER_pn-python = "Nitin A Kamble <nitin.a.kamble@intel.com>"

RECIPE_STATUS_pn-yum-metadata-parser="green" # upgraded
RECIPE_LATEST_VERSION_pn-yum-metadata-parser="1.1.4"
RECIPE_NO_OF_PATCHES_pn-yum-metadata-parser="0"
RECIPE_LATEST_RELEASE_DATE_pn-yum-metadata-parser="2010/01/07"
RECIPE_TIME_BETWEEN_LAST_TWO_RELEASES_pn-yum-metadata-parser="5 months"
RECIPE_MAINTAINER_pn-yum-metadata-parser = "Nitin A Kamble <nitin.a.kamble@intel.com>"

RECIPE_STATUS_pn-quilt="green" # upgraded
RECIPE_LATEST_VERSION_pn-quilt="0.48"
RECIPE_NO_OF_PATCHES_pn-quilt="3"
RECIPE_LATEST_RELEASE_DATE_pn-quilt="2008/11/29"
RECIPE_TIME_BETWEEN_LAST_TWO_RELEASES_pn-quilt="3 months"
RECIPE_MAINTAINER_pn-quilt = "Nitin A Kamble <nitin.a.kamble@intel.com>"

RECIPE_STATUS_pn-tcl="green" # upgraded
RECIPE_LATEST_VERSION_pn-tcl="8.5.8"
RECIPE_NO_OF_PATCHES_pn-tcl="2"
RECIPE_LATEST_RELEASE_DATE_pn-tcl="2008/11/29"
RECIPE_TIME_BETWEEN_LAST_TWO_RELEASES_pn-tcl="3 months"
RECIPE_MAINTAINER_pn-tcl = "Nitin A Kamble <nitin.a.kamble@intel.com>"

RECIPE_STATUS_pn-unifdef="green" # poky local source files
RECIPE_LATEST_VERSION_pn-unifdef="2.6.18+git"
RECIPE_NO_OF_PATCHES_pn-unifdef="1"
RECIPE_LATEST_RELEASE_DATE_pn-unifdef="2009/06/03"
RECIPE_TIME_BETWEEN_LAST_TWO_RELEASES_pn-unifdef="27 months"
RECIPE_MAINTAINER_pn-unifdef = "Nitin A Kamble <nitin.a.kamble@intel.com>"

RECIPE_STATUS_pn-qmake2-cross="green" # upgraded
RECIPE_LATEST_VERSION_pn-qmake2-cross="2.10a"
RECIPE_NO_OF_PATCHES_pn-qmake2-cross="1"
RECIPE_LATEST_RELEASE_DATE_pn-qmake2-cross="2010/06/02"
RECIPE_TIME_BETWEEN_LAST_TWO_RELEASES_pn-qmake2-cross="4 months"
RECIPE_MAINTAINER_pn-qmake2-cross = "Nitin A Kamble <nitin.a.kamble@intel.com>"

RECIPE_STATUS_pn-gnu-config="green" # upgraded
RECIPE_LATEST_VERSION_pn-gnu-config="0.1+cvs20080123"
RECIPE_NO_OF_PATCHES_pn-gnu-config="4"
RECIPE_LATEST_RELEASE_DATE_pn-gnu-config="2008/01/23"
RECIPE_MAINTAINER_pn-gnu-config = "Nitin A Kamble <nitin.a.kamble@intel.com>"

RECIPE_STATUS_pn-mpfr="green" # upgraded
RECIPE_LATEST_VERSION_pn-mpfr="3.0.0"
RECIPE_NO_OF_PATCHES_pn-mpfr="0"
RECIPE_LATEST_RELEASE_DATE_pn-mpfr="2010/06/10"
RECIPE_MAINTAINER_pn-mpfr = "Nitin A Kamble <nitin.a.kamble@intel.com>"

RECIPE_STATUS_pn-gmp="green" # upgraded
RECIPE_LATEST_VERSION_pn-gmp="5.0.1"
RECIPE_NO_OF_PATCHES_pn-gmp="4"
RECIPE_LATEST_RELEASE_DATE_pn-gmp="2010/02/06"
RECIPE_TIME_BETWEEN_LAST_TWO_RELEASES_pn-gmp="1 month"
RECIPE_MAINTAINER_pn-gmp = "Nitin A Kamble <nitin.a.kamble@intel.com>"

RECIPE_STATUS_pn-libmpc="green" # upgraded
RECIPE_LATEST_VERSION_pn-libmpc="0.8.2"
RECIPE_MAINTAINER_pn-libmpc = "Nitin A Kamble <nitin.a.kamble@intel.com>"

RECIPE_STATUS_pn-byacc="green" 
RECIPE_LATEST_VERSION_pn-byacc="20100610"
RECIPE_MAINTAINER_pn-byacc = "Nitin A Kamble <nitin.a.kamble@intel.com>"

RECIPE_STATUS_pn-libconvert-asn1-perl="red" # 0.22 version does not build, so created a recipe for version 0.21
RECIPE_LATEST_VERSION_pn-libconvert-asn1-perl="0.22"
RECIPE_MAINTAINER_pn-libconvert-asn1-perl = "Nitin A Kamble <nitin.a.kamble@intel.com>"

RECIPE_STATUS_pn-libtimedate-perl="green" 
RECIPE_LATEST_VERSION_pn-libtimedate-perl="1.20"
RECIPE_MAINTAINER_pn-ilibtimedate-perl = "Nitin A Kamble <nitin.a.kamble@intel.com>"

RECIPE_STATUS_pn-libxml-parser-perl="green" 
RECIPE_LATEST_VERSION_pn-libxml-parser-perl="2.36"
RECIPE_MAINTAINER_pn-libxml-parser-perl = "Nitin A Kamble <nitin.a.kamble@intel.com>"
```

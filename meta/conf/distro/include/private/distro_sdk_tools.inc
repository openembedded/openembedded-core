## meta/conf/distro/include/sane-srcdates.inc
```bitbake
# Lock down some SRCDATEs, see http://svn.o-hand.com/view/poky/trunk/openembedded/conf/distro/poky.conf for the original version 

# Kernel modules
SRCDATE_at76c503a-modules ?= "20060814"
SRCDATE_prism54-module ?= "20060814"

# X11 libs, extentions and protos
SRCDATE_compositeext ?= "20060814"
SRCDATE_drm ?= "20060814"
SRCDATE_drm-kernel ?= "20060814"
SRCDATE_fixesext ?= "20060814"
SRCDATE_libxext-native ?= "20060814"
SRCDATE_libxss ?= "20060814"
SRCDATE_recordext ?= "20060814"
SRCDATE_renderext ?= "20060814"
SRCDATE_calibrateproto ?= "20070802"
SRCDATE_libxcalibrate ?= "20070802"
SRCDATE_xxf86dgaext ?= "20060814"
SRCDATE_xxf86vmext ?= "20060814"

# Matchbox / O-hand
SRCDATE_contacts ?= "20060707"
SRCDATE_dates ?= "20060707"
SRCDATE_fstests ?= "20061122"
SRCDATE_eds-dbus ?= "20070704"
SRCDATE_libmatchbox ?= "20060612"
SRCDATE_libfakekey ?= "20051101"
SRCDATE_matchbox-common ?= "20060612"
SRCDATE_matchbox-config-gtk ?= "20060612"
SRCDATE_matchbox-desktop ?= "20060612"
SRCDATE_matchbox-keyboard ?= "20070816"
SRCDATE_matchbox-panel ?= "20060612"
SRCDATE_matchbox-panel-manager ?= "20060612"
SRCDATE_matchbox-stroke ?= "20060612"
SRCDATE_matchbox-themes-extra ?= "20060612"
SRCDATE_matchbox-wm ?= "20060612"
SRCDATE_libmatchbox ?= "20060612"
SRCDATE_libfakekey ?= "20051101"
SRCDATE_psplash ?= "20070330"
SRCDATE_web ?= "20060613"
SRCDATE_zaurusd ?= "20060628"

# GPE
SRCDATE_dasher-gpe  ?= "20060814"
SRCDATE_rosetta ?= "20060804"
SRCDATE_gpesyncd ?= "20070701"

# GNOME
SRCDATE_gconf-dbus ?= "20070512"
SRCDATE_gnome-vfs ?= "20060119"
SRCDATE_gtkhtml2 ?= "20060323"

# Enlightenment Foundation Libraries
# Caution: This is not alphabetically, but (roughly) dependency-sorted.
# Please leave it like that.
EFL_SRCDATE = "20070819"
SRCDATE_edb-native ?= "${EFL_SRCDATE}"
SRCDATE_edb ?= "${EFL_SRCDATE}"
SRCDATE_eet-native ?= "${EFL_SRCDATE}"
SRCDATE_eet ?= "${EFL_SRCDATE}"
SRCDATE_evas-native ?= "${EFL_SRCDATE}"
SRCDATE_evas ?= "${EFL_SRCDATE}"
SRCDATE_ecore-native ?= "${EFL_SRCDATE}"
SRCDATE_ecore ?= "${EFL_SRCDATE}"
SRCDATE_edbus ?= "${EFL_SRCDATE}"
SRCDATE_embryo-native ?= "${EFL_SRCDATE}"
SRCDATE_embryo ?= "${EFL_SRCDATE}"
SRCDATE_edje-native ?= "${EFL_SRCDATE}"
SRCDATE_edje ?= "${EFL_SRCDATE}"
SRCDATE_emotion ?= "${EFL_SRCDATE}"
SRCDATE_etk-native ?= "${EFL_SRCDATE}"
SRCDATE_etk ?= "${EFL_SRCDATE}"
SRCDATE_ewl ?= "${EFL_SRCDATE}"
SRCDATE_epeg ?= "${EFL_SRCDATE}"
SRCDATE_epsilon ?= "${EFL_SRCDATE}"
SRCDATE_epdf ?= "${EFL_SRCDATE}"
SRCDATE_esmart ?= "${EFL_SRCDATE}"
SRCDATE_efreet ?= "${EFL_SRCDATE}"
SRCDATE_exml ?= "${EFL_SRCDATE}"
SRCDATE_enhance ?= "${EFL_SRCDATE}"
SRCDATE_engrave ?= "${EFL_SRCDATE}"
SRCDATE_evolve-native ?= "${EFL_SRCDATE}"
SRCDATE_evolve ?= "${EFL_SRCDATE}"
SRCDATE_gevas2 ?= "${EFL_SRCDATE}"

# Enlightenment Bindings
SRCDATE_eflpp ?= "${EFL_SRCDATE}"
SRCDATE_python-evas ?= "${EFL_SRCDATE}"
SRCDATE_python-ecore ?= "${EFL_SRCDATE}"
SRCDATE_python-edje ?= "${EFL_SRCDATE}"
SRCDATE_python-ewl ?= "${EFL_SRCDATE}"
SRCDATE_python-etk ?= "${EFL_SRCDATE}"

# Enlightenment Applications
SRCDATE_edje-viewer ?= "${EFL_SRCDATE}"
SRCDATE_edje-editor ?= "${EFL_SRCDATE}"
SRCDATE_emphasis ?= "${EFL_SRCDATE}"
SRCDATE_ephoto ?= "${EFL_SRCDATE}"
SRCDATE_examine ?= "${EFL_SRCDATE}"
SRCDATE_exhibit ?= "${EFL_SRCDATE}"
SRCDATE_expedite ?= "${EFL_SRCDATE}"
SRCDATE_elitaire ?= "${EFL_SRCDATE}"
SRCDATE_entice ?= "${EFL_SRCDATE}"
SRCDATE_e-utils ?= "${EFL_SRCDATE}"
SRCDATE_enna ?= "${EFL_SRCDATE}"

# Misc packages, sorted by alphabet
SRCDATE_avetanabt ?= "20060814"
SRCDATE_bl ?= "20060814"
SRCDATE_dvbstream ?= "20060814"
SRCDATE_dvbtraffic ?= "20060814"
SRCDATE_dvbtune ?= "20060814"
SRCDATE_fdclock ?= "20060814"
SRCDATE_fltk ?= "20060814"
SRCDATE_ipatience ?= "20061112" 
SRCDATE_ipkg-link ?= "20050930"
SRCDATE_ipkg-link-1 ?= "20050930"
SRCDATE_ipkg-utils ?= "20050930"
SRCDATE_ipkg-utils-native ?= "20050930"
SRCDATE_kaffe-qt ?= "20060814"
SRCDATE_kbdd ?= "20061019"
SRCDATE_led ?= "20060814"
SRCDATE_linux-input ?= "20060814"
SRCDATE_madwifi-modules ?= "20060814"
SRCDATE_maemo-mapper-nohildon ?= "20061114"
SRCDATE_mileage ?= "20060814"
SRCDATE_minimo ?= "20050401"
SRCDATE_mpd ?= "20070210"
SRCDATE_mystun-server ?= "20060814"
SRCDATE_olsrd ?= "20060814"
SRCDATE_opencvs ?= "20060814"
SRCDATE_oprofile ?= "20061011"
SRCDATE_portaudio ?= "20060814"
SRCDATE_putty ?= "20060814"
SRCDATE_python-cairo ?= "20060814"
SRCDATE_qemu-native ?= "20070613"
SRCDATE_roadster ?= "20060814"
SRCDATE_sctzap ?= "20060814"
SRCDATE_tslib ?= "20051101"
SRCDATE_waimea ?= "20060814"
SRCDATE_xcompmgr ?= "20060814"
SRCDATE_xirssi ?= "20060814"
SRCDATE_xsvg ?= "20060814"
SRCDATE_yamonenv ?= "20060814"
SRCDATE_zroadmap ?= "20060814"

# Freedesktop.org
SRCDATE_poppler0.6 = "20070708"
```

## meta/conf/distro/include/security_flags.inc
```bitbake
SECURITY_CFLAGS ?= "-fstack-protector-all -pie -fpie -D_FORTIFY_SOURCE=2"
SECURITY_NO_PIE_CFLAGS ?= "-fstack-protector-all -D_FORTIFY_SOURCE=2"
SECURITY_LDFLAGS ?= "-Wl,-z,relro,-z,now"

SECURITY_CFLAGS_pn-aspell = "${SECURITY_NO_PIE_CFLAGS}"
SECURITY_CFLAGS_pn-beecrypt = "${SECURITY_NO_PIE_CFLAGS}"
# Curl seems to check for FORTIFY_SOURCE in CFLAGS, but even assigned
# to CPPFLAGS it gets picked into CFLAGS in bitbake.
#TARGET_CPPFLAGS_pn-curl += "-D_FORTIFY_SOURCE=2"
SECURITY_CFLAGS_pn-curl = "-fstack-protector-all -pie -fpie"
SECURITY_CFLAGS_pn-directfb = "${SECURITY_NO_PIE_CFLAGS}"
SECURITY_CFLAGS_pn-eglibc = ""
SECURITY_CFLAGS_pn-eglibc-initial = ""
SECURITY_CFLAGS_pn-enchant = "${SECURITY_NO_PIE_CFLAGS}"
SECURITY_CFLAGS_pn-flac = "${SECURITY_NO_PIE_CFLAGS}"
SECURITY_CFLAGS_pn-gcc-runtime = "${SECURITY_NO_PIE_CFLAGS}"
SECURITY_CFLAGS_pn-gdb = "${SECURITY_NO_PIE_CFLAGS}"
SECURITY_CFLAGS_pn-gmp = "${SECURITY_NO_PIE_CFLAGS}"
SECURITY_CFLAGS_pn-gnutls = "${SECURITY_NO_PIE_CFLAGS}"
SECURITY_CFLAGS_pn-grub = ""
SECURITY_CFLAGS_pn-gst-plugins-bad = "${SECURITY_NO_PIE_CFLAGS}"
SECURITY_CFLAGS_pn-gst-plugins-gl = "${SECURITY_NO_PIE_CFLAGS}"
SECURITY_CFLAGS_pn-gstreamer1.0-plugins-good = "${SECURITY_NO_PIE_CFLAGS}"
SECURITY_CFLAGS_pn-harfbuzz = "${SECURITY_NO_PIE_CFLAGS}"
SECURITY_CFLAGS_pn-kexec-tools = "${SECURITY_NO_PIE_CFLAGS}"
SECURITY_CFLAGS_pn-libcap = "${SECURITY_NO_PIE_CFLAGS}"
SECURITY_CFLAGS_pn-libgcc = "${SECURITY_NO_PIE_CFLAGS}"
SECURITY_CFLAGS_pn-libglu = "${SECURITY_NO_PIE_CFLAGS}"
SECURITY_CFLAGS_pn-libpcre = "${SECURITY_NO_PIE_CFLAGS}"
SECURITY_CFLAGS_pn-mesa = "${SECURITY_NO_PIE_CFLAGS}"
SECURITY_CFLAGS_pn-mesa-gl = "${SECURITY_NO_PIE_CFLAGS}"
SECURITY_CFLAGS_pn-opensp = "${SECURITY_NO_PIE_CFLAGS}"
SECURITY_CFLAGS_pn-ppp = "${SECURITY_NO_PIE_CFLAGS}"
SECURITY_CFLAGS_pn-python = "${SECURITY_NO_PIE_CFLAGS}"
SECURITY_CFLAGS_pn-python-imaging = "${SECURITY_NO_PIE_CFLAGS}"
SECURITY_CFLAGS_pn-python-pycurl = "${SECURITY_NO_PIE_CFLAGS}"
SECURITY_CFLAGS_pn-python-smartpm = "${SECURITY_NO_PIE_CFLAGS}"
SECURITY_CFLAGS_pn-tcl = "${SECURITY_NO_PIE_CFLAGS}"
SECURITY_CFLAGS_pn-tiff = "${SECURITY_NO_PIE_CFLAGS}"
SECURITY_CFLAGS_pn-webkit-gtk = "${SECURITY_NO_PIE_CFLAGS}"
SECURITY_CFLAGS_pn-zlib = "${SECURITY_NO_PIE_CFLAGS}"

# These 2 have text relco errors with the pie options enabled
SECURITY_CFLAGS_pn-ltp = "${SECURITY_NO_PIE_CFLAGS}"
SECURITY_CFLAGS_pn-pulseaudio = "${SECURITY_NO_PIE_CFLAGS}"

TARGET_CFLAGS_append = " ${SECURITY_CFLAGS}"
TARGET_LDFLAGS_append = " ${SECURITY_LDFLAGS}"
```

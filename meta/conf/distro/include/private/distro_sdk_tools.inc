## meta/conf/distro/include/private/distro_x11_core.inc
```bitbake
#
# distro tracking filed for X core packages
#

RECIPE_STATUS_pn-bigreqsproto="green" # no update needed
RECIPE_LATEST_VERSION_pn-bigreqsproto="1.1.0"
RECIPE_NO_OF_PATCHES_pn-bigreqsproto="0"
RECIPE_TIME_BETWEEN_LAST_TWO_RELEASES_pn-bigreqsproto="3 years"
RECIPE_LATEST_RELEASE_DATE_pn-bigreqsproto="2009/08/26"
RECIPE_INTEL_SECTION_pn-bigreqsproto="graphic core"
RECIPE_MAINTAINER_pn-bigreqsproto="Yu Ke <ke.yu@intel.com>"

RECIPE_STATUS_pn-evieext="green" # no update needed
RECIPE_LATEST_VERSION_pn-evieext="1.1.0"
RECIPE_NO_OF_PATCHES_pn-evieext="0"
RECIPE_TIME_BETWEEN_LAST_TWO_RELEASES_pn-evieext="3 years"
RECIPE_LATEST_RELEASE_DATE_pn-evieext="2009/08/26"
RECIPE_INTEL_SECTION_pn-evieext="graphic core"
RECIPE_MAINTAINER_pn-evieext="Yu Ke <ke.yu@intel.com>"

RECIPE_STATUS_pn-libxxf86dga="green" # no update needed
RECIPE_LATEST_VERSION_pn-libxxf86dga="1.1.1"
RECIPE_NO_OF_PATCHES_pn-libxxf86dga="0"
RECIPE_TIME_BETWEEN_LAST_TWO_RELEASES_pn-libxxf86dga="1 month"
RECIPE_LATEST_RELEASE_DATE_pn-libxxf86dga="2009/10/06"
RECIPE_INTEL_SECTION_pn-libxxf86dga="graphic core"
RECIPE_MAINTAINER_pn-libxxf86dga="Yu Ke <ke.yu@intel.com>"

RECIPE_STATUS_pn-x11-common="green" # no update needed
RECIPE_LATEST_VERSION_pn-x11-common="0.1"
RECIPE_NO_OF_PATCHES_pn-x11-common="0"
RECIPE_TIME_BETWEEN_LAST_TWO_RELEASES_pn-x11-common="n/a" # local file without release
RECIPE_LATEST_RELEASE_DATE_pn-x11-common="2008/09/22" # per poky git log
RECIPE_INTEL_SECTION_pn-x11-common="graphic core"
RECIPE_MAINTAINER_pn-x11-common="Yu Ke <ke.yu@intel.com>"

RECIPE_STATUS_pn-xf86-input-keyboard="green" # no update needed
RECIPE_LATEST_VERSION_pn-xf86-input-keyboard="1.4.0"
RECIPE_NO_OF_PATCHES_pn-xf86-input-keyboard="0"
RECIPE_TIME_BETWEEN_LAST_TWO_RELEASES_pn-xf86-input-keyboard="9 monthes"
RECIPE_LATEST_RELEASE_DATE_pn-xf86-input-keyboard="2009/10/07"
RECIPE_INTEL_SECTION_pn-xf86-input-keyboard="graphic core"
RECIPE_MAINTAINER_pn-xf86-input-keyboard="Yu Ke <ke.yu@intel.com>"

RECIPE_STATUS_pn-xf86-input-mouse="green" # no update needed
RECIPE_LATEST_VERSION_pn-xf86-input-mouse="1.5.0"
RECIPE_NO_OF_PATCHES_pn-xf86-input-mouse="0"
RECIPE_TIME_BETWEEN_LAST_TWO_RELEASES_pn-xf86-input-mouse="9 monthes"
RECIPE_LATEST_RELEASE_DATE_pn-xf86-input-mouse="2009/10/06"
RECIPE_INTEL_SECTION_pn-xf86-input-mouse="graphic core"
RECIPE_MAINTAINER_pn-xf86-input-mouse="Yu Ke <ke.yu@intel.com>"

RECIPE_STATUS_pn-xf86-input-vmmouse="red" # update needed
RECIPE_LATEST_VERSION_pn-xf86-input-vmmouse="12.6.9"
RECIPE_NO_OF_PATCHES_pn-xf86-input-vmmouse="0"
RECIPE_TIME_BETWEEN_LAST_TWO_RELEASES_pn-xf86-input-vmmouse="1 month"
RECIPE_LATEST_RELEASE_DATE_pn-xf86-input-vmmouse="2010/04/08"
RECIPE_INTEL_SECTION_pn-xf86-input-vmmouse="graphic core"
RECIPE_MAINTAINER_pn-xf86-input-vmmouse="Yu Ke <ke.yu@intel.com>"

RECIPE_STATUS_pn-libdrm="green" # no update needed
RECIPE_LATEST_VERSION_pn-libdrm="2.4.21"
RECIPE_NO_OF_PATCHES_pn-libdrm="1"
RECIPE_TIME_BETWEEN_LAST_TWO_RELEASES_pn-libdrm="1 month"
RECIPE_LATEST_RELEASE_DATE_pn-libdrm="2010/06/10"
RECIPE_INTEL_SECTION_pn-libdrm="graphic core"
RECIPE_MAINTAINER_pn-libdrm="Yu Ke <ke.yu@intel.com>"

RECIPE_STATUS_pn-python-pycairo="green" # no upgrade needed
RECIPE_LATEST_VERSION_pn-python-pycairo="1.8.10"
RECIPE_NO_OF_PATCHES_pn-python-pycairo="0"
RECIPE_LATEST_RELEASE_DATE_pn-python-pycairo="2010/05/20"
RECIPE_TIME_BETWEEN_LAST_TWO_RELEASES_pn-python-pycairo="9 months"
RECIPE_INTEL_SECTION_pn-python-pycairo="graphic core"
RECIPE_MAINTAINER_pn-python-pycairo="Yu Ke <ke.yu@intel.com>"

RECIPE_STATUS_pn-libxfontcache="green" # no update neededd
RECIPE_LATEST_VERSION_pn-libxfontcache="1.0.5"
RECIPE_NO_OF_PATCHES_pn-libxfontcache="0"
RECIPE_TIME_BETWEEN_LAST_TWO_RELEASES_pn-libxfontcache="3 years"
RECIPE_LATEST_RELEASE_DATE_pn-libxfontcache="2009/10/08"
RECIPE_INTEL_SECTION_pn-libxfontcache="graphic core"
RECIPE_MAINTAINER_pn-libxfontcache="Yu Ke <ke.yu@intel.com>"

RECIPE_STATUS_pn-xf86-input-evdev="green" # no update needed
RECIPE_LATEST_VERSION_pn-xf86-input-evdev="2.4.0"
RECIPE_NO_OF_PATCHES_pn-xf86-input-evdev="0"
RECIPE_TIME_BETWEEN_LAST_TWO_RELEASES_pn-xf86-input-evdev="1 monthes"
RECIPE_LATEST_RELEASE_DATE_pn-xf86-input-evdev="2010/04/06"
RECIPE_INTEL_SECTION_pn-xf86-input-evdev="graphic core"
RECIPE_MAINTAINER_pn-xf86-input-evdev="Yu Ke <ke.yu@intel.com>"

RECIPE_STATUS_pn-xf86-video-vmware="green" # no update needed
RECIPE_LATEST_VERSION_pn-xf86-video-vmware="11.0.1"
RECIPE_NO_OF_PATCHES_pn-xf86-video-vmware="0"
RECIPE_TIME_BETWEEN_LAST_TWO_RELEASES_pn-xf86-video-vmware="2 monthes"
RECIPE_LATEST_RELEASE_DATE_pn-xf86-video-vmware="2010/03/18"
RECIPE_INTEL_SECTION_pn-xf86-video-vmware="graphic core"
RECIPE_MAINTAINER_pn-xf86-video-vmware="Yu Ke <ke.yu@intel.com>"

RECIPE_STATUS_pn-cairo="green" # no update needed
RECIPE_LATEST_VERSION_pn-cairo="1.9.10" # OK
RECIPE_NO_OF_PATCHES_pn-cairo="1"
RECIPE_TIME_BETWEEN_LAST_TWO_RELEASES_pn-cairo="1 monthes"
RECIPE_LATEST_RELEASE_DATE_pn-cairo="2010/02/20"
RECIPE_INTEL_SECTION_pn-cairo="graphic core"
RECIPE_MAINTAINER_pn-cairo="Yu Ke <ke.yu@intel.com>"

RECIPE_STATUS_pn-xserver-nodm-init="green" # no update needed
RECIPE_LATEST_VERSION_pn-xserver-nodm-init="1.0"
RECIPE_NO_OF_PATCHES_pn-xserver-nodm-init="0"
#RECIPE_TIME_BETWEEN_LAST_TWO_RELEASES_pn-xserver-nodm-init=""
#RECIPE_LATEST_RELEASE_DATE_pn-xserver-nodm-init=""
RECIPE_INTEL_SECTION_pn-xserver-nodm-init="graphic core"
RECIPE_MAINTAINER_pn-xserver-nodm-init="Yu Ke <ke.yu@intel.com>"

RECIPE_STATUS_pn-xserver-xf86-config="green" # no update needed
RECIPE_LATEST_VERSION_pn-xserver-xf86-config="0.1"
RECIPE_NO_OF_PATCHES_pn-xserver-xf86-config="0"
#RECIPE_TIME_BETWEEN_LAST_TWO_RELEASES_pn-xserver-xf86-config=""
#RECIPE_LATEST_RELEASE_DATE_pn-xserver-xf86-config=""
RECIPE_INTEL_SECTION_pn-xserver-xf86-config="graphic core"
RECIPE_MAINTAINER_pn-xserver-xf86-config="Yu Ke <ke.yu@intel.com>"

RECIPE_STATUS_pn-pango="green" # no update needed
RECIPE_LATEST_VERSION_pn-pango="1.28.0"
RECIPE_NO_OF_PATCHES_pn-pango="1"
RECIPE_TIME_BETWEEN_LAST_TWO_RELEASES_pn-pango="1 month"
RECIPE_LATEST_RELEASE_DATE_pn-pango="2010/03/10"
RECIPE_INTEL_SECTION_pn-pango="graphic core"
RECIPE_MAINTAINER_pn-pango="Yu Ke <ke.yu@intel.com>"

RECIPE_STATUS_pn-mesa-dri="green" # no update needed
RECIPE_LATEST_VERSION_pn-mesa-dri="7.8.2"
RECIPE_NO_OF_PATCHES_pn-mesa-dri="1"
RECIPE_TIME_BETWEEN_LAST_TWO_RELEASES_pn-mesa-dri="2 monthes"
RECIPE_LATEST_RELEASE_DATE_pn-mesa-dri="2010/06/17"
RECIPE_INTEL_SECTION_pn-mesa-dri="graphic core"
RECIPE_MAINTAINER_pn-mesa-dri="Yu Ke <ke.yu@intel.com>"

RECIPE_STATUS_pn-mesa-xlib="green" # no update needed
RECIPE_LATEST_VERSION_pn-mesa-xlib="7.8.2"
RECIPE_NO_OF_PATCHES_pn-mesa-xlib="0"
RECIPE_TIME_BETWEEN_LAST_TWO_RELEASES_pn-mesa-xlib="2 monthes"
RECIPE_LATEST_RELEASE_DATE_pn-mesa-xlib="2010/06/17"
RECIPE_INTEL_SECTION_pn-mesa-xlib="graphic core"
RECIPE_MAINTAINER_pn-mesa-xlib="Yu Ke <ke.yu@intel.com>"

RECIPE_STATUS_pn-xserver-xf86-dri-lite="green" # no update needed
RECIPE_LATEST_VERSION_pn-xserver-xf86-dri-lite="1.8.99.904"
RECIPE_NO_OF_PATCHES_pn-xserver-xf86-dri-lite="2"
RECIPE_TIME_BETWEEN_LAST_TWO_RELEASES_pn-xserver-xf86-dri-lite="2 monthes"
RECIPE_LATEST_RELEASE_DATE_pn-xserver-xf86-dri-lite="2010/07/01"
RECIPE_INTEL_SECTION_pn-xserver-xf86-dri-lite="graphic core"
RECIPE_MAINTAINER_pn-xserver-xf86-dri-lite="Yu Ke <ke.yu@intel.com>"

RECIPE_STATUS_pn-xbitmaps = "red"
RECIPE_LATEST_VERSION_pn-xbitmaps = "1.1.0"
RECIPE_MAINTAINER_pn-xbitmaps = "Ke Yu <ke.yu@intel.com>"

RECIPE_STATUS_pn-xf86-input-synaptics = "red"
RECIPE_LATEST_VERSION_pn-xf86-input-synaptics = "1.2.2"
RECIPE_MAINTAINER_pn-xf86-input-synaptics = "Ke Yu <ke.yu@intel.com>"

RECIPE_STATUS_pn-xf86-video-intel = "red"
RECIPE_LATEST_VERSION_pn-xf86-video-intel = "2.11.0"
RECIPE_MAINTAINER_pn-xf86-video-intel = "Ke Yu <ke.yu@intel.com>"

RECIPE_STATUS_pn-xf86-video-omapfb = "red"
RECIPE_LATEST_VERSION_pn-xf86-video-omapfb = "0.1.1+git_db636c8436265c3d86"
RECIPE_MAINTAINER_pn-xf86-video-omapfb = "Ke Yu <ke.yu@intel.com>"

RECIPE_STATUS_pn-xorg-cf-files = "red"
RECIPE_LATEST_VERSION_pn-xorg-cf-files = "1.0.3"
RECIPE_MAINTAINER_pn-xorg-cf-files = "Ke Yu <ke.yu@intel.com>"
```

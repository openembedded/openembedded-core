## meta/conf/distro/include/private/distro_sdk_tools.inc
```bitbake
RECIPE_STATUS_pn-oprofileui = "green"
DISTRO_PN_ALIAS_pn-oprofileui = "Fedora=oprofileui Ubuntu=oprofile-gui Debian=oprofile-gui"
DEPENDENCY_CHECK_pn-oprofileui = "not done"
RECIPE_LATEST_VERSION_pn-oprofileui = "0.0+svnr197"
RECIPE_NO_OF_PATCHES_pn-oprofileui = "0"
RECIPE_INTEL_SECTION_pn-oprofileui = "sdk-tools"
RECIPE_TIME_BETWEEN_LAST_TWO_RELEASES_pn-oprofileui = "13 days"
RECIPE_LATEST_RELEASE_DATE_pn-oprofileui = "07/2008"
RECIPE_COMMENTS_pn-oprofileui = ""
RECIPE_MAINTAINER_pn-oprofileui = "Dexuan Cui <dexuan.cui@intel.com>"

RECIPE_STATUS_pn-powertop = "green"
DISTRO_PN_ALIAS_pn-powertop ="Meego=powertop Fedora=powertop Debian=powertop OpenSuSE=powertop Mandriva=powertop"
DEPENDENCY_CHECK_pn-powertop = "not done"
RECIPE_LATEST_VERSION_pn-powertop = "1.13"
RECIPE_NO_OF_PATCHES_pn-powertop = "1"
RECIPE_PATCH_pn-powertop+stub_out_the_ncurses_calls_in_dump_mode = "stub out the ncurses calls in dump mode; this fixes a segfault"
RECIPE_INTEL_SECTION_pn-powertop = "sdk-tools"
RECIPE_TIME_BETWEEN_LAST_TWO_RELEASES_pn-powertop = "11 months"
RECIPE_LATEST_RELEASE_DATE_pn-powertop = "07/2010"
RECIPE_COMMENTS_pn-powertop = ""
RECIPE_MAINTAINER_pn-powertop = "Dexuan Cui <dexuan.cui@intel.com>"

RECIPE_STATUS_pn-latencytop = "green"
DISTRO_PN_ALIAS_pn-latencytop = "Meego=latencytop Fedora=latencytop Debian=latencytop OpenSuSE=latencytop"
DEPENDENCY_CHECK_pn-latencytop = "not done"
RECIPE_LATEST_VERSION_pn-latencytop = "0.5"
RECIPE_NO_OF_PATCHES_pn-latencytop = "1"
RECIPE_PATCH_pn-latencytop+latencytop-makefile = "-lncursesw ==> -lncurses; gcc ==> CC ?= gcc, and use $(CC); install:mkdir -p $(DESTDIR)/$(SBINDIR)"
RECIPE_INTEL_SECTION_pn-latencytop = "sdk-tools"
RECIPE_TIME_BETWEEN_LAST_TWO_RELEASES_pn-latencytop = "1 year"
RECIPE_LATEST_RELEASE_DATE_pn-latencytop = "04/2009"
RECIPE_COMMENTS_pn-latencytop = ""
RECIPE_MAINTAINER_pn-latencytop = "Dexuan Cui <dexuan.cui@intel.com>"

RECIPE_STATUS_pn-tcf-agent = "green"
DISTRO_PN_ALIAS_pn-tcf-agent = ""
DEPENDENCY_CHECK_pn-tcf-agent = "not done"
RECIPE_LATEST_VERSION_pn-tcf-agent = "0.3.0+svnr1078"
RECIPE_NO_OF_PATCHES_pn-tcf-agent = "2"
RECIPE_PATCH_pn-tcf-agent+terminals_agent = "we might get the patch from git://git.pokylinux.org/eclipse-poky.git in future"
RECIPE_PATCH_pn-tcf-agent+fix_tcf-agent.init = "a proper script /etc/init.d/tcf-agent"
RECIPE_INTEL_SECTION_pn-tcf-agent = "sdk-tools"
RECIPE_TIME_BETWEEN_LAST_TWO_RELEASES_pn-tcf-agent = "1+ years"
RECIPE_LATEST_RELEASE_DATE_pn-tcf-agent = "07/2010"
RECIPE_COMMENTS_pn-tcf-agent = ""
RECIPE_MAINTAINER_pn-tcf-agent = "Dexuan Cui <dexuan.cui@intel.com>"

RECIPE_STATUS_pn-liburcu = "green"
DISTRO_PN_ALIAS_pn-liburcu = ""
DEPENDENCY_CHECK_pn-liburcu = "not done"
RECIPE_LATEST_VERSION_pn-liburcu = "0.4.6"
RECIPE_NO_OF_PATCHES_pn-liburcu = "0"
RECIPE_INTEL_SECTION_pn-liburcu = "libs"
RECIPE_TIME_BETWEEN_LAST_TWO_RELEASES_pn-liburcu = "10 minutes"
RECIPE_LATEST_RELEASE_DATE_pn-liburcu = "06/2010"
RECIPE_COMMENTS_pn-liburcu = ""
RECIPE_MAINTAINER_pn-liburcu = "Dexuan Cui <dexuan.cui@intel.com>"

RECIPE_STATUS_pn-lttng-ust = "green"
DISTRO_PN_ALIAS_pn-lttng-ust = ""
DEPENDENCY_CHECK_pn-lttng-ust = "not done"
RECIPE_LATEST_VERSION_pn-lttng-ust = "0.7"
RECIPE_NO_OF_PATCHES_pn-lttng-ust = "0"
RECIPE_INTEL_SECTION_pn-lttng-ust = "sdk-tools"
RECIPE_TIME_BETWEEN_LAST_TWO_RELEASES_pn-lttng-ust = "4 days"
RECIPE_LATEST_RELEASE_DATE_pn-lttng-ust = "Aug 20, 2010"
RECIPE_COMMENTS_pn-lttng-ust = ""
RECIPE_MAINTAINER_pn-lttng-ust = "Dexuan Cui <dexuan.cui@intel.com>"

RECIPE_STATUS_pn-lttng-control = "green"
DISTRO_PN_ALIAS_pn-lttng-control = ""
DEPENDENCY_CHECK_pn-lttng-control = "not done"
RECIPE_LATEST_VERSION_pn-lttng-control = "0.87"
RECIPE_NO_OF_PATCHES_pn-lttng-control = "0"
RECIPE_INTEL_SECTION_pn-lttng-control = "sdk-tools"
RECIPE_TIME_BETWEEN_LAST_TWO_RELEASES_pn-lttng-control = "1 month"
RECIPE_LATEST_RELEASE_DATE_pn-lttng-control = "06/2010"
RECIPE_COMMENTS_pn-lttng-control = ""
RECIPE_MAINTAINER_pn-lttng-control = "Dexuan Cui <dexuan.cui@intel.com>"

RECIPE_STATUS_pn-lttng-viewer = "green"
DISTRO_PN_ALIAS_pn-lttng-viewer = ""
DEPENDENCY_CHECK_pn-lttng-viewer = "not done"
RECIPE_LATEST_VERSION_pn-lttng-viewer = "0.12.35"
RECIPE_NO_OF_PATCHES_pn-lttng-viewer = "0"
RECIPE_INTEL_SECTION_pn-lttng-viewer = "sdk-tools"
RECIPE_TIME_BETWEEN_LAST_TWO_RELEASES_pn-lttng-viewer = "6 days"
RECIPE_LATEST_RELEASE_DATE_pn-lttng-viewer = "Aug 20, 2010"
RECIPE_COMMENTS_pn-lttng-viewer = ""
RECIPE_MAINTAINER_pn-lttng-viewer = "Dexuan Cui <dexuan.cui@intel.com>"
```

## meta/conf/distro/include/private/distro_x11_ux.inc
```bitbake
#
# distro tracking fields for X11 UX
#

RECIPE_STATUS_pn-gnome-mime-data = "green" # no update needed
DEPENDENCY_CHECK_pn-gnome-mime-data = "not done"
RECIPE_LATEST_VERSION_pn-gnome-mime-data = "2.18.0"
RECIPE_NO_OF_PATCHES_pn-gnome-mime-data = "1"
RECIPE_INTEL_SECTION_pn-gnome-mime-data = "graphic UX"
RECIPE_TIME_BETWEEN_LAST_TWO_RELEASES_pn-gnome-mime-data = "5 months"
RECIPE_LATEST_RELEASE_DATE_pn-gnome-mime-data = "04/2007"
RECIPE_COMMENTS_pn-gnome-mime-data = ""
RECIPE_MAINTAINER_pn-gnome-mime-data = "Zhai Edwin <edwin.zhai@intel.com>"

RECIPE_STATUS_pn-libmatchbox = "green" # no update needed
DEPENDENCY_CHECK_pn-libmatchbox = "not done"
RECIPE_LATEST_VERSION_pn-libmatchbox = "1.9"
RECIPE_NO_OF_PATCHES_pn-libmatchbox = "2"
RECIPE_INTEL_SECTION_pn-libmatchbox = "graphic UX"
RECIPE_TIME_BETWEEN_LAST_TWO_RELEASES_pn-libmatchbox = "5 months"
RECIPE_LATEST_RELEASE_DATE_pn-libmatchbox = "08/2006"
RECIPE_COMMENTS_pn-libmatchbox = ""
RECIPE_MAINTAINER_pn-libmatchbox = "Zhai Edwin <edwin.zhai@intel.com>"

RECIPE_STATUS_pn-libowl = "green" # no update needed
DEPENDENCY_CHECK_pn-libowl = "not done"
RECIPE_LATEST_VERSION_pn-libowl = "0.0+svnr408"
RECIPE_NO_OF_PATCHES_pn-libowl = "0"
RECIPE_INTEL_SECTION_pn-libowl = "graphic UX"
RECIPE_TIME_BETWEEN_LAST_TWO_RELEASES_pn-libowl = "n/a"
RECIPE_LATEST_RELEASE_DATE_pn-libowl = "09/2008"
RECIPE_COMMENTS_pn-libowl = ""
RECIPE_MAINTAINER_pn-libowl = "Zhai Edwin <edwin.zhai@intel.com>"

RECIPE_STATUS_pn-libowl-av = "green" # no update needed
DEPENDENCY_CHECK_pn-libowl-av = "not done"
RECIPE_LATEST_VERSION_pn-libowl-av = "0.0+svnr398"
RECIPE_NO_OF_PATCHES_pn-libowl-av = "0"
RECIPE_INTEL_SECTION_pn-libowl-av = "graphic UX"
RECIPE_TIME_BETWEEN_LAST_TWO_RELEASES_pn-libowl-av = "n/a"
RECIPE_LATEST_RELEASE_DATE_pn-libowl-av = "12/2008"
RECIPE_COMMENTS_pn-libowl-av = ""
RECIPE_MAINTAINER_pn-libowl-av = "Zhai Edwin <edwin.zhai@intel.com>"

RECIPE_STATUS_pn-matchbox-desktop = "green" # no update needed
DEPENDENCY_CHECK_pn-matchbox-desktop = "not done"
RECIPE_LATEST_VERSION_pn-matchbox-desktop = "2.0+svnr2096"
RECIPE_NO_OF_PATCHES_pn-matchbox-desktop = "0"
RECIPE_INTEL_SECTION_pn-matchbox-desktop = "graphic UX"
RECIPE_TIME_BETWEEN_LAST_TWO_RELEASES_pn-matchbox-desktop = "n/a"
RECIPE_LATEST_RELEASE_DATE_pn-matchbox-desktop = "12/2008"
RECIPE_COMMENTS_pn-matchbox-desktop = ""
RECIPE_MAINTAINER_pn-matchbox-desktop = "Zhai Edwin <edwin.zhai@intel.com>"

RECIPE_STATUS_pn-matchbox-desktop-sato = "green" # no update needed
DEPENDENCY_CHECK_pn-matchbox-desktop-sato = "not done"
RECIPE_LATEST_VERSION_pn-matchbox-desktop-sato = "0.0+svnr76"
RECIPE_NO_OF_PATCHES_pn-matchbox-desktop-sato = "0"
RECIPE_INTEL_SECTION_pn-matchbox-desktop-sato = "graphic UX"
RECIPE_TIME_BETWEEN_LAST_TWO_RELEASES_pn-matchbox-desktop-sato = "n/a"
RECIPE_LATEST_RELEASE_DATE_pn-matchbox-desktop-sato = "07/2007"
RECIPE_COMMENTS_pn-matchbox-desktop-sato = ""
RECIPE_MAINTAINER_pn-matchbox-desktop-sato = "Zhai Edwin <edwin.zhai@intel.com>"

RECIPE_STATUS_pn-matchbox-session = "green" # no update needed
DEPENDENCY_CHECK_pn-matchbox-session = "not done"
RECIPE_LATEST_VERSION_pn-matchbox-session = "0.1"
RECIPE_NO_OF_PATCHES_pn-matchbox-session = "0"
RECIPE_INTEL_SECTION_pn-matchbox-session = "graphic UX"
RECIPE_TIME_BETWEEN_LAST_TWO_RELEASES_pn-matchbox-session = "n/a"
RECIPE_LATEST_RELEASE_DATE_pn-matchbox-session = "02/2004"
RECIPE_COMMENTS_pn-matchbox-session = ""
RECIPE_MAINTAINER_pn-matchbox-session = "Zhai Edwin <edwin.zhai@intel.com>"

RECIPE_STATUS_pn-matchbox-session-sato = "green" # no update needed
DEPENDENCY_CHECK_pn-matchbox-session-sato = "not done"
RECIPE_LATEST_VERSION_pn-matchbox-session-sato = "0.1"
RECIPE_NO_OF_PATCHES_pn-matchbox-session-sato = "0"
RECIPE_INTEL_SECTION_pn-matchbox-session-sato = "graphic UX"
RECIPE_TIME_BETWEEN_LAST_TWO_RELEASES_pn-matchbox-session-sato = "n/a"
RECIPE_LATEST_RELEASE_DATE_pn-matchbox-session-sato = "06/2007"
RECIPE_COMMENTS_pn-matchbox-session-sato = ""
RECIPE_MAINTAINER_pn-matchbox-session-sato = "Zhai Edwin <edwin.zhai@intel.com>"

RECIPE_STATUS_pn-matchbox-terminal = "green" # no update needed
DEPENDENCY_CHECK_pn-matchbox-terminal = "not done"
RECIPE_LATEST_VERSION_pn-matchbox-terminal = "0.0+svnr1816"
RECIPE_NO_OF_PATCHES_pn-matchbox-terminal = "0"
RECIPE_INTEL_SECTION_pn-matchbox-terminal = "graphic UX"
RECIPE_TIME_BETWEEN_LAST_TWO_RELEASES_pn-matchbox-terminal = "n/a"
RECIPE_LATEST_RELEASE_DATE_pn-matchbox-terminal = "11/2007"
RECIPE_COMMENTS_pn-matchbox-terminal = ""
RECIPE_MAINTAINER_pn-matchbox-terminal = "Zhai Edwin <edwin.zhai@intel.com>"

RECIPE_STATUS_pn-matchbox-theme-sato = "green" # no update needed
DEPENDENCY_CHECK_pn-matchbox-theme-sato = "not done"
RECIPE_LATEST_VERSION_pn-matchbox-theme-sato = "0.1"
RECIPE_NO_OF_PATCHES_pn-matchbox-theme-sato = "0"
RECIPE_INTEL_SECTION_pn-matchbox-theme-sato = "graphic UX"
RECIPE_TIME_BETWEEN_LAST_TWO_RELEASES_pn-matchbox-theme-sato = "n/a"
RECIPE_LATEST_RELEASE_DATE_pn-matchbox-theme-sato = "07/2007"
RECIPE_COMMENTS_pn-matchbox-theme-sato = ""
RECIPE_MAINTAINER_pn-matchbox-theme-sato = "Zhai Edwin <edwin.zhai@intel.com>"

RECIPE_STATUS_pn-sato-icon-theme = "green" # no update needed
DEPENDENCY_CHECK_pn-sato-icon-theme = "not done"
RECIPE_LATEST_VERSION_pn-sato-icon-theme = "0.4.1"
RECIPE_NO_OF_PATCHES_pn-sato-icon-theme = "0"
RECIPE_INTEL_SECTION_pn-sato-icon-theme = "graphic UX"
RECIPE_TIME_BETWEEN_LAST_TWO_RELEASES_pn-sato-icon-theme = "n/a"
RECIPE_LATEST_RELEASE_DATE_pn-sato-icon-theme = "02/2008"
RECIPE_COMMENTS_pn-sato-icon-theme = ""
RECIPE_MAINTAINER_pn-sato-icon-theme = "Zhai Edwin <edwin.zhai@intel.com>"

RECIPE_STATUS_pn-tslib = "green" # no update needed
DEPENDENCY_CHECK_pn-tslib = "not done"
RECIPE_LATEST_VERSION_pn-tslib = "1.0"
RECIPE_NO_OF_PATCHES_pn-tslib = "3"
RECIPE_INTEL_SECTION_pn-tslib = "graphic UX"
RECIPE_TIME_BETWEEN_LAST_TWO_RELEASES_pn-tslib = "n/a"
RECIPE_LATEST_RELEASE_DATE_pn-tslib = "08/2006"
RECIPE_COMMENTS_pn-tslib = ""
RECIPE_MAINTAINER_pn-tslib = "Zhai Edwin <edwin.zhai@intel.com>"

RECIPE_STATUS_pn-xcursor-transparent-theme = "green" # no update needed
DEPENDENCY_CHECK_pn-xcursor-transparent-theme = "not done"
RECIPE_LATEST_VERSION_pn-xcursor-transparent-theme = "0.1.1"
RECIPE_NO_OF_PATCHES_pn-xcursor-transparent-theme = "2"
RECIPE_INTEL_SECTION_pn-xcursor-transparent-theme = "graphic UX"
RECIPE_TIME_BETWEEN_LAST_TWO_RELEASES_pn-xcursor-transparent-theme = "n/a"
RECIPE_LATEST_RELEASE_DATE_pn-xcursor-transparent-theme = "12/2004"
RECIPE_COMMENTS_pn-xcursor-transparent-theme = ""
RECIPE_MAINTAINER_pn-xcursor-transparent-theme = "Zhai Edwin <edwin.zhai@intel.com>"

RECIPE_STATUS_pn-screenshot = "green"
DEPENDENCY_CHECK_pn-screenshot = "not done"
RECIPE_LATEST_VERSION_pn-screenshot = "0.0+svnr292"
RECIPE_NO_OF_PATCHES_pn-screenshot = "0"
RECIPE_INTEL_SECTION_pn-screenshot = "graphic UX"
RECIPE_TIME_BETWEEN_LAST_TWO_RELEASES_pn-screenshot = "n/a"
RECIPE_LATEST_RELEASE_DATE_pn-screenshot = "09/2007"
RECIPE_COMMENTS_pn-screenshot = ""
RECIPE_MAINTAINER_pn-screenshot = "Zhai Edwin <edwin.zhai@intel.com>"

RECIPE_STATUS_pn-tasks = "green"
DEPENDENCY_CHECK_pn-tasks = "not done"
RECIPE_LATEST_VERSION_pn-tasks = "0.16"
RECIPE_NO_OF_PATCHES_pn-tasks = "1"
RECIPE_INTEL_SECTION_pn-tasks = "graphic UX"
RECIPE_TIME_BETWEEN_LAST_TWO_RELEASES_pn-tasks = "4 months"
RECIPE_LATEST_RELEASE_DATE_pn-tasks = "07/2009"
RECIPE_COMMENTS_pn-tasks = ""
RECIPE_MAINTAINER_pn-tasks = "Zhai Edwin <edwin.zhai@intel.com>"

RECIPE_STATUS_pn-contacts = "green"
DEPENDENCY_CHECK_pn-contacts = "not done"
RECIPE_LATEST_VERSION_pn-contacts = "0.12+git0+19853893fdb595de6aa59db0d9dc2f9451ed2933"
RECIPE_NO_OF_PATCHES_pn-contacts = "1"
RECIPE_INTEL_SECTION_pn-contacts = "graphic UX"
RECIPE_TIME_BETWEEN_LAST_TWO_RELEASES_pn-contacts = "n/a"
RECIPE_LATEST_RELEASE_DATE_pn-contacts = "11/2009"
RECIPE_COMMENTS_pn-contacts = ""
RECIPE_MAINTAINER_pn-contacts = "Zhai Edwin <edwin.zhai@intel.com>"

RECIPE_STATUS_pn-dates = "green"
DEPENDENCY_CHECK_pn-dates = "not done"
RECIPE_LATEST_VERSION_pn-dates = "0.4.11+git0+514185dc1f6588085fda41eb59898b93d0487dd4"
RECIPE_NO_OF_PATCHES_pn-dates = "1"
RECIPE_INTEL_SECTION_pn-dates = "graphic UX"
RECIPE_TIME_BETWEEN_LAST_TWO_RELEASES_pn-dates = "1 month"
RECIPE_LATEST_RELEASE_DATE_pn-dates = "10/2009"
RECIPE_COMMENTS_pn-dates = ""
RECIPE_MAINTAINER_pn-dates = "Zhai Edwin <edwin.zhai@intel.com>"

RECIPE_STATUS_pn-libcroco = "green"
DEPENDENCY_CHECK_pn-libcroco = "not done"
RECIPE_LATEST_VERSION_pn-libcroco = "0.6.2"
RECIPE_NO_OF_PATCHES_pn-libcroco = "1"
RECIPE_INTEL_SECTION_pn-libcroco = "graphic UX"
RECIPE_TIME_BETWEEN_LAST_TWO_RELEASES_pn-libcroco = "35 months"
RECIPE_LATEST_RELEASE_DATE_pn-libcroco = "02/2009"
RECIPE_COMMENTS_pn-libcroco = ""
RECIPE_MAINTAINER_pn-libcroco = "Zhai Edwin <edwin.zhai@intel.com>"

RECIPE_STATUS_pn-leafpad = "green"
DEPENDENCY_CHECK_pn-leafpad = "not done"
RECIPE_LATEST_VERSION_pn-leafpad = "0.8.17"
RECIPE_NO_OF_PATCHES_pn-leafpad = "1"
RECIPE_INTEL_SECTION_pn-leafpad = "graphic UX"
RECIPE_TIME_BETWEEN_LAST_TWO_RELEASES_pn-leafpad = "10 months"
RECIPE_LATEST_RELEASE_DATE_pn-leafpad = "10/2009"
RECIPE_COMMENTS_pn-leafpad = ""
RECIPE_MAINTAINER_pn-leafpad = "Zhai Edwin <edwin.zhai@intel.com>"

RECIPE_STATUS_pn-atk = "green"
DEPENDENCY_CHECK_pn-atk = "not done"
RECIPE_LATEST_VERSION_pn-atk = "1.30.0"
RECIPE_NO_OF_PATCHES_pn-atk = "0"
RECIPE_INTEL_SECTION_pn-atk = "graphic UX"
RECIPE_TIME_BETWEEN_LAST_TWO_RELEASES_pn-atk = "1 month"
RECIPE_LATEST_RELEASE_DATE_pn-atk = "03/2010"
RECIPE_COMMENTS_pn-atk = ""
RECIPE_MAINTAINER_pn-atk = "Zhai Edwin <edwin.zhai@intel.com>"

RECIPE_STATUS_pn-gtk+ = "green"
DEPENDENCY_CHECK_pn-gtk+ = "not done"
RECIPE_LATEST_VERSION_pn-gtk+ = "2.20.1"
RECIPE_NO_OF_PATCHES_pn-gtk+ = "0"
RECIPE_INTEL_SECTION_pn-gtk+ = "graphic UX"
RECIPE_TIME_BETWEEN_LAST_TWO_RELEASES_pn-gtk+ = "2 months"
RECIPE_LATEST_RELEASE_DATE_pn-gtk+ = "05/2010"
RECIPE_COMMENTS_pn-gtk+ = ""
RECIPE_MAINTAINER_pn-gtk+ = "Zhai Edwin <edwin.zhai@intel.com>"

RECIPE_STATUS_pn-gnome-common = "green"
DEPENDENCY_CHECK_pn-gnome-common = "not done"
RECIPE_LATEST_VERSION_pn-gnome-common = "2.28.0"
RECIPE_NO_OF_PATCHES_pn-gnome-common = "0"
RECIPE_INTEL_SECTION_pn-gnome-common = "graphic UX"
RECIPE_TIME_BETWEEN_LAST_TWO_RELEASES_pn-gnome-common = "6 months"
RECIPE_LATEST_RELEASE_DATE_pn-gnome-common = "09/2009"
RECIPE_COMMENTS_pn-gnome-common = ""
RECIPE_MAINTAINER_pn-gnome-common = "Zhai Edwin <edwin.zhai@intel.com>"

RECIPE_STATUS_pn-webkit-gtk = "green"
DEPENDENCY_CHECK_pn-webkit-gtk = "not done"
RECIPE_LATEST_VERSION_pn-webkit-gtk = "1.3.2+svnr62027"
RECIPE_NO_OF_PATCHES_pn-webkit-gtk = "0"
RECIPE_INTEL_SECTION_pn-webkit-gtk = "graphic UX"
RECIPE_TIME_BETWEEN_LAST_TWO_RELEASES_pn-webkit-gtk = "1 month"
RECIPE_LATEST_RELEASE_DATE_pn-webkit-gtk = "06/2010"
RECIPE_COMMENTS_pn-webkit-gtk = ""
RECIPE_MAINTAINER_pn-webkit-gtk = "Zhai Edwin <edwin.zhai@intel.com>"

RECIPE_STATUS_pn-eds-dbus = "green"
DEPENDENCY_CHECK_pn-eds-dbus = "not done"
RECIPE_LATEST_VERSION_pn-eds-dbus = "2.31.4"
RECIPE_NO_UPDATE_REASON_pn-eds-dbus = "2.30.2 is latest stable release, while 2.31 branch acts as development branch."
RECIPE_NO_OF_PATCHES_pn-eds-dbus = "0"
RECIPE_INTEL_SECTION_pn-eds-dbus = "graphic UX"
RECIPE_TIME_BETWEEN_LAST_TWO_RELEASES_pn-eds-dbus = "1 month"
RECIPE_LATEST_RELEASE_DATE_pn-eds-dbus = "06/2010"
RECIPE_COMMENTS_pn-eds-dbus = "Update to 2.30.2 because of stability and dependency"
RECIPE_MAINTAINER_pn-eds-dbus = "Zhai Edwin <edwin.zhai@intel.com>"

RECIPE_STATUS_pn-gnome-keyring = "green"
DEPENDENCY_CHECK_pn-gnome-keyring = "not done"
RECIPE_LATEST_VERSION_pn-gnome-keyring = "2.31.4"
RECIPE_NO_OF_PATCHES_pn-gnome-keyring = "0"
RECIPE_INTEL_SECTION_pn-gnome-keyring = "graphic UX"
RECIPE_TIME_BETWEEN_LAST_TWO_RELEASES_pn-gnome-keyring = "1 month"
RECIPE_LATEST_RELEASE_DATE_pn-gnome-keyring = "06/2010"
RECIPE_COMMENTS_pn-gnome-keyring = ""
RECIPE_MAINTAINER_pn-gnome-keyring = "Zhai Edwin <edwin.zhai@intel.com>"

RECIPE_STATUS_pn-gtk-sato-engine = "green"
DEPENDENCY_CHECK_pn-gtk-sato-engine = "not done"
RECIPE_LATEST_VERSION_pn-gtk-sato-engine = "0.3.2+svnr163"
RECIPE_NO_OF_PATCHES_pn-gtk-sato-engine = "0"
RECIPE_INTEL_SECTION_pn-gtk-sato-engine = "graphic UX"
RECIPE_TIME_BETWEEN_LAST_TWO_RELEASES_pn-gtk-sato-engine = "n/a"
RECIPE_LATEST_RELEASE_DATE_pn-gtk-sato-engine = "02/2008"
RECIPE_COMMENTS_pn-gtk-sato-engine = ""
RECIPE_MAINTAINER_pn-gtk-sato-engine = "Zhai Edwin <edwin.zhai@intel.com>"

RECIPE_STATUS_pn-hicolor-icon-theme = "green"
DEPENDENCY_CHECK_pn-hicolor-icon-theme = "not done"
RECIPE_LATEST_VERSION_pn-hicolor-icon-theme = "0.12"
RECIPE_NO_OF_PATCHES_pn-hicolor-icon-theme = "0"
RECIPE_INTEL_SECTION_pn-hicolor-icon-theme = "graphic UX"
RECIPE_TIME_BETWEEN_LAST_TWO_RELEASES_pn-hicolor-icon-theme = "4 months"
RECIPE_LATEST_RELEASE_DATE_pn-hicolor-icon-theme = "09/2009"
RECIPE_COMMENTS_pn-hicolor-icon-theme = ""
RECIPE_MAINTAINER_pn-hicolor-icon-theme = "Zhai Edwin <edwin.zhai@intel.com>"

RECIPE_STATUS_pn-jpeg = "green"
DEPENDENCY_CHECK_pn-jpeg = "not done"
RECIPE_LATEST_VERSION_pn-jpeg = "8b"
RECIPE_NO_OF_PATCHES_pn-jpeg = "0"
RECIPE_INTEL_SECTION_pn-jpeg = "graphic UX"
RECIPE_TIME_BETWEEN_LAST_TWO_RELEASES_pn-jpeg = "12 months"
RECIPE_LATEST_RELEASE_DATE_pn-jpeg = "05/2010"
RECIPE_COMMENTS_pn-jpeg = ""
RECIPE_MAINTAINER_pn-jpeg = "Zhai Edwin <edwin.zhai@intel.com>"

RECIPE_STATUS_pn-libfakekey = "green" # no update needed
DEPENDENCY_CHECK_pn-libfakekey = "not done"
RECIPE_LATEST_VERSION_pn-libfakekey = "0.0+svnr2031"
RECIPE_NO_OF_PATCHES_pn-libfakekey = "0"
RECIPE_INTEL_SECTION_pn-libfakekey = "graphic UX"
RECIPE_TIME_BETWEEN_LAST_TWO_RELEASES_pn-libfakekey = "n/a"
RECIPE_LATEST_RELEASE_DATE_pn-libfakekey = "07/2006"
RECIPE_COMMENTS_pn-libfakekey = ""
RECIPE_MAINTAINER_pn-libfakekey = "Zhai Edwin <edwin.zhai@intel.com>"

RECIPE_STATUS_pn-libglade = "green"
DEPENDENCY_CHECK_pn-libglade = "not done"
RECIPE_LATEST_VERSION_pn-libglade = "2.6.4"
RECIPE_NO_OF_PATCHES_pn-libglade = "0"
RECIPE_INTEL_SECTION_pn-libglade = "graphic UX"
RECIPE_TIME_BETWEEN_LAST_TWO_RELEASES_pn-libglade = "7 months"
RECIPE_LATEST_RELEASE_DATE_pn-libglade = "03/2009"
RECIPE_COMMENTS_pn-libglade = ""
RECIPE_MAINTAINER_pn-libglade = "Zhai Edwin <edwin.zhai@intel.com>"

RECIPE_STATUS_pn-libsoup-2.4 = "green"
DEPENDENCY_CHECK_pn-libsoup-2.4 = "not done"
RECIPE_LATEST_VERSION_pn-libsoup-2.4 = "2.31.2"
RECIPE_NO_OF_PATCHES_pn-libsoup-2.4 = "0"
RECIPE_INTEL_SECTION_pn-libsoup-2.4 = "graphic UX"
RECIPE_TIME_BETWEEN_LAST_TWO_RELEASES_pn-libsoup-2.4 = "1 month"
RECIPE_LATEST_RELEASE_DATE_pn-libsoup-2.4 = "05/2010"
RECIPE_COMMENTS_pn-libsoup-2.4 = ""
RECIPE_MAINTAINER_pn-libsoup-2.4 = "Zhai Edwin <edwin.zhai@intel.com>"

RECIPE_STATUS_pn-libxslt = "green"
DEPENDENCY_CHECK_pn-libxslt = "not done"
RECIPE_LATEST_VERSION_pn-libxslt = "1.1.26"
RECIPE_NO_OF_PATCHES_pn-libxslt = "0"
RECIPE_INTEL_SECTION_pn-libxslt = "graphic UX"
RECIPE_TIME_BETWEEN_LAST_TWO_RELEASES_pn-libxslt = "1 month"
RECIPE_LATEST_RELEASE_DATE_pn-libxslt = "09/2009"
RECIPE_COMMENTS_pn-libxslt = ""
RECIPE_MAINTAINER_pn-libxslt = "Zhai Edwin <edwin.zhai@intel.com>"

RECIPE_STATUS_pn-matchbox-config-gtk = "green"
DEPENDENCY_CHECK_pn-matchbox-config-gtk = "not done"
RECIPE_LATEST_VERSION_pn-matchbox-config-gtk = "0.0+svnr2081"
RECIPE_NO_OF_PATCHES_pn-matchbox-config-gtk = "0"
RECIPE_INTEL_SECTION_pn-matchbox-config-gtk = "graphic UX"
RECIPE_TIME_BETWEEN_LAST_TWO_RELEASES_pn-matchbox-config-gtk = "n/a"
RECIPE_LATEST_RELEASE_DATE_pn-matchbox-config-gtk = "09/2008"
RECIPE_COMMENTS_pn-matchbox-config-gtk = ""
RECIPE_MAINTAINER_pn-matchbox-config-gtk = "Zhai Edwin <edwin.zhai@intel.com>"

RECIPE_STATUS_pn-matchbox-keyboard = "green"
DEPENDENCY_CHECK_pn-matchbox-keyboard = "not done"
RECIPE_LATEST_VERSION_pn-matchbox-keyboard = "0.0+svnr2075"
RECIPE_NO_OF_PATCHES_pn-matchbox-keyboard = "0"
RECIPE_INTEL_SECTION_pn-matchbox-keyboard = "graphic UX"
RECIPE_TIME_BETWEEN_LAST_TWO_RELEASES_pn-matchbox-keyboard = "n/a"
RECIPE_LATEST_RELEASE_DATE_pn-matchbox-keyboard = "09/2008"
RECIPE_COMMENTS_pn-matchbox-keyboard = ""
RECIPE_MAINTAINER_pn-matchbox-keyboard = "Zhai Edwin <edwin.zhai@intel.com>"

RECIPE_STATUS_pn-matchbox-panel-2 = "green"
DEPENDENCY_CHECK_pn-matchbox-panel-2 = "not done"
RECIPE_LATEST_VERSION_pn-matchbox-panel-2 = "0.0+svnr2109"
RECIPE_NO_OF_PATCHES_pn-matchbox-panel-2 = "0"
RECIPE_INTEL_SECTION_pn-matchbox-panel-2 = "graphic UX"
RECIPE_TIME_BETWEEN_LAST_TWO_RELEASES_pn-matchbox-panel-2 = "n/a"
RECIPE_LATEST_RELEASE_DATE_pn-matchbox-panel-2 = "04/2010"
RECIPE_COMMENTS_pn-matchbox-panel-2 = ""
RECIPE_MAINTAINER_pn-matchbox-panel-2 = "Zhai Edwin <edwin.zhai@intel.com>"

RECIPE_STATUS_pn-matchbox-stroke = "green"
DEPENDENCY_CHECK_pn-matchbox-stroke = "not done"
RECIPE_LATEST_VERSION_pn-matchbox-stroke = "0.0+svnr1820"
RECIPE_NO_OF_PATCHES_pn-matchbox-stroke = "0"
RECIPE_INTEL_SECTION_pn-matchbox-stroke = "graphic UX"
RECIPE_TIME_BETWEEN_LAST_TWO_RELEASES_pn-matchbox-stroke = "n/a"
RECIPE_LATEST_RELEASE_DATE_pn-matchbox-stroke = "11/2007"
RECIPE_COMMENTS_pn-matchbox-stroke = ""
RECIPE_MAINTAINER_pn-matchbox-stroke = "Zhai Edwin <edwin.zhai@intel.com>"

RECIPE_STATUS_pn-matchbox-wm = "green"
DEPENDENCY_CHECK_pn-matchbox-wm = "not done"
RECIPE_LATEST_VERSION_pn-matchbox-wm = "1.2+svnr1819"
RECIPE_NO_OF_PATCHES_pn-matchbox-wm = "0"
RECIPE_INTEL_SECTION_pn-matchbox-wm = "graphic UX"
RECIPE_TIME_BETWEEN_LAST_TWO_RELEASES_pn-matchbox-wm = "n/a"
RECIPE_LATEST_RELEASE_DATE_pn-matchbox-wm = "11/2007"
RECIPE_COMMENTS_pn-matchbox-wm = ""
RECIPE_MAINTAINER_pn-matchbox-wm = "Zhai Edwin <edwin.zhai@intel.com>"

RECIPE_STATUS_pn-pointercal = "green"
DEPENDENCY_CHECK_pn-pointercal = "not done"
RECIPE_LATEST_VERSION_pn-pointercal = "0.0"
RECIPE_NO_OF_PATCHES_pn-pointercal = "0"
RECIPE_INTEL_SECTION_pn-pointercal = "graphic UX"
RECIPE_TIME_BETWEEN_LAST_TWO_RELEASES_pn-pointercal = "n/a"
RECIPE_LATEST_RELEASE_DATE_pn-pointercal = "n/a"
RECIPE_COMMENTS_pn-pointercal = "Just a data file"
RECIPE_MAINTAINER_pn-pointercal = "Zhai Edwin <edwin.zhai@intel.com>"

RECIPE_STATUS_pn-libgnome-keyring = "green"
DEPENDENCY_CHECK_pn-libgnome-keyring = "not done"
RECIPE_LATEST_VERSION_pn-libgnome-keyring = "2.30.1"
RECIPE_NO_OF_PATCHES_pn-libgnome-keyring = "0"
RECIPE_INTEL_SECTION_pn-libgnome-keyring = "graphic UX"
RECIPE_TIME_BETWEEN_LAST_TWO_RELEASES_pn-libgnome-keyring = "1 month"
RECIPE_LATEST_RELEASE_DATE_pn-libgnome-keyring = "04/2010"
RECIPE_COMMENTS_pn-libgnome-keyring = "New recipe separated from gnome-keyring"
RECIPE_MAINTAINER_pn-libgnome-keyring = "Zhai Edwin <edwin.zhai@intel.com>"

RECIPE_STATUS_pn-web-webkit = "green"
DEPENDENCY_CHECK_pn-web-webkit = "not done"
RECIPE_LATEST_VERSION_pn-web-webkit = "0.0+svnr110"
RECIPE_NO_OF_PATCHES_pn-web-webkit = "1"
RECIPE_INTEL_SECTION_pn-web-webkit = "graphic UX"
RECIPE_TIME_BETWEEN_LAST_TWO_RELEASES_pn-web-webkit = "n/a"
RECIPE_LATEST_RELEASE_DATE_pn-web-webkit = "08/2008"
RECIPE_COMMENTS_pn-web-webkit = ""
RECIPE_MAINTAINER_pn-web-webkit = "Zhai Edwin <edwin.zhai@intel.com>"

RECIPE_STATUS_pn-libfm = "green"
DEPENDENCY_CHECK_pn-libfm = "not done"
RECIPE_LATEST_VERSION_pn-libfm = "0.1.12"
RECIPE_NO_OF_PATCHES_pn-libfm = "0"
RECIPE_INTEL_SECTION_pn-libfm = "graphic UX"
RECIPE_TIME_BETWEEN_LAST_TWO_RELEASES_pn-libfm = "1 month"
RECIPE_LATEST_RELEASE_DATE_pn-libfm = "05/2010"
RECIPE_COMMENTS_pn-libfm = "Add as required when updating pcmanfm"
RECIPE_MAINTAINER_pn-libfm = "Zhai Edwin <edwin.zhai@intel.com>"

RECIPE_STATUS_pn-menu-cache = "green"
DEPENDENCY_CHECK_pn-menu-cache = "not done"
RECIPE_LATEST_VERSION_pn-menu-cache = "0.3.2"
RECIPE_NO_OF_PATCHES_pn-menu-cache = "0"
RECIPE_INTEL_SECTION_pn-menu-cache = "graphic UX"
RECIPE_TIME_BETWEEN_LAST_TWO_RELEASES_pn-menu-cache = "1 month"
RECIPE_LATEST_RELEASE_DATE_pn-menu-cache = "02/2010"
RECIPE_COMMENTS_pn-menu-cache = "Add as required when adding libfm"
RECIPE_MAINTAINER_pn-menu-cache = "Zhai Edwin <edwin.zhai@intel.com>"


RECIPE_STATUS_pn-gtk-engines = "red"
RECIPE_LATEST_VERSION_pn-gtk-engines = "2.18"
RECIPE_MAINTAINER_pn-gtk-engines = "Edwin Zhai <edwin.zhai@intel.com>"

RECIPE_STATUS_pn-clutter-imcontext = "red"
RECIPE_LATEST_VERSION_pn-clutter-imcontext = "0.1.6"
RECIPE_MAINTAINER_pn-clutter-imcontext = "Edwin Zhai <edwin.zhai@intel.com>"

RECIPE_STATUS_pn-clutter-box2d = "red"
RECIPE_LATEST_VERSION_pn-clutter-box2d = "0.10.0"
RECIPE_MAINTAINER_pn-clutter-box2d = "Edwin Zhai <edwin.zhai@intel.com>"

RECIPE_STATUS_pn-clutter-gtk-0.10 = "red"
RECIPE_LATEST_VERSION_pn-clutter-gtk-0.10 = "0.10.4"
RECIPE_MAINTAINER_pn-clutter-gtk-0.10 = "Edwin Zhai <edwin.zhai@intel.com>"

RECIPE_STATUS_pn-clutter-gtk-1.0 = "red"
RECIPE_LATEST_VERSION_pn-clutter-gtk-1.0 = "0.10.4"
RECIPE_MAINTAINER_pn-clutter-gtk-1.0 = "Edwin Zhai <edwin.zhai@intel.com>"

RECIPE_STATUS_pn-clutter-mozembed = "red"
RECIPE_LATEST_VERSION_pn-clutter-mozembed = "0.10.5"
RECIPE_MAINTAINER_pn-clutter-mozembed = "Edwin Zhai <edwin.zhai@intel.com>"

RECIPE_STATUS_pn-tidy = "red"
RECIPE_LATEST_VERSION_pn-tidy = "0.1.0"
RECIPE_MAINTAINER_pn-tidy = "Edwin Zhai <edwin.zhai@intel.com>"

RECIPE_STATUS_pn-libcanberra = "red"
RECIPE_LATEST_VERSION_pn-libcanberra = "0.24"
RECIPE_MAINTAINER_pn-libcanberra = "Edwin Zhai <edwin.zhai@intel.com>"

RECIPE_STATUS_pn-libgalago = "red"
RECIPE_LATEST_VERSION_pn-libgalago = "0.5.2"
RECIPE_MAINTAINER_pn-libgalago = "Edwin Zhai <edwin.zhai@intel.com>"

RECIPE_STATUS_pn-clutter-cairo-0.6 = "red"
RECIPE_LATEST_VERSION_pn-clutter-cairo-0.6 = "0.6"
RECIPE_MAINTAINER_pn-clutter-cairo-0.6 = "Edwin Zhai <edwin.zhai@intel.com>"

RECIPE_STATUS_pn-clutter-0.6 = "red"
RECIPE_LATEST_VERSION_pn-clutter-0.6 = "0.6.0"
RECIPE_MAINTAINER_pn-clutter-0.6 = "Edwin Zhai <edwin.zhai@intel.com>"

RECIPE_STATUS_pn-clutter-gtk-0.6 = "red"
RECIPE_LATEST_VERSION_pn-clutter-gtk-0.6 = "0.6.0"
RECIPE_MAINTAINER_pn-clutter-gtk-0.6 = "Edwin Zhai <edwin.zhai@intel.com>"

RECIPE_STATUS_pn-clutter-cairo-0.8 = "red"
RECIPE_LATEST_VERSION_pn-clutter-cairo-0.8 = "0.8.2"
RECIPE_MAINTAINER_pn-clutter-cairo-0.8 = "Edwin Zhai <edwin.zhai@intel.com>"

RECIPE_STATUS_pn-clutter-gtk-0.8 = "red"
RECIPE_LATEST_VERSION_pn-clutter-gtk-0.8 = "0.8.3"
RECIPE_MAINTAINER_pn-clutter-gtk-0.8 = "Edwin Zhai <edwin.zhai@intel.com>"

RECIPE_STATUS_pn-clutter-0.8 = "red"
RECIPE_LATEST_VERSION_pn-clutter-0.8 = "0.8.9"
RECIPE_MAINTAINER_pn-clutter-0.8 = "Edwin Zhai <edwin.zhai@intel.com>"

RECIPE_STATUS_pn-clutter-1.0 = "red"
RECIPE_LATEST_VERSION_pn-clutter-1.0 = "1.0.10"
RECIPE_MAINTAINER_pn-clutter-1.0 = "Edwin Zhai <edwin.zhai@intel.com>"

RECIPE_STATUS_pn-clutter = "red"
RECIPE_LATEST_VERSION_pn-clutter = "1.2.8"
RECIPE_MAINTAINER_pn-clutter = "Edwin Zhai <edwin.zhai@intel.com>"

RECIPE_STATUS_pn-gnome-menus = "red"
RECIPE_LATEST_VERSION_pn-gnome-menus = "2.30.0"
RECIPE_MAINTAINER_pn-gnome-menus = "Edwin Zhai <edwin.zhai@intel.com>"

RECIPE_STATUS_pn-gnome-packagekit = "red"
RECIPE_LATEST_VERSION_pn-gnome-packagekit = "2.30.2"
RECIPE_MAINTAINER_pn-gnome-packagekit = "Edwin Zhai <edwin.zhai@intel.com>"

RECIPE_STATUS_pn-libgnomekbd = "red"
RECIPE_LATEST_VERSION_pn-libgnomekbd = "2.31.1"
RECIPE_MAINTAINER_pn-libgnomekbd = "Edwin Zhai <edwin.zhai@intel.com>"

RECIPE_STATUS_pn-mx = "red"
RECIPE_LATEST_VERSION_pn-mx = "1.0.2"
RECIPE_MAINTAINER_pn-mx = "Edwin Zhai <edwin.zhai@intel.com>"

RECIPE_STATUS_pn-clipboard-manager = "red"
RECIPE_LATEST_VERSION_pn-clipboard-manager = "0.6.8"
RECIPE_MAINTAINER_pn-clipboard-manager = "Edwin Zhai <edwin.zhai@intel.com>"

RECIPE_STATUS_pn-gnome-desktop = "red"
RECIPE_LATEST_VERSION_pn-gnome-desktop = "2.31.2"
RECIPE_MAINTAINER_pn-gnome-desktop = "Edwin Zhai <edwin.zhai@intel.com>"

RECIPE_STATUS_pn-gnome-icon-theme = "red"
RECIPE_LATEST_VERSION_pn-gnome-icon-theme = "2.30.2"
RECIPE_MAINTAINER_pn-gnome-icon-theme = "Edwin Zhai <edwin.zhai@intel.com>"

RECIPE_STATUS_pn-gtk-doc = "red"
RECIPE_LATEST_VERSION_pn-gtk-doc = "1.15"
RECIPE_MAINTAINER_pn-gtk-doc = "Edwin Zhai <edwin.zhai@intel.com>"

RECIPE_STATUS_pn-gtkhtml2 = "red"
RECIPE_LATEST_VERSION_pn-gtkhtml2 = "2.11.1"
RECIPE_MAINTAINER_pn-gtkhtml2 = "Edwin Zhai <edwin.zhai@intel.com>"

RECIPE_STATUS_pn-gtk-theme-darkilouche = "red"
RECIPE_LATEST_VERSION_pn-gtk-theme-darkilouche = "1"
RECIPE_MAINTAINER_pn-gtk-theme-darkilouche = "Edwin Zhai <edwin.zhai@intel.com>"

RECIPE_STATUS_pn-libgnomecanvas = "red"
RECIPE_LATEST_VERSION_pn-libgnomecanvas = "2.30.1"
RECIPE_MAINTAINER_pn-libgnomecanvas = "Edwin Zhai <edwin.zhai@intel.com>"

RECIPE_STATUS_pn-libgtkstylus = "red"
RECIPE_LATEST_VERSION_pn-libgtkstylus = "0.5"
RECIPE_MAINTAINER_pn-libgtkstylus = "Edwin Zhai <edwin.zhai@intel.com>"

RECIPE_STATUS_pn-libidl = "red"
RECIPE_LATEST_VERSION_pn-libidl = "0.8.14"
RECIPE_MAINTAINER_pn-libidl = "Edwin Zhai <edwin.zhai@intel.com>"

RECIPE_STATUS_pn-libsexy = "red"
RECIPE_LATEST_VERSION_pn-libsexy = "0.1.11"
RECIPE_MAINTAINER_pn-libsexy = "Edwin Zhai <edwin.zhai@intel.com>"

RECIPE_STATUS_pn-matchbox-session-netbook = "red"
RECIPE_LATEST_VERSION_pn-matchbox-session-netbook = "0.1"
RECIPE_MAINTAINER_pn-matchbox-session-netbook = "Edwin Zhai <edwin.zhai@intel.com>"

RECIPE_STATUS_pn-matchbox-theme-sato-2 = "red"
RECIPE_LATEST_VERSION_pn-matchbox-theme-sato-2 = "0.1 + svnr164"
RECIPE_MAINTAINER_pn-matchbox-theme-sato-2 = "Edwin Zhai <edwin.zhai@intel.com>"

RECIPE_STATUS_pn-matchbox-themes-extra = "red"
RECIPE_LATEST_VERSION_pn-matchbox-themes-extra = "0.3+svnr1247"
RECIPE_MAINTAINER_pn-matchbox-themes-extra = "Edwin Zhai <edwin.zhai@intel.com>"

RECIPE_STATUS_pn-matchbox-themes-gtk = "red"
RECIPE_LATEST_VERSION_pn-matchbox-themes-gtk = "1"
RECIPE_MAINTAINER_pn-matchbox-themes-gtk = "Edwin Zhai <edwin.zhai@intel.com>"

RECIPE_STATUS_pn-matchbox-wm-2 = "red"
RECIPE_LATEST_VERSION_pn-matchbox-wm-2 = "0.0+svnr2106"
RECIPE_MAINTAINER_pn-matchbox-wm-2 = "Edwin Zhai <edwin.zhai@intel.com>"

RECIPE_STATUS_pn-metacity = "red"
RECIPE_LATEST_VERSION_pn-metacity = "2.30.1"
RECIPE_MAINTAINER_pn-metacity = "Edwin Zhai <edwin.zhai@intel.com>"

RECIPE_STATUS_pn-moblin-cursor-theme = "red"
RECIPE_LATEST_VERSION_pn-moblin-cursor-theme = "0.3"
RECIPE_MAINTAINER_pn-moblin-cursor-theme = "Edwin Zhai <edwin.zhai@intel.com>"

RECIPE_STATUS_pn-moblin-gtk-engine = "red"
RECIPE_LATEST_VERSION_pn-moblin-gtk-engine = "1.2.3"
RECIPE_MAINTAINER_pn-moblin-gtk-engine = "Edwin Zhai <edwin.zhai@intel.com>"

RECIPE_STATUS_pn-moblin-icon-theme = "red"
RECIPE_LATEST_VERSION_pn-moblin-icon-theme = "0.10"
RECIPE_MAINTAINER_pn-moblin-icon-theme = "Edwin Zhai <edwin.zhai@intel.com>"

RECIPE_STATUS_pn-moblin-menus = "red"
RECIPE_LATEST_VERSION_pn-moblin-menus = "0.1.6"
RECIPE_MAINTAINER_pn-moblin-menus = "Edwin Zhai <edwin.zhai@intel.com>"

RECIPE_STATUS_pn-moblin-user-skel = "red"
RECIPE_LATEST_VERSION_pn-moblin-user-skel = "0.18"
RECIPE_MAINTAINER_pn-moblin-user-skel = "Edwin Zhai <edwin.zhai@intel.com>"

RECIPE_STATUS_pn-moblin-web-browser = "red"
RECIPE_LATEST_VERSION_pn-moblin-web-browser = "2.1.2"
RECIPE_MAINTAINER_pn-moblin-web-browser = "Edwin Zhai <edwin.zhai@intel.com>"

RECIPE_STATUS_pn-nautilus = "red"
RECIPE_LATEST_VERSION_pn-nautilus = "2.31.2"
RECIPE_MAINTAINER_pn-nautilus = "Edwin Zhai <edwin.zhai@intel.com>"

RECIPE_STATUS_pn-polkit-gnome = "red"
RECIPE_LATEST_VERSION_pn-polkit-gnome = "0.96"
RECIPE_MAINTAINER_pn-polkit-gnome = "Edwin Zhai <edwin.zhai@intel.com>"

RECIPE_STATUS_pn-pong-clock = "red"
RECIPE_LATEST_VERSION_pn-pong-clock = "1"
RECIPE_MAINTAINER_pn-pong-clock = "Edwin Zhai <edwin.zhai@intel.com>"

RECIPE_STATUS_pn-twm = "red"
RECIPE_LATEST_VERSION_pn-twm = "1.0.4"
RECIPE_MAINTAINER_pn-twm = "Edwin Zhai <edwin.zhai@intel.com>"

RECIPE_STATUS_pn-anerley  = "red"
RECIPE_LATEST_VERSION_pn-anerley  = "0.2.13"
RECIPE_MAINTAINER_pn-anerley  = "Edwin Zhai <edwin.zhai@intel.com>"

RECIPE_STATUS_pn-nbtk = "red"
RECIPE_LATEST_VERSION_pn-nbtk = "n/a"
RECIPE_MAINTAINER_pn-nbtk = "Edwin Zhai <edwin.zhai@intel.com>"

RECIPE_STATUS_pn-moblin-panel-applications = "red"
RECIPE_LATEST_VERSION_pn-moblin-panel-applications = "0.1.28"
RECIPE_MAINTAINER_pn-moblin-panel-applications = "Edwin Zhai <edwin.zhai@intel.com>"

RECIPE_STATUS_pn-moblin-panel-media = "red"
RECIPE_LATEST_VERSION_pn-moblin-panel-media = "0.0.18"
RECIPE_MAINTAINER_pn-moblin-panel-media = "Edwin Zhai <edwin.zhai@intel.com>"

RECIPE_STATUS_pn-moblin-panel-myzone = "red"
RECIPE_LATEST_VERSION_pn-moblin-panel-myzone = "0.1.32"
RECIPE_MAINTAINER_pn-moblin-panel-myzone = "Edwin Zhai <edwin.zhai@intel.com>"

RECIPE_STATUS_pn-moblin-panel-pasteboard = "red"
RECIPE_LATEST_VERSION_pn-moblin-panel-pasteboard = "0.0.6"
RECIPE_MAINTAINER_pn-moblin-panel-pasteboard = "Edwin Zhai <edwin.zhai@intel.com>"

RECIPE_STATUS_pn-moblin-panel-people = "red"
RECIPE_LATEST_VERSION_pn-moblin-panel-people = "0.1.12"
RECIPE_MAINTAINER_pn-moblin-panel-people = "Edwin Zhai <edwin.zhai@intel.com>"

RECIPE_STATUS_pn-moblin-panel-status = "red"
RECIPE_LATEST_VERSION_pn-moblin-panel-status = "0.1.21"
RECIPE_MAINTAINER_pn-moblin-panel-status = "Edwin Zhai <edwin.zhai@intel.com>"

RECIPE_STATUS_pn-mutter = "red"
RECIPE_LATEST_VERSION_pn-mutter = "2.29.1_0.4"
RECIPE_MAINTAINER_pn-mutter = "Edwin Zhai <edwin.zhai@intel.com>"

RECIPE_STATUS_pn-mutter-moblin = "red"
RECIPE_LATEST_VERSION_pn-mutter-moblin = "0.75.13"
RECIPE_MAINTAINER_pn-mutter-moblin = "Edwin Zhai <edwin.zhai@intel.com>"
```

## meta/conf/distro/include/upstream_tracking.inc
```bitbake
# upstream_tracking.inc - This file contains data that tracks the
# upstream project associated with a given recipe. This list is needed
# for recipes that version information can not be automagically discovered.
# As we automate this checking, this file will slowed be reduced.
#
# This data is used by the package reporting system (packages.yoctoproject.org)
#
# The format is as a bitbake variable override for each recipe
#
#       RECIPE_UPSTREAM_VERSION_pn-<recipe name> = "<version>"
#       RECIPE_UPSTREAM_DATE_pn-<recipe name> = "Mmm dd, YYYY"
#	 - This is the latest upstream version and date
#       RECIPE_NO_UPDATE_REASON_pn-<recipe name> = "<free form text>"
#        - Used to note why a recipe should not be upgraded to a newer versoin
#       CHECK_DATE_pn-<recipe name> = "Mmm dd, YYYY"
#        - This is the date that upstream was last manually checked over time
#          this should be removed as we automate this checking
#
# These entries will slowly be removed as we can automatically determine
# the information in this file.  So for existing recipes that we can get 
# from the Recipe reporting system, the entries here can be removed.
#

# SVN support isn't implemented
# Also a new tarball release (or SVN tag) hasn't happened in a long time
RECIPE_UPSTREAM_VERSION_pn-unfs3="0.9.22.r495"
RECIPE_UPSTREAM_DATE_pn-unfs3="Feb 05, 2015"
CHECK_DATE_pn-unfs3 = "Jun 10, 2015"

# NO UPDATE REASONS
RECIPE_NO_UPDATE_REASON_pn-createrepo = "Versions after 0.9.* use YUM, so we hold at 0.4.11"
RECIPE_NO_UPDATE_REASON_pn-jpeg = "webkit-gtk 1.8.3 doesn't work with jpeg 9"
RECIPE_NO_UPDATE_REASON_pn-liberation-fonts = "2.x depends on fontforge package, which is not yet provided in oe-core"
RECIPE_NO_UPDATE_REASON_pn-pkgconfig = "removes glib-conf, adds circular depends"
RECIPE_NO_UPDATE_REASON_pn-python-pygobject = "Newer versions of python-pygobject depend on gobject-introspection which doesn't cross-compile"
RECIPE_NO_UPDATE_REASON_pn-webkit-gtk = ">= 1.10.2 needs ruby"
```

## meta/conf/distro/include/world-broken.inc
```bitbake
#
# Exclude known broken packages
#
EXCLUDE_FROM_WORLD_pn-gobject-introspection = "1"
```

## meta/conf/distro/include/yocto-uninative.inc
```bitbake
#
# This include points at uninative tarballs generated and maintained
# by the Yocto Project. These file can be included by distros if they
# want to use/maintain a unified sstate feed for native/cross artefacts
# rather than the feeds having native/cross artefacts which are specific
# to the distro running on the build machine.
#

UNINATIVE_MAXGLIBCVERSION = "2.38"
UNINATIVE_VERSION = "4.2"

UNINATIVE_URL ?= "http://downloads.yoctoproject.org/releases/uninative/${UNINATIVE_VERSION}/"
UNINATIVE_CHECKSUM[aarch64] ?= "cff40e7bdde50aeda06707af8c001796a71b4cf33c5ae1616e5c47943ff6b94e"
UNINATIVE_CHECKSUM[i686] ?= "a70516447e9a9f1465ffaf1c7f89e79d1692d2356d86fd2a5a63acd908db1ff2"
UNINATIVE_CHECKSUM[x86_64] ?= "6a86d71eeafba4fefec600c9bf8cf4a01324d1eb52788b6e398d3f23c10d19fb"
```

## meta/conf/distro/maemo-1.0.conf
```bitbake
require conf/distro/include/familiar.inc

DISTRO = "maemo"
DISTRO_NAME = "Maemo Linux"
DISTRO_VERSION = "v1.0b-${DATE}"

DISTRO_TYPE = "debug"
#DISTRO_TYPE = "release"

FEED_URIS += " \
		"
#SRCDATE = 20050331

PREFERRED_PROVIDERS += "virtual/${TARGET_PREFIX}gcc-initial:gcc-cross-initial"
PREFERRED_PROVIDERS += "virtual/${TARGET_PREFIX}gcc:gcc-cross"
PREFERRED_PROVIDERS += "virtual/${TARGET_PREFIX}g++:gcc-cross"

#PREFERRED_VERSION_binutils-cross = "2.15.91.0.2"
#PREFERRED_VERSION_gcc-cross = "3.4.4"
#PREFERRED_VERSION_gcc-cross-initial = "3.4.4
#PREFERRED_VERSION_libtool-native = "1.5.6"
#PREFERRED_VERSION_libtool-cross= "1.5.6"

#
# GPE
#

PREFERRED_PROVIDERS += "virtual/xserver:xserver-kdrive"
PREFERRED_PROVIDERS += "virtual/gconf:gconf-dbus"
PREFERRED_PROVIDER_virtual/libx11 = "diet-x11"

require conf/distro/include/preferred-gpe-versions.inc

#
# Maemo
#

require conf/distro/include/maemo-preferred.inc
```

## meta/conf/distro/openzaurus-unstable.conf
```bitbake
#@--------------------------------------------------------------------
#@TYPE: Distribution
#@NAME: OpenZaurus <http://www.openzaurus.org>
#@DESCRIPTION: A Linux Distribution for the Sharp Zaurus family
#@--------------------------------------------------------------------

DISTRO_VERSION = ".dev-snapshot-${DATE}"

CVS_TARBALL_STASH = "\
http://ewi546.ewi.utwente.nl/mirror/www.openzaurus.org/official/unstable/3.5.4/sources/ \
http://www.oesources.org/source/current/"


require conf/distro/include/sane-srcdates.inc
require conf/distro/include/openzaurus.inc

DISTRO_TYPE = "debug"
# DISTRO_TYPE = "release"

#FEED_URIS += " \
#           upgrades##http://openzaurus.org/official/unstable/${DISTRO_VERSION}/upgrades/ \
#upgrades-${MACHINE}##http://openzaurus.org/official/unstable/${DISTRO_VERSION}/upgrades/${MACHINE} \
#            machine##http://openzaurus.org/official/unstable/${DISTRO_VERSION}/feed/machine/${MACHINE} \
#               base##http://openzaurus.org/official/unstable/${DISTRO_VERSION}/feed/base/ \
#               libs##http://openzaurus.org/official/unstable/${DISTRO_VERSION}/feed/libs/ \
#            console##http://openzaurus.org/official/unstable/${DISTRO_VERSION}/feed/console \
#              devel##http://openzaurus.org/official/unstable/${DISTRO_VERSION}/feed/devel"

SRCDATE ?= "20060701"

#
# Zaurus
#
ASSUME_PROVIDED += "virtual/arm-linux-gcc-2.95"
PREFERRED_PROVIDER_hostap-conf = "hostap-conf"
PREFERRED_PROVIDER_task-bootstrap = "task-bootstrap"
PREFERRED_PROVIDER_tslib ?= tslib

KERNEL_CONSOLE = "ttyS0"
#DEBUG_OPTIMIZATION = "-O -g3"
#DEBUG_BUILD = "1"
#INHIBIT_PACKAGE_STRIP = "1"

# Glibc provides iconv and intl -- adjust, when doing uclibc builds
PREFERRED_PROVIDER_virtual/libiconv = "glibc"
PREFERRED_PROVIDER_virtual/libintl = "glibc"

#
# Base
#
PREFERRED_PROVIDERS += " virtual/${TARGET_PREFIX}gcc-initial:gcc-cross-initial"
PREFERRED_PROVIDERS += " virtual/${TARGET_PREFIX}gcc:gcc-cross"
PREFERRED_PROVIDERS += " virtual/${TARGET_PREFIX}g++:gcc-cross"

PREFERRED_VERSION_binutils-cross = "2.15.94.0.1"
PREFERRED_VERSION_binutils = "2.15.94.0.1"

#
# Opie
#
QTE_VERSION = "2.3.10"
OPIE_VERSION = "1.2.2"
PALMTOP_USE_MULTITHREADED_QT = "yes"
require conf/distro/include/preferred-opie-versions.inc

#
# GPE
#
PREFERRED_PROVIDERS += "virtual/xserver:xserver-kdrive"
PREFERRED_PROVIDER_virtual/libx11 = "diet-x11"
require conf/distro/include/preferred-gpe-versions-2.8.inc

#
# E
#
require conf/distro/include/preferred-e-versions.inc
```

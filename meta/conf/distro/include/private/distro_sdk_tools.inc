## meta/conf/distro/include/private/distro_x11_apps_1.inc
```bitbake
#
# distro tracking fields for X11 apps(high level)
#

RECIPE_STATUS_pn-owl-video = "green" # no update needed
DEPENDENCY_CHECK_pn-owl-video = "not done"
RECIPE_LATEST_VERSION_pn-owl-video = "394"
RECIPE_NO_OF_PATCHES_pn-owl-video = "0"
RECIPE_INTEL_SECTION_pn-owl-video = "graphic apps"
RECIPE_TIME_BETWEEN_LAST_TWO_RELEASES_pn-owl-video = "n/a"
RECIPE_LATEST_RELEASE_DATE_pn-owl-video = "06/2008"
RECIPE_COMMENTS_pn-owl-video = ""
RECIPE_MAINTAINER_pn-owl-video = "Zhai Edwin <edwin.zhai@intel.com>"

RECIPE_STATUS_pn-xtscal = "green" # no update needed
DEPENDENCY_CHECK_pn-xtscal = "not done"
RECIPE_LATEST_VERSION_pn-xtscal = "0.6.3"
RECIPE_NO_OF_PATCHES_pn-xtscal = "2"
RECIPE_INTEL_SECTION_pn-xtscal = "graphic apps"
RECIPE_TIME_BETWEEN_LAST_TWO_RELEASES_pn-xtscal = "n/a"
RECIPE_LATEST_RELEASE_DATE_pn-xtscal = "06/2006"
RECIPE_COMMENTS_pn-xtscal = ""
RECIPE_MAINTAINER_pn-xtscal = "Zhai Edwin <edwin.zhai@intel.com>"

RECIPE_STATUS_pn-xrestop = "green" # no update needed
DEPENDENCY_CHECK_pn-xrestop = "not done"
RECIPE_LATEST_VERSION_pn-xrestop = "0.4"
RECIPE_NO_OF_PATCHES_pn-xrestop = "0"
RECIPE_INTEL_SECTION_pn-xrestop = "graphic apps"
RECIPE_TIME_BETWEEN_LAST_TWO_RELEASES_pn-xrestop = "18 months"
RECIPE_LATEST_RELEASE_DATE_pn-xrestop = "03/2006"
RECIPE_COMMENTS_pn-xrestop = ""
RECIPE_MAINTAINER_pn-xrestop = "Zhai Edwin <edwin.zhai@intel.com>"

RECIPE_STATUS_pn-pcmanfm = "green"
DEPENDENCY_CHECK_pn-pcmanfm = "not done"
RECIPE_LATEST_VERSION_pn-pcmanfm = "0.9.7"
RECIPE_NO_OF_PATCHES_pn-pcmanfm = "4"
RECIPE_INTEL_SECTION_pn-pcmanfm = "graphic apps"
RECIPE_TIME_BETWEEN_LAST_TWO_RELEASES_pn-pcmanfm = "4 months"
RECIPE_LATEST_RELEASE_DATE_pn-pcmanfm = "05/2010"
RECIPE_COMMENTS_pn-pcmanfm = ""
RECIPE_MAINTAINER_pn-pcmanfm = "Zhai Edwin <edwin.zhai@intel.com>"

RECIPE_STATUS_pn-oh-puzzles = "green" # no update needed
DEPENDENCY_CHECK_pn-oh-puzzles = "not done"
RECIPE_LATEST_VERSION_pn-oh-puzzles = "0.1+svnr23"
RECIPE_NO_OF_PATCHES_pn-oh-puzzles = "1"
RECIPE_INTEL_SECTION_pn-oh-puzzles = "graphic apps"
RECIPE_TIME_BETWEEN_LAST_TWO_RELEASES_pn-oh-puzzles = "n/a"
RECIPE_LATEST_RELEASE_DATE_pn-oh-puzzles = "04/2008"
RECIPE_COMMENTS_pn-oh-puzzles = ""
RECIPE_MAINTAINER_pn-oh-puzzles = "Zhai Edwin <edwin.zhai@intel.com>"


RECIPE_STATUS_pn-gnome-terminal = "red"
RECIPE_LATEST_VERSION_pn-gnome-terminal = "2.31.3"
RECIPE_MAINTAINER_pn-gnome-terminal = "Edwin Zhai <edwin.zhai@intel.com>"

RECIPE_STATUS_pn-puzzles = "red"
RECIPE_LATEST_VERSION_pn-puzzles = "svn_8956"
RECIPE_MAINTAINER_pn-puzzles = "Edwin Zhai <edwin.zhai@intel.com>"

RECIPE_STATUS_pn-xdg-user-dirs = "red"
RECIPE_LATEST_VERSION_pn-xdg-user-dirs = "0.12"
RECIPE_MAINTAINER_pn-xdg-user-dirs = "Edwin Zhai <edwin.zhai@intel.com>"

RECIPE_STATUS_pn-xterm = "red"
RECIPE_LATEST_VERSION_pn-xterm = "n/a"
RECIPE_MAINTAINER_pn-xterm = "Edwin Zhai <edwin.zhai@intel.com>"

RECIPE_STATUS_pn-iceauth = "red"
RECIPE_LATEST_VERSION_pn-iceauth = "1.0.3"
RECIPE_MAINTAINER_pn-iceauth = "Edwin Zhai <edwin.zhai@intel.com>"

RECIPE_STATUS_pn-luit = "red"
RECIPE_LATEST_VERSION_pn-luit = "1.0.5"
RECIPE_MAINTAINER_pn-luit = "Edwin Zhai <edwin.zhai@intel.com>"

RECIPE_STATUS_pn-oclock = "red"
RECIPE_LATEST_VERSION_pn-oclock = "n/a"
RECIPE_MAINTAINER_pn-oclock = "Edwin Zhai <edwin.zhai@intel.com>"

RECIPE_STATUS_pn-rgb = "red"
RECIPE_LATEST_VERSION_pn-rgb = "1.0.3"
RECIPE_MAINTAINER_pn-rgb = "Edwin Zhai <edwin.zhai@intel.com>"

RECIPE_STATUS_pn-x11perf = "red"
RECIPE_LATEST_VERSION_pn-x11perf = "1.5.1"
RECIPE_MAINTAINER_pn-x11perf = "Edwin Zhai <edwin.zhai@intel.com>"

RECIPE_STATUS_pn-xbacklight = "red"
RECIPE_LATEST_VERSION_pn-xbacklight = "1.1.1"
RECIPE_MAINTAINER_pn-xbacklight = "Edwin Zhai <edwin.zhai@intel.com>"

RECIPE_STATUS_pn-xbiff = "red"
RECIPE_LATEST_VERSION_pn-xbiff = "1.0.2"
RECIPE_MAINTAINER_pn-xbiff = "Edwin Zhai <edwin.zhai@intel.com>"

RECIPE_STATUS_pn-xclipboard = "red"
RECIPE_LATEST_VERSION_pn-xclipboard = "1.1.0"
RECIPE_MAINTAINER_pn-xclipboard = "Edwin Zhai <edwin.zhai@intel.com>"

RECIPE_STATUS_pn-xclock = "red"
RECIPE_LATEST_VERSION_pn-xclock = "n/a"
RECIPE_MAINTAINER_pn-xclock = "Edwin Zhai <edwin.zhai@intel.com>"

RECIPE_STATUS_pn-xcmsdb = "red"
RECIPE_LATEST_VERSION_pn-xcmsdb = "1.0.2"
RECIPE_MAINTAINER_pn-xcmsdb = "Edwin Zhai <edwin.zhai@intel.com>"

RECIPE_STATUS_pn-xconsole = "red"
RECIPE_LATEST_VERSION_pn-xconsole = "1.0.3"
RECIPE_MAINTAINER_pn-xconsole = "Edwin Zhai <edwin.zhai@intel.com>"

RECIPE_STATUS_pn-xcursorgen = "red"
RECIPE_LATEST_VERSION_pn-xcursorgen = "1.0.3"
RECIPE_MAINTAINER_pn-xcursorgen = "Edwin Zhai <edwin.zhai@intel.com>"

RECIPE_STATUS_pn-xdriinfo = "red"
RECIPE_LATEST_VERSION_pn-xdriinfo = "1.0.3"
RECIPE_MAINTAINER_pn-xdriinfo = "Edwin Zhai <edwin.zhai@intel.com>"

RECIPE_STATUS_pn-xev = "red"
RECIPE_LATEST_VERSION_pn-xev = "1.0.4"
RECIPE_MAINTAINER_pn-xev = "Edwin Zhai <edwin.zhai@intel.com>"

RECIPE_STATUS_pn-xeyes = "red"
RECIPE_LATEST_VERSION_pn-xeyes = "1.1.0"
RECIPE_MAINTAINER_pn-xeyes = "Edwin Zhai <edwin.zhai@intel.com>"

RECIPE_STATUS_pn-xfd = "red"
RECIPE_LATEST_VERSION_pn-xfd = "1.0.1"
RECIPE_MAINTAINER_pn-xfd = "Edwin Zhai <edwin.zhai@intel.com>"

RECIPE_STATUS_pn-xfontsel = "red"
RECIPE_LATEST_VERSION_pn-xfontsel = "1.0.2"
RECIPE_MAINTAINER_pn-xfontsel = "Edwin Zhai <edwin.zhai@intel.com>"

RECIPE_STATUS_pn-xgamma = "red"
RECIPE_LATEST_VERSION_pn-xgamma = "1.0.3"
RECIPE_MAINTAINER_pn-xgamma = "Edwin Zhai <edwin.zhai@intel.com>"

RECIPE_STATUS_pn-xkbevd = "red"
RECIPE_LATEST_VERSION_pn-xkbevd = "1.1.0"
RECIPE_MAINTAINER_pn-xkbevd = "Edwin Zhai <edwin.zhai@intel.com>"

RECIPE_STATUS_pn-xkbprint = "red"
RECIPE_LATEST_VERSION_pn-xkbprint = "1.0.2"
RECIPE_MAINTAINER_pn-xkbprint = "Edwin Zhai <edwin.zhai@intel.com>"

RECIPE_STATUS_pn-xkbutils = "red"
RECIPE_LATEST_VERSION_pn-xkbutils = "1.0.2"
RECIPE_MAINTAINER_pn-xkbutils = "Edwin Zhai <edwin.zhai@intel.com>"

RECIPE_STATUS_pn-xkill = "red"
RECIPE_LATEST_VERSION_pn-xkill = "1.0.2"
RECIPE_MAINTAINER_pn-xkill = "Edwin Zhai <edwin.zhai@intel.com>"

RECIPE_STATUS_pn-xload = "red"
RECIPE_LATEST_VERSION_pn-xload = "1.0.2"
RECIPE_MAINTAINER_pn-xload = "Edwin Zhai <edwin.zhai@intel.com>"

RECIPE_STATUS_pn-xlsatoms = "red"
RECIPE_LATEST_VERSION_pn-xlsatoms = "1.1.0"
RECIPE_MAINTAINER_pn-xlsatoms = "Edwin Zhai <edwin.zhai@intel.com>"

RECIPE_STATUS_pn-xlsclients = "red"
RECIPE_LATEST_VERSION_pn-xlsclients = "1.1.0"
RECIPE_MAINTAINER_pn-xlsclients = "Edwin Zhai <edwin.zhai@intel.com>"

RECIPE_STATUS_pn-xlsfonts = "red"
RECIPE_LATEST_VERSION_pn-xlsfonts = "1.0.2"
RECIPE_MAINTAINER_pn-xlsfonts = "Edwin Zhai <edwin.zhai@intel.com>"

RECIPE_STATUS_pn-xmag = "red"
RECIPE_LATEST_VERSION_pn-xmag = "1.0.3"
RECIPE_MAINTAINER_pn-xmag = "Edwin Zhai <edwin.zhai@intel.com>"

RECIPE_STATUS_pn-xmessage = "red"
RECIPE_LATEST_VERSION_pn-xmessage = "1.0.3"
RECIPE_MAINTAINER_pn-xmessage = "Edwin Zhai <edwin.zhai@intel.com>"

RECIPE_STATUS_pn-xrdb = "red"
RECIPE_LATEST_VERSION_pn-xrdb = "1.0.6"
RECIPE_MAINTAINER_pn-xrdb = "Edwin Zhai <edwin.zhai@intel.com>"

RECIPE_STATUS_pn-xrefresh = "red"
RECIPE_LATEST_VERSION_pn-xrefresh = "1.0.3"
RECIPE_MAINTAINER_pn-xrefresh = "Edwin Zhai <edwin.zhai@intel.com>"

RECIPE_STATUS_pn-xsetroot = "red"
RECIPE_LATEST_VERSION_pn-xsetroot = "1.0.3"
RECIPE_MAINTAINER_pn-xsetroot = "Edwin Zhai <edwin.zhai@intel.com>"

RECIPE_STATUS_pn-xstdcmap = "red"
RECIPE_LATEST_VERSION_pn-xstdcmap = "1.0.1"
RECIPE_MAINTAINER_pn-xstdcmap = "Edwin Zhai <edwin.zhai@intel.com>"

RECIPE_STATUS_pn-xtrap = "red"
RECIPE_LATEST_VERSION_pn-xtrap = "1.0.2"
RECIPE_MAINTAINER_pn-xtrap = "Edwin Zhai <edwin.zhai@intel.com>"

RECIPE_STATUS_pn-xvidtune = "red"
RECIPE_LATEST_VERSION_pn-xvidtune = "1.0.2"
RECIPE_MAINTAINER_pn-xvidtune = "Edwin Zhai <edwin.zhai@intel.com>"

RECIPE_STATUS_pn-xvinfo = "red"
RECIPE_LATEST_VERSION_pn-xvinfo = "1.1.0"
RECIPE_MAINTAINER_pn-xvinfo = "Edwin Zhai <edwin.zhai@intel.com>"

RECIPE_STATUS_pn-xwd = "red"
RECIPE_LATEST_VERSION_pn-xwd = "1.0.3"
RECIPE_MAINTAINER_pn-xwd = "Edwin Zhai <edwin.zhai@intel.com>"

RECIPE_STATUS_pn-xwud = "red"
RECIPE_LATEST_VERSION_pn-xwud = "1.0.2"
RECIPE_MAINTAINER_pn-xwud = "Edwin Zhai <edwin.zhai@intel.com>"

RECIPE_STATUS_pn-claws-plugin-gtkhtml2-viewer = "red"
RECIPE_LATEST_VERSION_pn-claws-plugin-gtkhtml2-viewer = "0.27"
RECIPE_MAINTAINER_pn-claws-plugin-gtkhtml2-viewer = "Edwin Zhai <edwin.zhai@intel.com>"

RECIPE_STATUS_pn-claws-plugin-maildir = "red"
RECIPE_LATEST_VERSION_pn-claws-plugin-maildir = "0.24.4"
RECIPE_MAINTAINER_pn-claws-plugin-maildir = "Edwin Zhai <edwin.zhai@intel.com>"

RECIPE_STATUS_pn-claws-plugin-mailmbox = "red"
RECIPE_LATEST_VERSION_pn-claws-plugin-mailmbox = "1.14.4"
RECIPE_MAINTAINER_pn-claws-plugin-mailmbox = "Edwin Zhai <edwin.zhai@intel.com>"

RECIPE_STATUS_pn-claws-plugin-rssyl = "red"
RECIPE_LATEST_VERSION_pn-claws-plugin-rssyl = "0.27"
RECIPE_MAINTAINER_pn-claws-plugin-rssyl = "Edwin Zhai <edwin.zhai@intel.com>"

RECIPE_STATUS_pn-lndir = "red"
RECIPE_LATEST_VERSION_pn-lndir = "n/a"
RECIPE_MAINTAINER_pn-lndir = "Edwin Zhai <edwin.zhai@intel.com>"

RECIPE_STATUS_pn-mozilla-headless = "red"
RECIPE_LATEST_VERSION_pn-mozilla-headless = "tip_hg_555cbc23"
RECIPE_MAINTAINER_pn-mozilla-headless = "Edwin Zhai <edwin.zhai@intel.com>"

RECIPE_STATUS_pn-kf = "red"
RECIPE_LATEST_VERSION_pn-kf = "n/a"
RECIPE_MAINTAINER_pn-kf = "Edwin Zhai <edwin.zhai@intel.com>"

RECIPE_STATUS_pn-claws-mail = "red"
RECIPE_LATEST_VERSION_pn-claws-mail = "3.7.6"
RECIPE_MAINTAINER_pn-claws-mail = "Edwin Zhai <edwin.zhai@intel.com>"

RECIPE_STATUS_pn-x11vnc = "red"
RECIPE_LATEST_VERSION_pn-x11vnc = "0.9.11_dev"
RECIPE_MAINTAINER_pn-x11vnc = "Edwin Zhai <edwin.zhai@intel.com>"
```

## meta/conf/distro/include/private/distro_x11_apps_2.inc
```bitbake
#
# distro tracking fields for X11 apps packages
#

RECIPE_STATUS_pn-mkfontdir="green" # no update needed
RECIPE_LATEST_VERSION_pn-mkfontdir="1.0.5"
RECIPE_NO_OF_PATCHES_pn-mkfontdir="0"
RECIPE_TIME_BETWEEN_LAST_TWO_RELEASES_pn-mkfontdir="2009/10/11"
RECIPE_LATEST_RELEASE_DATE_pn-mkfontdir="16 monthes"
RECIPE_INTEL_SECTION_pn-mkfontdir="graphic apps"
RECIPE_MAINTAINER_pn-mkfontdir="Yu Ke <ke.yu@intel.com>"

RECIPE_STATUS_pn-mkfontscale="green" # no update needed
RECIPE_LATEST_VERSION_pn-mkfontscale="1.0.7"
RECIPE_NO_OF_PATCHES_pn-mkfontscale="0"
RECIPE_TIME_BETWEEN_LAST_TWO_RELEASES_pn-mkfontscale="10 monthes"
RECIPE_LATEST_RELEASE_DATE_pn-mkfontscale="2009/10/11"
RECIPE_INTEL_SECTION_pn-mkfontscale="graphic apps"
RECIPE_MAINTAINER_pn-mkfontscale="Yu Ke <ke.yu@intel.com>"

RECIPE_STATUS_pn-xauth="green" # no update needed
RECIPE_LATEST_VERSION_pn-xauth="1.0.4"
RECIPE_NO_OF_PATCHES_pn-xauth="0"
RECIPE_TIME_BETWEEN_LAST_TWO_RELEASES_pn-xauth="1 year"
RECIPE_LATEST_RELEASE_DATE_pn-xauth="2009/09/21"
RECIPE_INTEL_SECTION_pn-xauth="graphic app"
RECIPE_MAINTAINER_pn-xauth="Yu Ke <ke.yu@intel.com>"

RECIPE_STATUS_pn-xdpyinfo="green" # no update needed
RECIPE_LATEST_VERSION_pn-xdpyinfo="1.1.0"
RECIPE_NO_OF_PATCHES_pn-xdpyinfo="1"
RECIPE_TIME_BETWEEN_LAST_TWO_RELEASES_pn-xdpyinfo="1 year"
RECIPE_LATEST_RELEASE_DATE_pn-xdpyinfo="2009/10/16"
RECIPE_INTEL_SECTION_pn-xdpyinfo="graphic app"
RECIPE_MAINTAINER_pn-xdpyinfo="Yu Ke <ke.yu@intel.com>"

RECIPE_STATUS_pn-xhost="green" # no update needed
RECIPE_LATEST_VERSION_pn-xhost="1.0.3"
RECIPE_NO_OF_PATCHES_pn-xhost="0"
RECIPE_TIME_BETWEEN_LAST_TWO_RELEASES_pn-xhost="2 years"
RECIPE_LATEST_RELEASE_DATE_pn-xhost="2009/10/14"
RECIPE_INTEL_SECTION_pn-xhost="graphic app"
RECIPE_MAINTAINER_pn-xhost="Yu Ke <ke.yu@intel.com>"

RECIPE_STATUS_pn-xinit="green" # no update needed
RECIPE_LATEST_VERSION_pn-xinit="1.2.1"
RECIPE_NO_OF_PATCHES_pn-xinit="0"
RECIPE_TIME_BETWEEN_LAST_TWO_RELEASES_pn-xinit="4 monthes"
RECIPE_LATEST_RELEASE_DATE_pn-xinit="2010/03/16"
RECIPE_INTEL_SECTION_pn-xinit="graphic app"
RECIPE_MAINTAINER_pn-xinit="Yu Ke <ke.yu@intel.com>"

RECIPE_STATUS_pn-xkbcomp="green" # no update needed
RECIPE_LATEST_VERSION_pn-xkbcomp="1.1.1"
RECIPE_NO_OF_PATCHES_pn-xkbcomp="0"
RECIPE_TIME_BETWEEN_LAST_TWO_RELEASES_pn-xkbcomp="2 monthes"
RECIPE_LATEST_RELEASE_DATE_pn-xkbcomp="2009/10/03"
RECIPE_INTEL_SECTION_pn-xkbcomp="graphic app"
RECIPE_MAINTAINER_pn-xkbcomp="Yu Ke <ke.yu@intel.com>"

RECIPE_STATUS_pn-xmodmap="green" # no update needed
RECIPE_LATEST_VERSION_pn-xmodmap="1.0.4"
RECIPE_NO_OF_PATCHES_pn-xmodmap="0"
RECIPE_TIME_BETWEEN_LAST_TWO_RELEASES_pn-xmodmap="2 years"
RECIPE_LATEST_RELEASE_DATE_pn-xmodmap="2009/10/06"
RECIPE_INTEL_SECTION_pn-xmodmap="graphic app"
RECIPE_MAINTAINER_pn-xmodmap="Yu Ke <ke.yu@intel.com>"

RECIPE_STATUS_pn-xprop="green" # no update needed
RECIPE_LATEST_VERSION_pn-xprop="1.1.0"
RECIPE_NO_OF_PATCHES_pn-xprop="0"
RECIPE_TIME_BETWEEN_LAST_TWO_RELEASES_pn-xprop="1 year"
RECIPE_LATEST_RELEASE_DATE_pn-xprop="2009/10/12"
RECIPE_INTEL_SECTION_pn-xprop="graphic app"
RECIPE_MAINTAINER_pn-xprop="Yu Ke <ke.yu@intel.com>"

RECIPE_STATUS_pn-xset="green" # no update needed
DISTRO_PN_ALIAS_pn-xset = "Fedora=xorg-x11-server-utils Ubuntu=x11-xserver-utils Debian=x11-xserver-utils Opensuse=xorg-x11"
RECIPE_LATEST_VERSION_pn-xset="1.1.0"
RECIPE_NO_OF_PATCHES_pn-xset="1"
RECIPE_TIME_BETWEEN_LAST_TWO_RELEASES_pn-xset="1 year"
RECIPE_LATEST_RELEASE_DATE_pn-xset="2009/09/21"
RECIPE_INTEL_SECTION_pn-xset="graphic app"
RECIPE_MAINTAINER_pn-xset="Yu Ke <ke.yu@intel.com>"

RECIPE_STATUS_pn-xwininfo="green" # no update needed
RECIPE_LATEST_VERSION_pn-xwininfo="1.0.5"
RECIPE_NO_OF_PATCHES_pn-xwininfo="0"
RECIPE_TIME_BETWEEN_LAST_TWO_RELEASES_pn-xwininfo="1 year"
RECIPE_LATEST_RELEASE_DATE_pn-xwininfo="2009/10/12"
RECIPE_INTEL_SECTION_pn-xwininfo="graphic app"
RECIPE_MAINTAINER_pn-xwininfo="Yu Ke <ke.yu@intel.com>"

RECIPE_STATUS_pn-xrandr="green" # no update needed
RECIPE_LATEST_VERSION_pn-xrandr="1.3.2"
RECIPE_NO_OF_PATCHES_pn-xrandr="0"
RECIPE_TIME_BETWEEN_LAST_TWO_RELEASES_pn-xrandr="1 month"
RECIPE_LATEST_RELEASE_DATE_pn-xrandr="2009/09/10"
RECIPE_INTEL_SECTION_pn-xrandr="graphic app"
RECIPE_MAINTAINER_pn-xrandr="Yu Ke <ke.yu@intel.com>"

RECIPE_STATUS_pn-vte="green" # no update needed
RECIPE_LATEST_VERSION_pn-vte="0.24.3"
RECIPE_NO_OF_PATCHES_pn-vte="0"
RECIPE_TIME_BETWEEN_LAST_TWO_RELEASES_pn-vte="3 monthes"
RECIPE_LATEST_RELEASE_DATE_pn-vte="2010/07/12"
RECIPE_INTEL_SECTION_pn-vte="graphic app"
RECIPE_MAINTAINER_pn-vte="Yu Ke <ke.yu@intel.com>"

RECIPE_STATUS_pn-qemugl="green" # no update needed
RECIPE_LATEST_VERSION_pn-qemugl="0.0+git0+d888bbc723c00d197d34a39b5b7448660ec1b1c0"
RECIPE_NO_OF_PATCHES_pn-qemugl="1"
RECIPE_TIME_BETWEEN_LAST_TWO_RELEASES_pn-qemugl="n/a"
RECIPE_LATEST_RELEASE_DATE_pn-qemugl="2009/05/30"
RECIPE_INTEL_SECTION_pn-qemugl="graphic app"
RECIPE_MAINTAINER_pn-qemugl="Yu Ke <ke.yu@intel.com>"
```

## meta/conf/distro/include/seperatebuilddir.inc
```bitbake
# List of autotools recipes which support building with external build directories
# i.e. ${B} != ${S}
SEPB = "${WORKDIR}/build"

# Makefile based, no out of tree support
#B_pn-acl = "${SEPB}"
#B_pn-acl-native = "${SEPB}"
B_pn-alsa-lib = "${SEPB}"
B_pn-alsa-lib-native = "${SEPB}"
# Not autotools
#B_pn-alsa-tools = "${SEPB}"
# Has header issues at compile, likely fixable
#B_pn-alsa-utils = "${SEPB}"
B_pn-apache2 = "${SEPB}"
# No working out of tree support
#B_pn-apr = "${SEPB}"
#B_pn-apr-native = "${SEPB}"
#B_pn-apr-util = "${SEPB}"
#B_pn-apr-util-native = "${SEPB}"
B_pn-apt = "${SEPB}"
B_pn-apt-native = "${SEPB}"
# support for out of tree broken at compile, likely fixable
#B_pn-aspell = "${SEPB}"
# No support for out of tree builds
#B_pn-at = "${SEPB}"
B_pn-atk = "${SEPB}"
B_pn-atk-native = "${SEPB}"
# Makefile based, no out of tree support
#B_pn-attr = "${SEPB}"
#B_pn-attr-native = "${SEPB}"
B_pn-augeas = "${SEPB}"
B_pn-autoconf = "${SEPB}"
B_pn-autoconf-native = "${SEPB}"
B_pn-autogen-native = "${SEPB}"
B_pn-automake = "${SEPB}"
B_pn-automake-native = "${SEPB}"
B_pn-avahi = "${SEPB}"
B_pn-avahi-ui = "${SEPB}"
B_pn-babeltrace = "${SEPB}"
B_pn-base-passwd = "${SEPB}"
#B_pn-bash = "${SEPB}"
B_pn-bc = "${SEPB}"
B_pn-bdwgc = "${SEPB}"
B_pn-bdwgc-native = "${SEPB}"
B_pn-beecrypt = "${SEPB}"
B_pn-beecrypt-native = "${SEPB}"
B_pn-bigreqsproto = "${SEPB}"
B_pn-bigreqsproto-native = "${SEPB}"
#| make[3]: Entering directory `/media/build1/poky/build/tmp/work/i586-poky-linux/bind/9.8.1-r5/build/bin/named'
#| i586-poky-linux-gcc  -m32   -march=i586 --sysroot=/media/build1/poky/build/tmp/sysroots/qemux86 -O2 -pipe -g -feliminate-unused-debug-types   -c -o named-symtbl.o named-symtbl.c
#| named-symtbl.c:4:27: fatal error: isc/backtrace.h: No such file or directory
#B_pn-bind = "${SEPB}"
B_pn-bison = "${SEPB}"
B_pn-bison-native = "${SEPB}"
B_pn-blktool = "${SEPB}"
# ln: failed to create symbolic link 'lib/bluetooth/bluetooth.h': File exists
#B_pn-bluez4 = "${SEPB}"
B_pn-bluez-hcidump = "${SEPB}"
B_pn-byacc = "${SEPB}"
B_pn-byacc-native = "${SEPB}"
B_pn-bzip2 = "${SEPB}"
B_pn-bzip2-native = "${SEPB}"
B_pn-cairo = "${SEPB}"
B_pn-cairo-native = "${SEPB}"
B_pn-calibrateproto = "${SEPB}"
B_pn-ccache = "${SEPB}"
B_pn-ccache-native = "${SEPB}"
B_pn-chrpath = "${SEPB}"
B_pn-chrpath-native = "${SEPB}"
B_pn-clutter-1.0 = "${SEPB}"
B_pn-clutter-gst-1.0 = "${SEPB}"
B_pn-clutter-gtk-1.0 = "${SEPB}"
#B_pn-cmake = "${SEPB}"
#B_pn-cmake-native = "${SEPB}"
B_pn-cogl-1.0 = "${SEPB}"
B_pn-compositeproto = "${SEPB}"
B_pn-compositeproto-native = "${SEPB}"
#B_pn-connman = "${SEPB}"
#B_pn-connman-gnome = "${SEPB}"
B_pn-consolekit = "${SEPB}"
B_pn-console-tools = "${SEPB}"
B_pn-coreutils = "${SEPB}"
B_pn-coreutils-native = "${SEPB}"
B_pn-courier-authlib = "${SEPB}"
B_pn-courier-imap = "${SEPB}"
B_pn-cpio = "${SEPB}"
B_pn-cracklib = "${SEPB}"
B_pn-cronie = "${SEPB}"
B_pn-cross-localedef-native = "${SEPB}"
#No autoconf and no support for separate build
#B_pn-cups = "${SEPB}"
B_pn-curl = "${SEPB}"
B_pn-curl-native = "${SEPB}"
B_pn-damageproto = "${SEPB}"
B_pn-damageproto-native = "${SEPB}"
B_pn-db = "${SEPB}"
B_pn-db-native = "${SEPB}"
B_pn-dbus = "${SEPB}"
B_pn-dbus-glib = "${SEPB}"
B_pn-dbus-glib-native = "${SEPB}"
B_pn-dbus-native = "${SEPB}"
B_pn-dbus-ptest = "${SEPB}"
B_pn-dbus-wait = "${SEPB}"
B_pn-desktop-file-utils-native = "${SEPB}"
B_pn-dhcp = "${SEPB}"
B_pn-diffstat = "${SEPB}"
B_pn-diffutils = "${SEPB}"
B_pn-directfb = "${SEPB}"
B_pn-directfb-examples = "${SEPB}"
B_pn-distcc = "${SEPB}"
B_pn-dmxproto = "${SEPB}"
B_pn-docbook-utils-native = "${SEPB}"
B_pn-dpkg = "${SEPB}"
B_pn-dpkg-native = "${SEPB}"
B_pn-dri2proto = "${SEPB}"
B_pn-dropbear = "${SEPB}"
## Makefile based not autotools
##B_pn-dtc = "${SEPB}"
##B_pn-dtc-native = "${SEPB}"
B_pn-e2fsprogs = "${SEPB}"
B_pn-e2fsprogs-native = "${SEPB}"
B_pn-ed = "${SEPB}"
B_pn-elfutils = "${SEPB}"
B_pn-elfutils-native = "${SEPB}"
B_pn-enchant = "${SEPB}"
B_pn-encodings = "${SEPB}"
B_pn-ethtool = "${SEPB}"
B_pn-expat = "${SEPB}"
B_pn-expat-native = "${SEPB}"
B_pn-fetchmail = "${SEPB}"
B_pn-file = "${SEPB}"
B_pn-file-native = "${SEPB}"
B_pn-findutils = "${SEPB}"
B_pn-findutils-native = "${SEPB}"
B_pn-fixesproto = "${SEPB}"
B_pn-fixesproto-native = "${SEPB}"
# /bin/bash: line 0: cd: api: No such file or directory
#B_pn-flac = "${SEPB}"
B_pn-flex = "${SEPB}"
B_pn-flex-native = "${SEPB}"
B_pn-font-alias = "${SEPB}"
B_pn-fontconfig = "${SEPB}"
B_pn-fontconfig-native = "${SEPB}"
B_pn-fontsproto = "${SEPB}"
B_pn-fontsproto-native = "${SEPB}"
B_pn-font-util = "${SEPB}"
B_pn-font-util-native = "${SEPB}"
B_pn-foomatic-filters = "${SEPB}"
## run.do_configure.4694: 88: cd: can't cd to builds/unix
##B_pn-freetype = "${SEPB}"
##B_pn-freetype-native = "${SEPB}"
B_pn-fstests = "${SEPB}"
B_pn-gaku = "${SEPB}"
B_pn-gamin = "${SEPB}"
B_pn-gawk = "${SEPB}"
B_pn-gccmakedep = "${SEPB}"
B_pn-gconf = "${SEPB}"
B_pn-gconf-native = "${SEPB}"
B_pn-gdb = "${SEPB}"
B_pn-gdb-cross = "${SEPB}"
B_pn-gdb-cross-canadian-i586 = "${SEPB}"
B_pn-gdbm = "${SEPB}"
B_pn-gdbm-native = "${SEPB}"
B_pn-gdk-pixbuf = "${SEPB}"
B_pn-gdk-pixbuf-native = "${SEPB}"
B_pn-genext2fs = "${SEPB}"
B_pn-genext2fs-native = "${SEPB}"
B_pn-gettext = "${SEPB}"
B_pn-gettext-native = "${SEPB}"
#checking for system lcms2 library... checking for cmsCreateXYZProfile in -llcms2... no
#checking for local lcms library source... configure: error: LittleCMS source not found!
#B_pn-ghostscript = "${SEPB}"
#B_pn-ghostscript-native = "${SEPB}"
# No out of tree build support (manual makefile)
#B_pn-git = "${SEPB}"
#B_pn-git-native = "${SEPB}"
B_pn-glew = "${SEPB}"
B_pn-glib-2.0 = "${SEPB}"
B_pn-glib-2.0-native = "${SEPB}"
B_pn-glib-networking = "${SEPB}"
B_pn-glproto = "${SEPB}"
B_pn-gmp = "${SEPB}"
B_pn-gmp-native = "${SEPB}"
B_pn-gnome-common = "${SEPB}"
B_pn-gnome-common-native = "${SEPB}"
B_pn-gnome-desktop = "${SEPB}"
#B_pn-gnome-doc-utils = "${SEPB}"
#B_pn-gnome-doc-utils-native = "${SEPB}"
B_pn-gnome-icon-theme = "${SEPB}"
B_pn-gnome-mime-data = "${SEPB}"
B_pn-gnupg = "${SEPB}"
## libtool: link: warning: library `.../usr/lib/libgcrypt.la' was moved.
##B_pn-gnutls = "${SEPB}"
B_pn-gnutls-native = "${SEPB}"
B_pn-gperf = "${SEPB}"
B_pn-gperf-native = "${SEPB}"
B_pn-gpgme = "${SEPB}"
B_pn-grep = "${SEPB}"
B_pn-groff = "${SEPB}"
B_pn-groff-native = "${SEPB}"
B_pn-grub = "${SEPB}"
B_pn-grub-efi-i586-native = "${SEPB}"
B_pn-gsettings-desktop-schemas = "${SEPB}"
#| ./config.status: line 2219: /media/build1/poky/build/tmp/work/i586-poky-linux/gst-ffmpeg/0.10.13-r4/build//media/build1/poky/build/tmp/work/i586-poky-linux/gst-ffmpeg/0.10.13-r4/gst-ffmpeg-0.10.13/gst-libs/ext/libav/configure: No such file or directory
#| config.status: error: Failed to configure embedded Libav tree
#B_pn-gst-ffmpeg = "${SEPB}"
B_pn-gst-fluendo-mp3 = "${SEPB}"
B_pn-gst-fluendo-mpegdemux = "${SEPB}"
B_pn-gst-openmax = "${SEPB}"
# Has races/confusion over file/symbolic link creation
#B_pn-gst-plugin-bluetooth = "${SEPB}"
B_pn-gst-plugins-bad = "${SEPB}"
B_pn-gst-plugins-base = "${SEPB}"
B_pn-gst-plugins-gl = "${SEPB}"
B_pn-gst-plugins-good = "${SEPB}"
B_pn-gst-plugins-ugly = "${SEPB}"
B_pn-gstreamer = "${SEPB}"
B_pn-gtk+ = "${SEPB}"
B_pn-gtk+3 = "${SEPB}"
B_pn-gtk-doc-stub = "${SEPB}"
B_pn-gtk-doc-stub-native = "${SEPB}"
B_pn-gtk-engines = "${SEPB}"
##make[1]: *** No rule to make target `data/gtkrc', needed by `all-am'.  Stop
##B_pn-gtk-sato-engine = "${SEPB}"
B_pn-guile = "${SEPB}"
B_pn-guile-native = "${SEPB}"
B_pn-gzip = "${SEPB}"
B_pn-gzip-native = "${SEPB}"
B_pn-harfbuzz = "${SEPB}"
B_pn-harfbuzz-native = "${SEPB}"
B_pn-help2man-native = "${SEPB}"
## Hand coded makefiles don't support out-of-tree
##B_pn-hicolor-icon-theme = "${SEPB}"
B_pn-icon-naming-utils-native = "${SEPB}"
B_pn-icu = "${SEPB}"
B_pn-icu-native = "${SEPB}"
B_pn-inputproto = "${SEPB}"
B_pn-inputproto-native = "${SEPB}"
B_pn-intltool = "${SEPB}"
B_pn-intltool-native = "${SEPB}"
B_pn-iptables = "${SEPB}"
#B_pn-irda-utils = "${SEPB}"
B_pn-jpeg = "${SEPB}"
B_pn-jpeg-native = "${SEPB}"
#B_pn-js = "${SEPB}"
B_pn-json-glib = "${SEPB}"
B_pn-kbd = "${SEPB}"
B_pn-kbd-native = "${SEPB}"
B_pn-kbproto = "${SEPB}"
B_pn-kbproto-native = "${SEPB}"
B_pn-kconfig-frontends = "${SEPB}"
B_pn-kconfig-frontends-native = "${SEPB}"
##kexec-tools-2.0.3/kexec/arch/ppc/Makefile:4: kexec/arch/ppc/libfdt/Makefile.libfdt: No such file or directory
##B_pn-kexec-tools = "${SEPB}"
B_pn-kmod = "${SEPB}"
B_pn-kmod-native = "${SEPB}"
B_pn-lame = "${SEPB}"
B_pn-leafpad = "${SEPB}"
B_pn-less = "${SEPB}"
B_pn-liba52 = "${SEPB}"
#| cat /media/build1/poky/build/tmp/work/i586-poky-linux/libarchive/2.8.5-r0/libarchive-2.8.5/libarchive/test/test_*.c | grep DEFINE_TEST > libarchive/test/list.h
#| cat /media/build1/poky/build/tmp/work/i586-poky-linux/libarchive/2.8.5-r0/libarchive-2.8.5/tar/test/test_*.c | grep DEFINE_TEST > tar/test/list.h
#| cat /media/build1/poky/build/tmp/work/i586-poky-linux/libarchive/2.8.5-r0/libarchive-2.8.5/cpio/test/test_*.c | grep DEFINE_TEST > cpio/test/list.h
#| /bin/bash: tar/test/list.h: No such file or directory
#| /bin/bash: libarchive/test/list.h: No such file or directory
#| /bin/bash: cpio/test/list.h: No such file or directory
#B_pn-libarchive = "${SEPB}"
B_pn-libart-lgpl = "${SEPB}"
B_pn-libassuan = "${SEPB}"
B_pn-libatomics-ops = "${SEPB}"
B_pn-libcgroup = "${SEPB}"
B_pn-libcheck = "${SEPB}"
B_pn-libcroco = "${SEPB}"
B_pn-libdaemon = "${SEPB}"
B_pn-libdmx = "${SEPB}"
B_pn-libdrm = "${SEPB}"
B_pn-libevent = "${SEPB}"
B_pn-libexif = "${SEPB}"
B_pn-libfakekey = "${SEPB}"
B_pn-libffi = "${SEPB}"
B_pn-libffi-native = "${SEPB}"
##i586-poky-linux-libtool: link: cannot find the library `/media/build1/poky/build/tmp/work/i586-poky-linux/libfm/1.1.0-r0/libfm-1.1.0/src/actions/libfmactions.la' or unhandled argument `/media/build1/poky/build/tmp/work/i586-poky-linux/libfm/1.1.0-r0/libfm-1.1.0/src/actions/libfmactions.la'
##B_pn-libfm = "${SEPB}"
B_pn-libfontenc = "${SEPB}"
B_pn-libfontenc-native = "${SEPB}"
B_pn-libgcc = "${SEPB}"
#B_pn-libgcrypt = "${SEPB}"
#B_pn-libgcrypt-native = "${SEPB}"
B_pn-libglade = "${SEPB}"
B_pn-libglu = "${SEPB}"
B_pn-libgpg-error = "${SEPB}"
B_pn-libgpg-error-native = "${SEPB}"
B_pn-libice = "${SEPB}"
B_pn-libice-native = "${SEPB}"
B_pn-libid3tag = "${SEPB}"
B_pn-libidn = "${SEPB}"
B_pn-json-c = "${SEPB}"
B_pn-libksba = "${SEPB}"
B_pn-libmad = "${SEPB}"
B_pn-libmatchbox = "${SEPB}"
B_pn-libmpc = "${SEPB}"
B_pn-libmpc-native = "${SEPB}"
# CMake Error: The source directory "[...]libmusicbrainz-5.0.1[...]/build" does not appear to contain CMakeLists.txt.
#B_pn-libmusicbrainz = "${SEPB}"
# Not automake and no support for out of tree
#B_pn-libnewt = "${SEPB}"
B_pn-libnfsidmap = "${SEPB}"
# flex.real: could not create route/cls/ematch_grammar.c
#B_pn-libnl = "${SEPB}"
B_pn-libnss-mdns = "${SEPB}"
B_pn-libogg = "${SEPB}"
B_pn-liboil = "${SEPB}"
B_pn-libomxil = "${SEPB}"
B_pn-libowl = "${SEPB}"
B_pn-libowl-av = "${SEPB}"
B_pn-libpam = "${SEPB}"
B_pn-libpcap = "${SEPB}"
B_pn-libpciaccess = "${SEPB}"
B_pn-libpcre = "${SEPB}"
B_pn-libpcre-native = "${SEPB}"
B_pn-libpng = "${SEPB}"
B_pn-libpng-native = "${SEPB}"
B_pn-libpthread-stubs = "${SEPB}"
B_pn-libpthread-stubs-native = "${SEPB}"
B_pn-librsvg = "${SEPB}"
B_pn-librsvg-native = "${SEPB}"
B_pn-libsamplerate0 = "${SEPB}"
B_pn-libsdl = "${SEPB}"
B_pn-libsm = "${SEPB}"
B_pn-libsm-native = "${SEPB}"
B_pn-libsndfile1 = "${SEPB}"
B_pn-libsoup-2.4 = "${SEPB}"
B_pn-libtasn1 = "${SEPB}"
B_pn-libtasn1-native = "${SEPB}"
B_pn-libtelepathy = "${SEPB}"
B_pn-libtheora = "${SEPB}"
B_pn-libtirpc = "${SEPB}"
B_pn-libtool = "${SEPB}"
B_pn-libtool-cross = "${SEPB}"
B_pn-libtool-native = "${SEPB}"
B_pn-libunique = "${SEPB}"
B_pn-libunistring = "${SEPB}"
B_pn-libunistring-native = "${SEPB}"
B_pn-liburcu = "${SEPB}"
B_pn-libusb1 = "${SEPB}"
B_pn-libusb1-native = "${SEPB}"
B_pn-libusb-compat = "${SEPB}"
B_pn-libusb-compat-native = "${SEPB}"
B_pn-libuser = "${SEPB}"
B_pn-libva-intel-driver = "${SEPB}"
B_pn-libvorbis = "${SEPB}"
B_pn-libx11 = "${SEPB}"
B_pn-libx11-diet = "${SEPB}"
B_pn-libx11-native = "${SEPB}"
B_pn-libxau = "${SEPB}"
B_pn-libxau-native = "${SEPB}"
B_pn-libxcalibrate = "${SEPB}"
B_pn-libxcb = "${SEPB}"
B_pn-libxcb-native = "${SEPB}"
B_pn-libxcomposite = "${SEPB}"
B_pn-libxcomposite-native = "${SEPB}"
B_pn-libxcursor = "${SEPB}"
B_pn-libxcursor-native = "${SEPB}"
B_pn-libxdamage = "${SEPB}"
B_pn-libxdamage-native = "${SEPB}"
B_pn-libxdmcp = "${SEPB}"
B_pn-libxdmcp-native = "${SEPB}"
B_pn-libxext = "${SEPB}"
B_pn-libxext-native = "${SEPB}"
B_pn-libxfixes = "${SEPB}"
B_pn-libxfixes-native = "${SEPB}"
B_pn-libxfont = "${SEPB}"
B_pn-libxfont-native = "${SEPB}"
B_pn-libxft = "${SEPB}"
B_pn-libxft-native = "${SEPB}"
B_pn-libxi = "${SEPB}"
B_pn-libxinerama = "${SEPB}"
B_pn-libxkbcommon = "${SEPB}"
B_pn-libxkbfile = "${SEPB}"
B_pn-libxkbfile-native = "${SEPB}"
B_pn-libxml2 = "${SEPB}"
B_pn-libxml2-native = "${SEPB}"
B_pn-libxmu = "${SEPB}"
B_pn-libxmu-native = "${SEPB}"
B_pn-libxpm = "${SEPB}"
B_pn-libxpm-native = "${SEPB}"
B_pn-libxrandr = "${SEPB}"
B_pn-libxrandr-native = "${SEPB}"
B_pn-libxrender = "${SEPB}"
B_pn-libxrender-native = "${SEPB}"
B_pn-libxres = "${SEPB}"
B_pn-libxscrnsaver = "${SEPB}"
B_pn-libxsettings-client = "${SEPB}"
B_pn-libxslt = "${SEPB}"
B_pn-libxslt-native = "${SEPB}"
B_pn-libxt = "${SEPB}"
B_pn-libxt-native = "${SEPB}"
B_pn-libxtst = "${SEPB}"
B_pn-libxv = "${SEPB}"
B_pn-libxvmc = "${SEPB}"
B_pn-libxxf86dga = "${SEPB}"
B_pn-libxxf86misc = "${SEPB}"
B_pn-libxxf86vm = "${SEPB}"
B_pn-lighttpd = "${SEPB}"
# Doesn't use automake so no separate build support
#B_pn-linuxdoc-tools-native = "${SEPB}"
B_pn-lrzsz = "${SEPB}"
# Doesn't use automake
#B_pn-ltp = "${SEPB}"
##/media/build1/poky/build1/tmp/work/i586-poky-linux/lttng-tools/v2.1.0-r0/git/tests/tools/health/health_check.c:20:25: fatal error: lttng/lttng.h: No such file or directory
##B_pn-lttng-tools = "${SEPB}"
B_pn-lttng-ust = "${SEPB}"
B_pn-lzo = "${SEPB}"
B_pn-lzo-native = "${SEPB}"
B_pn-lzop = "${SEPB}"
B_pn-lzop-native = "${SEPB}"
B_pn-m4 = "${SEPB}"
B_pn-m4-native = "${SEPB}"
# Makefile only, no out of tree support
#B_pn-mailx = "${SEPB}"
B_pn-make = "${SEPB}"
B_pn-makedepend = "${SEPB}"
B_pn-makedepend-native = "${SEPB}"
B_pn-make-native = "${SEPB}"
B_pn-matchbox-config-gtk = "${SEPB}"
B_pn-matchbox-desktop = "${SEPB}"
B_pn-matchbox-desktop-sato = "${SEPB}"
B_pn-matchbox-keyboard = "${SEPB}"
B_pn-matchbox-panel-2 = "${SEPB}"
B_pn-matchbox-terminal = "${SEPB}"
B_pn-matchbox-theme-sato = "${SEPB}"
B_pn-matchbox-wm = "${SEPB}"
B_pn-mc = "${SEPB}"
#makefile only, no out of tree support
#B_pn-mdadm = "${SEPB}"
B_pn-menu-cache = "${SEPB}"
B_pn-mesa-demos = "${SEPB}"
# src/mapi/mapi/stub.c:51:39: error: 'MAPI_TABLE_NUM_DYNAMIC' undeclared here (not in a function)
B_pn-mesa = "${SEPB}"
B_pn-mesa-gl = "${SEPB}"
B_pn-minicom = "${SEPB}"
# Not automake, no external tree support
#B_pn-mkelfimage = "${SEPB}"
#B_pn-mkelfimage-native = "${SEPB}"
B_pn-mkfontdir = "${SEPB}"
B_pn-mkfontdir-native = "${SEPB}"
B_pn-mkfontscale = "${SEPB}"
B_pn-mkfontscale-native = "${SEPB}"
B_pn-mklibs-native = "${SEPB}"
B_pn-mktemp = "${SEPB}"
B_pn-mobile-broadband-provider-info = "${SEPB}"
B_pn-mpeg2dec = "${SEPB}"
B_pn-mpfr = "${SEPB}"
B_pn-mpfr-native = "${SEPB}"
B_pn-msmtp = "${SEPB}"
B_pn-mtdev = "${SEPB}"
B_pn-mtools = "${SEPB}"
B_pn-mtools-native = "${SEPB}"
B_pn-mx = "${SEPB}"
# /media/build1/poky/build1/tmp/work/x86_64-linux/nasm-native/2.10.07-r0/nasm-2.10.07/compiler.h:47:21: fatal error: config.h: No such file or directory
#B_pn-nasm = "${SEPB}"
#B_pn-nasm-native = "${SEPB}"
B_pn-nativesdk-alsa-lib = "${SEPB}"
B_pn-nativesdk-autoconf = "${SEPB}"
B_pn-nativesdk-automake = "${SEPB}"
B_pn-nativesdk-bash = "${SEPB}"
B_pn-nativesdk-bdwgc = "${SEPB}"
B_pn-nativesdk-bigreqsproto = "${SEPB}"
B_pn-nativesdk-bison = "${SEPB}"
B_pn-nativesdk-bzip2 = "${SEPB}"
B_pn-nativesdk-chrpath = "${SEPB}"
B_pn-nativesdk-cmake = "${SEPB}"
B_pn-nativesdk-curl = "${SEPB}"
B_pn-nativesdk-db = "${SEPB}"
B_pn-nativesdk-dbus = "${SEPB}"
## Makefile based not autotools
##B_pn-nativesdk-dtc = "${SEPB}"
B_pn-nativesdk-eglibc = "${SEPB}"
B_pn-nativesdk-eglibc-initial = "${SEPB}"
B_pn-nativesdk-elfutils = "${SEPB}"
B_pn-nativesdk-expat = "${SEPB}"
B_pn-nativesdk-fixesproto = "${SEPB}"
B_pn-nativesdk-flex = "${SEPB}"
B_pn-nativesdk-gcc-runtime = "${SEPB}"
B_pn-nativesdk-gdbm = "${SEPB}"
B_pn-nativesdk-genext2fs = "${SEPB}"
B_pn-nativesdk-gettext = "${SEPB}"
B_pn-nativesdk-glib-2.0 = "${SEPB}"
B_pn-nativesdk-glproto = "${SEPB}"
B_pn-nativesdk-gmp = "${SEPB}"
B_pn-nativesdk-inputproto = "${SEPB}"
B_pn-nativesdk-kbproto = "${SEPB}"
#B_pn-nativesdk-libarchive = "${SEPB}"
B_pn-nativesdk-libffi = "${SEPB}"
B_pn-nativesdk-libgcc = "${SEPB}"
B_pn-nativesdk-libmpc = "${SEPB}"
B_pn-nativesdk-libpcre = "${SEPB}"
B_pn-nativesdk-libpng = "${SEPB}"
B_pn-nativesdk-libpthread-stubs = "${SEPB}"
B_pn-nativesdk-libsdl = "${SEPB}"
B_pn-nativesdk-libtool = "${SEPB}"
B_pn-nativesdk-libunistring = "${SEPB}"
B_pn-nativesdk-libusb1 = "${SEPB}"
B_pn-nativesdk-libusb-compat = "${SEPB}"
B_pn-nativesdk-libx11 = "${SEPB}"
B_pn-nativesdk-libxau = "${SEPB}"
B_pn-nativesdk-libxcb = "${SEPB}"
B_pn-nativesdk-libxdmcp = "${SEPB}"
B_pn-nativesdk-libxext = "${SEPB}"
B_pn-nativesdk-libxfixes = "${SEPB}"
B_pn-nativesdk-libxml2 = "${SEPB}"
B_pn-nativesdk-libxrandr = "${SEPB}"
B_pn-nativesdk-libxrender = "${SEPB}"
B_pn-nativesdk-lzo = "${SEPB}"
B_pn-nativesdk-lzop = "${SEPB}"
B_pn-nativesdk-m4 = "${SEPB}"
B_pn-nativesdk-mpfr = "${SEPB}"
B_pn-nativesdk-ncurses = "${SEPB}"
B_pn-nativesdk-opkg = "${SEPB}"
B_pn-nativesdk-pixman = "${SEPB}"
B_pn-nativesdk-pkgconfig = "${SEPB}"
# run.do_compile: 89: cd: can't cd to Lib/plat-linux2
#B_pn-nativesdk-python = "${SEPB}"
##B_pn-nativesdk-qemu = "${SEPB}"
B_pn-nativesdk-randrproto = "${SEPB}"
B_pn-nativesdk-readline = "${SEPB}"
B_pn-nativesdk-renderproto = "${SEPB}"
B_pn-nativesdk-sqlite3 = "${SEPB}"
B_pn-nativesdk-systemtap = "${SEPB}"
# Not automake, no out of tree build support
#B_pn-nativesdk-unfs3 = "${SEPB}"
B_pn-nativesdk-util-macros = "${SEPB}"
B_pn-nativesdk-xcb-proto = "${SEPB}"
B_pn-nativesdk-xcmiscproto = "${SEPB}"
B_pn-nativesdk-xextproto = "${SEPB}"
B_pn-nativesdk-xproto = "${SEPB}"
B_pn-nativesdk-xtrans = "${SEPB}"
B_pn-ncurses = "${SEPB}"
B_pn-ncurses-native = "${SEPB}"
B_pn-neon = "${SEPB}"
B_pn-neon-native = "${SEPB}"
##Weird as configure exits with error code despite apparent success
##B_pn-nfs-utils = "${SEPB}"
B_pn-npth = "${SEPB}"
#B_pn-nspr = "${SEPB}"
B_pn-ofono = "${SEPB}"
B_pn-oh-puzzles = "${SEPB}"
## make[2]: openjade-1.3.2/grove/../Makefile.comm: No such file or directory
##B_pn-openjade-native = "${SEPB}"
B_pn-opensp = "${SEPB}"
B_pn-opensp-native = "${SEPB}"
##/media/build1/poky/build1/tmp/work/i586-poky-linux/openssh/6.1p1-r0/openssh-6.1p1/configure: line 5674: syntax error near unexpected token `-Wall'
##/media/build1/poky/build1/tmp/work/i586-poky-linux/openssh/6.1p1-r0/openssh-6.1p1/configure: line 5674: `	OSSH_CHECK_CFLAG_COMPILE(-Wall)'
##Configure failed. The contents of all config.log files follows to aid debugging
#B_pn-openssh = "${SEPB}"
B_pn-openvpn = "${SEPB}"
B_pn-opkg = "${SEPB}"
B_pn-opkg-native = "${SEPB}"
#B_pn-oprofile = "${SEPB}"
B_pn-oprofileui = "${SEPB}"
B_pn-oprofileui-server = "${SEPB}"
B_pn-ossp-uuid = "${SEPB}"
B_pn-ossp-uuid-native = "${SEPB}"
B_pn-owl-video = "${SEPB}"
B_pn-pango = "${SEPB}"
B_pn-pango-native = "${SEPB}"
B_pn-parted = "${SEPB}"
B_pn-parted-native = "${SEPB}"
B_pn-patch = "${SEPB}"
B_pn-pax = "${SEPB}"
B_pn-pcmanfm = "${SEPB}"
B_pn-pixman = "${SEPB}"
B_pn-pixman-native = "${SEPB}"
B_pn-pkgconfig = "${SEPB}"
B_pn-pkgconfig-native = "${SEPB}"
B_pn-pm-utils = "${SEPB}"
B_pn-polkit = "${SEPB}"
B_pn-polkit-gnome = "${SEPB}"
B_pn-popt = "${SEPB}"
B_pn-popt-native = "${SEPB}"
#B_pn-ppp = "${SEPB}"
B_pn-prelink = "${SEPB}"
B_pn-prelink-native = "${SEPB}"
# Makefile only, no out of tree support
#B_pn-procps = "${SEPB}"
B_pn-psmisc = "${SEPB}"
B_pn-psplash = "${SEPB}"
B_pn-pth = "${SEPB}"
B_pn-pulseaudio = "${SEPB}"
#B_pn-python = "${SEPB}"
B_pn-python-dbus = "${SEPB}"
B_pn-python-gst = "${SEPB}"
B_pn-python-native = "${SEPB}"
B_pn-python-pygobject = "${SEPB}"
B_pn-python-pygobject-native = "${SEPB}"
B_pn-python-pygtk = "${SEPB}"
## Not autotools
##B_pn-qemu = "${SEPB}"
##B_pn-qemu-native = "${SEPB}"
##| /bin/bash: ./git-desc: No such file or directory
##| /usr/bin/find: `compat': No such file or directory
##| /bin/bash: /media/build1/poky/build1/tmp/work/x86_64-linux/quilt-native/0.60-r0/build/test/test.quiltrc: No such file or directory
##| make: *** No rule to make target `Makefile.in', needed by `Makefile'.  Stop.
##B_pn-quilt = "${SEPB}"
##B_pn-quilt-native = "${SEPB}"
#B_pn-quota = "${SEPB}"
B_pn-randrproto = "${SEPB}"
B_pn-randrproto-native = "${SEPB}"
B_pn-readline = "${SEPB}"
B_pn-readline-native = "${SEPB}"
B_pn-recordproto = "${SEPB}"
B_pn-remake = "${SEPB}"
B_pn-remake-native = "${SEPB}"
B_pn-renderproto = "${SEPB}"
B_pn-renderproto-native = "${SEPB}"
B_pn-resourceproto = "${SEPB}"
B_pn-rgb = "${SEPB}"
B_pn-rpcbind = "${SEPB}"
B_pn-rpm = "${SEPB}"
B_pn-rpm-native = "${SEPB}"
B_pn-rsync = "${SEPB}"
B_pn-rxvt-unicode = "${SEPB}"
B_pn-sato-icon-theme = "${SEPB}"
B_pn-sato-screenshot = "${SEPB}"
B_pn-sbc = "${SEPB}"
B_pn-screen = "${SEPB}"
B_pn-scrnsaverproto = "${SEPB}"
B_pn-sed = "${SEPB}"
B_pn-sed-native = "${SEPB}"
# Wierd out of tree support, could probably be fixed
#i586-poky-linux-gcc: error: setserial.c: No such file or directory
#i586-poky-linux-gcc: fatal error: no input files
#compilation terminated.
#B_pn-setserial = "${SEPB}"
B_pn-settings-daemon = "${SEPB}"
B_pn-sgml-common = "${SEPB}"
B_pn-sgml-common-native = "${SEPB}"
B_pn-shadow = "${SEPB}"
B_pn-shadow-native = "${SEPB}"
B_pn-shared-mime-info = "${SEPB}"
B_pn-shared-mime-info-native = "${SEPB}"
##configure: error: "This software does not support configuring from another directory.   See the INSTALL file"
##B_pn-slang = "${SEPB}"
B_pn-socat = "${SEPB}"
B_pn-speex = "${SEPB}"
B_pn-sqlite3 = "${SEPB}"
B_pn-sqlite3-native = "${SEPB}"
B_pn-startup-notification = "${SEPB}"
B_pn-strace = "${SEPB}"
B_pn-strace-native = "${SEPB}"
B_pn-subversion = "${SEPB}"
B_pn-subversion-native = "${SEPB}"
B_pn-sudo = "${SEPB}"
B_pn-sysfsutils = "${SEPB}"
B_pn-sysprof = "${SEPB}"
# No automake, no separate build support
#B_pn-sysstat = "${SEPB}"
B_pn-systemd = "${SEPB}"
B_pn-systemtap = "${SEPB}"
B_pn-systemtap-native = "${SEPB}"
B_pn-tar = "${SEPB}"
B_pn-tar-replacement-native = "${SEPB}"
B_pn-tcl = "${SEPB}"
B_pn-tcl-native = "${SEPB}"
B_pn-telepathy-glib = "${SEPB}"
B_pn-telepathy-idle = "${SEPB}"
B_pn-telepathy-mission-control = "${SEPB}"
B_pn-telepathy-python = "${SEPB}"
B_pn-texi2html = "${SEPB}"
B_pn-texinfo = "${SEPB}"
B_pn-texinfo-native = "${SEPB}"
B_pn-tiff = "${SEPB}"
B_pn-tiff-native = "${SEPB}"
B_pn-time = "${SEPB}"
B_pn-tremor = "${SEPB}"
B_pn-tslib = "${SEPB}"
B_pn-udev = "${SEPB}"
# Not automake, no out of tree build support
#B_pn-unfs3-native = "${SEPB}"
B_pn-usbutils = "${SEPB}"
B_pn-util-linux = "${SEPB}"
B_pn-util-linux-native = "${SEPB}"
B_pn-util-macros = "${SEPB}"
B_pn-util-macros-native = "${SEPB}"
B_pn-valgrind = "${SEPB}"
B_pn-videoproto = "${SEPB}"
B_pn-vte = "${SEPB}"
B_pn-watchdog = "${SEPB}"
B_pn-wayland = "${SEPB}"
B_pn-wayland-native = "${SEPB}"
# Not even going there
#B_pn-webkit-gtk = "${SEPB}"
B_pn-weston = "${SEPB}"
B_pn-wget = "${SEPB}"
B_pn-which = "${SEPB}"
B_pn-x11perf = "${SEPB}"
#B_pn-x11vnc = "${SEPB}"
B_pn-xauth = "${SEPB}"
B_pn-xcb-proto = "${SEPB}"
B_pn-xcb-proto-native = "${SEPB}"
B_pn-xcb-util = "${SEPB}"
B_pn-xcb-util-image = "${SEPB}"
B_pn-xcb-util-keysyms = "${SEPB}"
B_pn-xcb-util-renderutil = "${SEPB}"
B_pn-xcb-util-wm = "${SEPB}"
B_pn-xcmiscproto = "${SEPB}"
B_pn-xcmiscproto-native = "${SEPB}"
B_pn-xcursor-transparent-theme = "${SEPB}"
# No out of tree support, no automake
#/usr/bin/install: cannot stat `xdg-desktop-menu': No such file or directory
#/usr/bin/install: cannot stat `xdg-desktop-icon': No such file or directory
#/usr/bin/install: cannot stat `xdg-mime': No such file or directory
#/usr/bin/install: cannot stat `xdg-icon-resource': No such file or directory
#/usr/bin/install: cannot stat `xdg-open': No such file or directory
#/usr/bin/install: cannot stat `xdg-email': No such file or directory
#/usr/bin/install: cannot stat `xdg-screensaver': No such file or directory
#make[1]: *** [install] Error 1
#Probably fixable
#B_pn-xdg-utils = "${SEPB}"
B_pn-xdpyinfo = "${SEPB}"
B_pn-xev = "${SEPB}"
B_pn-xextproto = "${SEPB}"
B_pn-xextproto-native = "${SEPB}"
B_pn-xeyes = "${SEPB}"
B_pn-xf86dgaproto = "${SEPB}"
B_pn-xf86driproto = "${SEPB}"
B_pn-xf86-input-evdev = "${SEPB}"
B_pn-xf86-input-keyboard = "${SEPB}"
B_pn-xf86-input-mouse = "${SEPB}"
B_pn-xf86-input-synaptics = "${SEPB}"
B_pn-xf86-input-vmmouse = "${SEPB}"
B_pn-xf86miscproto = "${SEPB}"
B_pn-xf86-video-fbdev = "${SEPB}"
B_pn-xf86-video-imxfb = "${SEPB}"
B_pn-xf86-video-intel = "${SEPB}"
B_pn-xf86-video-mga = "${SEPB}"
B_pn-xf86-video-modesetting = "${SEPB}"
B_pn-xf86-video-omap = "${SEPB}"
B_pn-xf86-video-omapfb = "${SEPB}"
B_pn-xf86-video-vesa = "${SEPB}"
B_pn-xf86-video-vmware = "${SEPB}"
B_pn-xf86vidmodeproto = "${SEPB}"
B_pn-xhost = "${SEPB}"
B_pn-xineramaproto = "${SEPB}"
B_pn-xinetd = "${SEPB}"
B_pn-xinit = "${SEPB}"
B_pn-xinput = "${SEPB}"
B_pn-xkbcomp = "${SEPB}"
B_pn-xkbcomp-native = "${SEPB}"
B_pn-xkeyboard-config = "${SEPB}"
B_pn-xmodmap = "${SEPB}"
B_pn-xprop = "${SEPB}"
B_pn-xproto = "${SEPB}"
B_pn-xproto-native = "${SEPB}"
B_pn-xrandr = "${SEPB}"
B_pn-xrestop = "${SEPB}"
B_pn-xserver-xorg = "${SEPB}"
B_pn-xset = "${SEPB}"
B_pn-xtrans = "${SEPB}"
B_pn-xtrans-native = "${SEPB}"
B_pn-xtscal = "${SEPB}"
B_pn-xvideo-tests = "${SEPB}"
B_pn-xvinfo = "${SEPB}"
B_pn-xwininfo = "${SEPB}"
B_pn-xz = "${SEPB}"
B_pn-xz-native = "${SEPB}"
B_pn-yasm = "${SEPB}"
B_pn-yasm-native = "${SEPB}"
B_pn-zaurusd = "${SEPB}"

# Recipes that cannot by design use a separate build directory:
# wpa-supplicant
```

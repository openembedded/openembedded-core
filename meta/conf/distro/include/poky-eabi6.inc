## meta/conf/distro/include/private/distro_misc.inc
```bitbake
RECIPE_STATUS_pn-libical="green"
RECIPE_LATEST_VERSION_pn-libical="0.44"
RECIPE_NO_OF_PATCHES_pn-libical="0"
RECIPE_LATEST_RELEASE_DATE_pn-libical="2009/09/27"
RECIPE_TIME_BETWEEN_LAST_TWO_RELEASES_pn-libical="8 months"
RECIPE_MAINTAINER_pn-libical = "Dongxiao Xu <dongxiao.xu@intel.com>"

RECIPE_STATUS_pn-task-base="green"
RECIPE_LATEST_VERSION_pn-task-base="1.0"
RECIPE_NO_OF_PATCHES_pn-task-base="0"
RECIPE_LATEST_RELEASE_DATE_pn-task-base="n/a"
RECIPE_TIME_BETWEEN_LAST_TWO_RELEASES_pn-task-base="n/a"
RECIPE_MAINTAINER_pn-task-base = "Dongxiao Xu <dongxiao.xu@intel.com>"

RECIPE_STATUS_pn-task-poky-boot="green"
RECIPE_LATEST_VERSION_pn-task-poky-boot="1.0"
RECIPE_NO_OF_PATCHES_pn-task-poky-boot="0"
RECIPE_LATEST_RELEASE_DATE_pn-task-poky-boot="n/a"
RECIPE_TIME_BETWEEN_LAST_TWO_RELEASES_pn-task-poky-boot="n/a"
RECIPE_MAINTAINER_pn-task-poky-boot = "Dongxiao Xu <dongxiao.xu@intel.com>"

RECIPE_STATUS_pn-task-poky-nfs="green"
RECIPE_LATEST_VERSION_pn-task-poky-nfs="1.0"
RECIPE_NO_OF_PATCHES_pn-task-poky-nfs="0"
RECIPE_LATEST_RELEASE_DATE_pn-task-poky-nfs="n/a"
RECIPE_TIME_BETWEEN_LAST_TWO_RELEASES_pn-task-poky-nfs="n/a"
RECIPE_MAINTAINER_pn-task-poky-nfs = "Dongxiao Xu <dongxiao.xu@intel.com>"

RECIPE_STATUS_pn-task-poky-tools="green"
RECIPE_LATEST_VERSION_pn-task-poky-tools="1.0"
RECIPE_NO_OF_PATCHES_pn-task-poky-tools="0"
RECIPE_LATEST_RELEASE_DATE_pn-task-poky-tools="n/a"
RECIPE_TIME_BETWEEN_LAST_TWO_RELEASES_pn-task-poky-tools="n/a"
RECIPE_MAINTAINER_pn-task-poky-tools = "Dongxiao Xu <dongxiao.xu@intel.com>"

RECIPE_STATUS_pn-gst-meta-base="green"
DISTRO_PN_ALIAS_pn-gst-meta-base = "Meego=gstreamer Fedora=gstreamer OpenSuSE=gstreamer Ubuntu=gstreamer0.10 Mandriva=gstreamer0.10 Debian=gstreamer0.10"
RECIPE_LATEST_VERSION_pn-gst-meta-base="0.10"
RECIPE_NO_OF_PATCHES_pn-gst-meta-base="0"
RECIPE_LATEST_RELEASE_DATE_pn-gst-meta-base="n/a"
RECIPE_TIME_BETWEEN_LAST_TWO_RELEASES_pn-gst-meta-base="n/a"
RECIPE_MAINTAINER_pn-gst-meta-base = "Dongxiao Xu <dongxiao.xu@intel.com>"

RECIPE_STATUS_pn-task-poky-apps-x11-pimlico="green"
RECIPE_LATEST_VERSION_pn-task-poky-apps-x11-pimlico="1.0"
RECIPE_NO_OF_PATCHES_pn-task-poky-apps-x11-pimlico="0"
RECIPE_LATEST_RELEASE_DATE_pn-task-poky-apps-x11-pimlico="n/a"
RECIPE_TIME_BETWEEN_LAST_TWO_RELEASES_pn-task-poky-apps-x11-pimlico="n/a"
RECIPE_MAINTAINER_pn-task-poky-apps-x11-pimlico = "Dongxiao Xu <dongxiao.xu@intel.com>"

RECIPE_STATUS_pn-task-poky-x11-sato="green"
RECIPE_LATEST_VERSION_pn-task-poky-x11-sato="1.0"
RECIPE_NO_OF_PATCHES_pn-task-poky-x11-sato="0"
RECIPE_LATEST_RELEASE_DATE_pn-task-poky-x11-sato="n/a"
RECIPE_TIME_BETWEEN_LAST_TWO_RELEASES_pn-task-poky-x11-sato="n/a"
RECIPE_MAINTAINER_pn-task-poky-x11-sato = "Dongxiao Xu <dongxiao.xu@intel.com>"

RECIPE_STATUS_pn-enchant="green"
RECIPE_LATEST_VERSION_pn-enchant="1.6.0"
RECIPE_NO_OF_PATCHES_pn-enchant="0"
RECIPE_LATEST_RELEASE_DATE_pn-enchant="2010/04/01"
RECIPE_TIME_BETWEEN_LAST_TWO_RELEASES_pn-enchant="10 months"
RECIPE_MAINTAINER_pn-enchant = "Dongxiao Xu <dongxiao.xu@intel.com>"

RECIPE_STATUS_pn-task-moblin = "red"
RECIPE_LATEST_VERSION_pn-task-moblin = "1.0"
RECIPE_MAINTAINER_pn-task-moblin = "Dongxiao Xu <dongxiao.xu@intel.com>"

RECIPE_STATUS_pn-task-moblin-apps-x11-pimlico = "red"
RECIPE_LATEST_VERSION_pn-task-moblin-apps-x11-pimlico = "1.0"
RECIPE_MAINTAINER_pn-task-moblin-apps-x11-pimlico = "Dongxiao Xu <dongxiao.xu@intel.com>"

RECIPE_STATUS_pn-task-moblin-boot = "red"
RECIPE_LATEST_VERSION_pn-task-moblin-boot = "1.0"
RECIPE_MAINTAINER_pn-task-moblin-boot = "Dongxiao Xu <dongxiao.xu@intel.com>"

RECIPE_STATUS_pn-task-moblin-sdk = "red"
RECIPE_LATEST_VERSION_pn-task-moblin-sdk = "1.0"
RECIPE_MAINTAINER_pn-task-moblin-sdk = "Dongxiao Xu <dongxiao.xu@intel.com>"

RECIPE_STATUS_pn-task-moblin-standalone-sdk-target = "red"
RECIPE_LATEST_VERSION_pn-task-moblin-standalone-sdk-target = "1.0"
RECIPE_MAINTAINER_pn-task-moblin-standalone-sdk-target = "Dongxiao Xu <dongxiao.xu@intel.com>"

RECIPE_STATUS_pn-task-moblin-tools = "red"
RECIPE_LATEST_VERSION_pn-task-moblin-tools = "1.0"
RECIPE_MAINTAINER_pn-task-moblin-tools = "Dongxiao Xu <dongxiao.xu@intel.com>"

RECIPE_STATUS_pn-task-moblin-x11-netbook = "red"
RECIPE_LATEST_VERSION_pn-task-moblin-x11-netbook = "1.0"
RECIPE_MAINTAINER_pn-task-moblin-x11-netbook = "Dongxiao Xu <dongxiao.xu@intel.com>"

RECIPE_STATUS_pn-task-poky-sdk = "red"
RECIPE_LATEST_VERSION_pn-task-poky-sdk = "1.0"
RECIPE_MAINTAINER_pn-task-poky-sdk = "Dongxiao Xu <dongxiao.xu@intel.com>"

RECIPE_STATUS_pn-task-poky-sdk-gmae = "red"
RECIPE_LATEST_VERSION_pn-task-poky-sdk-gmae = "1.0"
RECIPE_MAINTAINER_pn-task-poky-sdk-gmae = "Dongxiao Xu <dongxiao.xu@intel.com>"

RECIPE_STATUS_pn-task-poky-standalone-gmae-sdk-target = "red"
RECIPE_LATEST_VERSION_pn-task-poky-standalone-gmae-sdk-target = "1.0"
RECIPE_MAINTAINER_pn-task-poky-standalone-gmae-sdk-target = "Dongxiao Xu <dongxiao.xu@intel.com>"

RECIPE_STATUS_pn-task-poky-standalone-sdk-target = "red"
RECIPE_LATEST_VERSION_pn-task-poky-standalone-sdk-target = "1.0"
RECIPE_MAINTAINER_pn-task-poky-standalone-sdk-target = "Dongxiao Xu <dongxiao.xu@intel.com>"

RECIPE_STATUS_pn-task-poky-x11-netbook = "red"
RECIPE_LATEST_VERSION_pn-task-poky-x11-netbook = "1.0"
RECIPE_MAINTAINER_pn-task-poky-x11-netbook = "Dongxiao Xu <dongxiao.xu@intel.com>"

RECIPE_STATUS_pn-xerces-c = "red"
RECIPE_LATEST_VERSION_pn-xerces-c = "3.1.1"
RECIPE_MAINTAINER_pn-xerces-c = "Dongxiao Xu <dongxiao.xu@intel.com>"

RECIPE_STATUS_pn-xournal = "red"
RECIPE_LATEST_VERSION_pn-xournal = "0.4.5"
RECIPE_MAINTAINER_pn-xournal = "Dongxiao Xu <dongxiao.xu@intel.com>"

RECIPE_STATUS_pn-carrick = "red"
RECIPE_LATEST_VERSION_pn-carrick = "1.0"
RECIPE_MAINTAINER_pn-carrick = "Dongxiao Xu <dongxiao.xu@intel.com>"

RECIPE_STATUS_pn-wv = "red"
RECIPE_LATEST_VERSION_pn-wv = "1.2.1"
RECIPE_MAINTAINER_pn-wv = "Dongxiao Xu <dongxiao.xu@intel.com>"

RECIPE_STATUS_pn-poky-image-minimal = "green"
RECIPE_LATEST_VERSION_pn-poky-image-minimal = "1.0"
RECIPE_MAINTAINER_pn-poky-image-minimal = "Dongxiao Xu <dongxiao.xu@intel.com>"

RECIPE_STATUS_pn-poky-image-minimal-directdisk = "green"
RECIPE_LATEST_VERSION_pn-poky-image-minimal-directdisk = "1.0"
RECIPE_MAINTAINER_pn-poky-image-minimal-directdisk = "Dongxiao Xu <dongxiao.xu@intel.com>"

RECIPE_STATUS_pn-poky-image-minimal-initramfs = "green"
RECIPE_LATEST_VERSION_pn-poky-image-minimal-initramfs = "1.0"
RECIPE_MAINTAINER_pn-poky-image-minimal-initramfs = "Dongxiao Xu <dongxiao.xu@intel.com>"

RECIPE_STATUS_pn-poky-image-minimal-live = "green"
RECIPE_LATEST_VERSION_pn-poky-image-minimal-live = "1.0"
RECIPE_MAINTAINER_pn-poky-image-minimal-live = "Dongxiao Xu <dongxiao.xu@intel.com>"

RECIPE_STATUS_pn-poky-image-minimal-mtdutils = "green"
RECIPE_LATEST_VERSION_pn-poky-image-minimal-mtdutils = "1.0"
RECIPE_MAINTAINER_pn-poky-image-minimal-mtdutils = "Dongxiao Xu <dongxiao.xu@intel.com>"

RECIPE_STATUS_pn-poky-image-basic = "green"
RECIPE_LATEST_VERSION_pn-poky-image-basic = "1.0"
RECIPE_MAINTAINER_pn-poky-image-basic = "Dongxiao Xu <dongxiao.xu@intel.com>"

RECIPE_STATUS_pn-poky-image-sato = "green"
RECIPE_LATEST_VERSION_pn-poky-image-sato = "1.0"
RECIPE_MAINTAINER_pn-poky-image-sato = "Dongxiao Xu <dongxiao.xu@intel.com>"

RECIPE_STATUS_pn-poky-image-sato-directdisk = "green"
RECIPE_LATEST_VERSION_pn-poky-image-sato-directdisk = "1.0"
RECIPE_MAINTAINER_pn-poky-image-sato-directdisk = "Dongxiao Xu <dongxiao.xu@intel.com>"

RECIPE_STATUS_pn-poky-image-sato-live = "green"
RECIPE_LATEST_VERSION_pn-poky-image-sato-live = "1.0"
RECIPE_MAINTAINER_pn-poky-image-sato-live = "Dongxiao Xu <dongxiao.xu@intel.com>"

RECIPE_STATUS_pn-poky-image-lsb = "green"
RECIPE_LATEST_VERSION_pn-poky-image-lsb = "1.0"
RECIPE_MAINTAINER_pn-poky-image-lsb = "Dongxiao Xu <dongxiao.xu@intel.com>"

RECIPE_STATUS_pn-poky-image-sdk = "green"
RECIPE_LATEST_VERSION_pn-poky-image-sdk = "1.0"
RECIPE_MAINTAINER_pn-poky-image-sdk = "Dongxiao Xu <dongxiao.xu@intel.com>"

RECIPE_STATUS_pn-task-poky = "green"
RECIPE_LATEST_VERSION_pn-task-poky = "1.0"
RECIPE_MAINTAINER_pn-task-poky = "Dongxiao Xu <dongxiao.xu@intel.com>"

RECIPE_STATUS_pn-task-poky-minimal = "green"
RECIPE_LATEST_VERSION_pn-task-poky-minimal = "1.0"
RECIPE_MAINTAINER_pn-task-poky-minimal = "Dongxiao Xu <dongxiao.xu@intel.com>"

RECIPE_STATUS_pn-task-poky-basic = "green"
RECIPE_LATEST_VERSION_pn-task-poky-basic = "1.0"
RECIPE_MAINTAINER_pn-task-poky-basic = "Dongxiao Xu <dongxiao.xu@intel.com>"

RECIPE_STATUS_pn-task-poky-sato = "green"
RECIPE_LATEST_VERSION_pn-task-poky-sato = "1.0"
RECIPE_MAINTAINER_pn-task-poky-sato = "Dongxiao Xu <dongxiao.xu@intel.com>"

RECIPE_STATUS_pn-task-poky-lsb = "green"
RECIPE_LATEST_VERSION_pn-task-poky-lsb = "1.0"
RECIPE_MAINTAINER_pn-task-poky-lsb = "Dongxiao Xu <dongxiao.xu@intel.com>"

RECIPE_STATUS_pn-task-sdk-host = "green"
RECIPE_LATEST_VERSION_pn-task-sdk-host = "1.0"
RECIPE_MAINTAINER_pn-task-sdk-host = "Dongxiao Xu <dongxiao.xu@intel.com>"

RECIPE_STATUS_pn-task-poky-qt = "green"
RECIPE_LATEST_VERSION_pn-task-poky-qt = "1.0"
RECIPE_MAINTAINER_pn-task-poky-qt = "Dongxiao Xu <dongxiao.xu@intel.com>"

RECIPE_STATUS_pn-poky-image-base = "green"
RECIPE_LATEST_VERSION_pn-poky-image-base = "1.0"
RECIPE_MAINTAINER_pn-poky-image-base = "Dongxiao Xu <dongxiao.xu@intel.com>"

RECIPE_STATUS_pn-poky-image-core = "green"
RECIPE_LATEST_VERSION_pn-poky-image-core = "1.0"
RECIPE_MAINTAINER_pn-poky-image-core = "Dongxiao Xu <dongxiao.xu@intel.com>"

RECIPE_STATUS_pn-poky-image-sdk-live = "green"
RECIPE_LATEST_VERSION_pn-poky-image-sdk-live = "1.0"
RECIPE_MAINTAINER_pn-poky-image-sdk-live = "Dongxiao Xu <dongxiao.xu@intel.com>"

RECIPE_STATUS_pn-poky-moblin-proto = "red"
RECIPE_LATEST_VERSION_pn-poky-image-sdk-live = "check"
RECIPE_MAINTAINER_pn-poky-image-sdk-live = "Dongxiao Xu <dongxiao.xu@intel.com>"

RECIPE_STATUS_pn-poky-image-sdk-live = "green"
RECIPE_LATEST_VERSION_pn-poky-image-sdk-live = "1.0"
RECIPE_MAINTAINER_pn-poky-image-sdk-live = "Dongxiao Xu <dongxiao.xu@intel.com>"

RECIPE_STATUS_pn-poky-image-sdk-live = "green"
RECIPE_LATEST_VERSION_pn-poky-image-sdk-live = "1.0"
RECIPE_MAINTAINER_pn-poky-image-sdk-live = "Dongxiao Xu <dongxiao.xu@intel.com>"
```

## meta/conf/distro/include/private/distro_base_utils_2.inc
```bitbake
RECIPE_STATUS_pn-time = "green"
RECIPE_MAINTAINER_pn-time = "Qing He <qing.he@intel.com>"
DEPENDENCY_CHECK_pn-time = "not done"
RECIPE_LATEST_VERSION_pn-time = "1.7"
RECIPE_INTEL_SECTION_pn-time = "base utils"
RECIPE_TIME_BETWEEN_LAST_TWO_RELEASES_pn-time = "n/a"
RECIPE_LATEST_RELEASE_DATE_pn-time = "07/1996"
RECIPE_COMMENTS_pn-time = ""

RECIPE_STATUS_pn-bzip2 = "yellow"  # local config scripts
RECIPE_MAINTAINER_pn-bzip2 = "Qing He <qing.he@intel.com>"
DEPENDENCY_CHECK_pn-bzip2 = "not done"
RECIPE_LATEST_VERSION_pn-bzip2 = "1.0.5"
RECIPE_PATCH_pn-bzip2+configure.ac = "override default build method"
RECIPE_PATCH_pn-bzip2+Makefile.am = "override default build method"
RECIPE_INTEL_SECTION_pn-bzip2 = "base utils"
RECIPE_TIME_BETWEEN_LAST_TWO_RELEASES_pn-bzip2 = "12 months"
RECIPE_LATEST_RELEASE_DATE_pn-bzip2 = "03/2008"
RECIPE_COMMENTS_pn-bzip2 = "bzip2 license is 3-clause BSD plus an renaming clause"

RECIPE_STATUS_pn-portmap = "yellow"
RECIPE_MAINTAINER_pn-portmap = "Qing He <qing.he@intel.com>"
DEPENDENCY_CHECK_pn-portmap = "not done"
RECIPE_LATEST_VERSION_pn-portmap = "6.0"
RECIPE_PATCH_pn-portmap+dest-dir-no-strip = "override default build method"
RECIPE_PATCH_pn-portmap+no-libwrap = "override default build method"
RECIPE_PATCH_pn-portmap+no-tcpd-support = "override default build method"
RECIPE_INTEL_SECTION_pn-portmap = "base utils"
RECIPE_TIME_BETWEEN_LAST_TWO_RELEASES_pn-portmap = "n/a"
RECIPE_LATEST_RELEASE_DATE_pn-portmap = "05/2007"
RECIPE_COMMENTS_pn-portmap = "most part is under 4-clause BSD, Sun RPC code is under another license, \
however debian portmap package licenses RPC code under 3-clause BSD. This needs further investigation"

RECIPE_STATUS_pn-grub = "green"
RECIPE_MAINTAINER_pn-grub = "Qing He <qing.he@intel.com>"
DEPENDENCY_CHECK_pn-grub = "not done"
RECIPE_LATEST_VERSION_pn-grub = "0.97"
RECIPE_PATCH_pn-grub+autohell = "fix configure"
RECIPE_INTEL_SECTION_pn-grub = "base utils"
RECIPE_TIME_BETWEEN_LAST_TWO_RELEASES_pn-grub = "n/a"
RECIPE_LATEST_RELEASE_DATE_pn-grub = "12/2005"
RECIPE_COMMENTS_pn-grub = ""

RECIPE_STATUS_pn-yum = "yellow"    # unused patch files
RECIPE_MAINTAINER_pn-yum = "Qing He <qing.he@intel.com>"
DEPENDENCY_CHECK_pn-yum = "not done"
RECIPE_LATEST_VERSION_pn-yum = "3.2.27"
RECIPE_PATCH_pn-yum+paths = "allow custom lib path"
RECIPE_PATCH_pn-yum+paths2 = "fix python lib path"
RECIPE_PATCH_pn-yum+yum-install-recommends.py = "poky package system"
RECIPE_PATCH_pn-yum+extract-postinst.awk = "poky package system"
RECIPE_PATCH_pn-yum+98_yum = "used by populate-volatile"
RECIPE_INTEL_SECTION_pn-yum = "base utils"
RECIPE_TIME_BETWEEN_LAST_TWO_RELEASES_pn-yum = "1 month"
RECIPE_LATEST_RELEASE_DATE_pn-yum = "03/2010"
RECIPE_COMMENTS_pn-yum = "most files are under GPLv2+, but yum/sqlutils.py is under GPLv2"

RECIPE_STATUS_pn-update-rc.d = "green"
RECIPE_MAINTAINER_pn-update-rc.d = "Qing He <qing.he@intel.com>"
DEPENDENCY_CHECK_pn-update-rc.d = "not done"
RECIPE_LATEST_VERSION_pn-update-rc.d = "0.7"
RECIPE_PATCH_pn-update-rc.d+add-verbose = "add verbosity"
RECIPE_INTEL_SECTION_pn-update-rc.d = "base utils"
RECIPE_TIME_BETWEEN_LAST_TWO_RELEASES_pn-update-rc.d = "n/a"
RECIPE_LATEST_RELEASE_DATE_pn-update-rc.d = "unknown"
RECIPE_COMMENTS_pn-update-rc.d = ""

RECIPE_STATUS_pn-update-modules = "green"
RECIPE_MAINTAINER_pn-update-modules = "Qing He <qing.he@intel.com>"
DEPENDENCY_CHECK_pn-update-modules = "not done"
RECIPE_LATEST_VERSION_pn-update-modules = "1.0"
RECIPE_PATCH_pn-update-modules+update-modules = "local file"
RECIPE_INTEL_SECTION_pn-update-modules = "base utils"
RECIPE_TIME_BETWEEN_LAST_TWO_RELEASES_pn-update-modules = "n/a"
RECIPE_LATEST_RELEASE_DATE_pn-update-modules = "n/a"
RECIPE_COMMENTS_pn-update-modules = ""

RECIPE_STATUS_pn-udev-extraconf = "green"
RECIPE_MAINTAINER_pn-udev-extraconf = "Qing He <qing.he@intel.com>"
DEPENDENCY_CHECK_pn-udev-extraconf = "not done"
RECIPE_LATEST_VERSION_pn-udev-extraconf = "0.0"
RECIPE_PATCH_pn-udev-extraconf+mount.blacklist = "add mount blacklist"
RECIPE_INTEL_SECTION_pn-udev-extraconf = "base utils"
RECIPE_TIME_BETWEEN_LAST_TWO_RELEASES_pn-udev-extraconf = "n/a"
RECIPE_LATEST_RELEASE_DATE_pn-udev-extraconf = "n/a"
RECIPE_COMMENTS_pn-udev-extraconf = ""

RECIPE_STATUS_pn-bash = "green"
RECIPE_MAINTAINER_pn-bash = "Qing He <qing.he@intel.com>"
DEPENDENCY_CHECK_pn-bash = "not done"
RECIPE_LATEST_VERSION_pn-bash = "4.1"
RECIPE_PATCH_pn-bash+upstream-patches = "upstream patches on source mirrors"
RECIPE_INTEL_SECTION_pn-bash = "base utils"
RECIPE_TIME_BETWEEN_LAST_TWO_RELEASES_pn-bash = "10 months"
RECIPE_LATEST_RELEASE_DATE_pn-bash = "12/2009"
RECIPE_COMMENTS_pn-bash = ""

RECIPE_STATUS_pn-syslinux = "yellow"    # need mangling on LDFLAGS
RECIPE_MAINTAINER_pn-syslinux = "Qing He <qing.he@intel.com>"
DEPENDENCY_CHECK_pn-syslinux = "not done"
RECIPE_LATEST_VERSION_pn-syslinux = "3.86"
RECIPE_PATCH_pn-syslinux+cross-build = "use poky toolchain instead of host"
RECIPE_INTEL_SECTION_pn-syslinux = "base utils"
RECIPE_TIME_BETWEEN_LAST_TWO_RELEASES_pn-syslinux = "2 months"
RECIPE_LATEST_RELEASE_DATE_pn-syslinux = "04/2010"
RECIPE_COMMENTS_pn-syslinux = ""

RECIPE_STATUS_pn-sysvinit = "green"
RECIPE_MAINTAINER_pn-sysvinit = "Qing He <qing.he@intel.com>"
DEPENDENCY_CHECK_pn-sysvinit = "not done"
RECIPE_LATEST_VERSION_pn-sysvinit = "2.88dsf"
RECIPE_PATCH_pn-sysvinit+install = "use poky environment variables"
RECIPE_INTEL_SECTION_pn-sysvinit = "base utils"
RECIPE_TIME_BETWEEN_LAST_TWO_RELEASES_pn-sysvinit = "9 months"
RECIPE_LATEST_RELEASE_DATE_pn-sysvinit = "04/2010"
RECIPE_COMMENTS_pn-sysvinit = ""

RECIPE_STATUS_pn-sysfsutils = "green"
RECIPE_MAINTAINER_pn-sysfsutils = "Qing He <qing.he@intel.com>"
DEPENDENCY_CHECK_pn-sysfsutils = "not done"
RECIPE_LATEST_VERSION_pn-sysfsutils = "2.1.0"
RECIPE_INTEL_SECTION_pn-sysfsutils = "base utils"
RECIPE_TIME_BETWEEN_LAST_TWO_RELEASES_pn-sysfsutils = "n/a"
RECIPE_LATEST_RELEASE_DATE_pn-sysfsutils = "08/2006"
RECIPE_COMMENTS_pn-sysfsutils = ""

RECIPE_STATUS_pn-curl = "green"
RECIPE_MAINTAINER_pn-curl = "Qing He <qing.he@intel.com>"
DEPENDENCY_CHECK_pn-curl = "not done"
RECIPE_LATEST_VERSION_pn-curl = "7.21.0"
RECIPE_PATCH_pn-curl+noldlibpath = "no bother set LD_LIBRARY_PATH since we are cross compiling"
RECIPE_PATCH_pn-curl+pkgconfig-fix = "fix libcurl.pc"
RECIPE_INTEL_SECTION_pn-curl = "base utils"
RECIPE_TIME_BETWEEN_LAST_TWO_RELEASES_pn-curl = "2 months"
RECIPE_LATEST_RELEASE_DATE_pn-curl = "06/2010"
RECIPE_COMMENTS_pn-curl = ""

RECIPE_STATUS_pn-gconf-dbus = "green"
DISTRO_PN_ALIAS_pn-gconf-dbus = "Meego=GConf-dbus"
RECIPE_MAINTAINER_pn-gconf-dbus = "Ke Yu <ke.yu@intel.com>"
DEPENDENCY_CHECK_pn-gconf-dbus = "not done"
RECIPE_LATEST_VERSION_pn-gconf-dbus = "2.16.0+svnr705"
RECIPE_INTEL_SECTION_pn-gconf-dbus = "base utils"
RECIPE_TIME_BETWEEN_LAST_TWO_RELEASES_pn-gconf-dbus = "n/a"
RECIPE_LATEST_RELEASE_DATE_pn-gconf-dbus = "n/a"
RECIPE_COMMENTS_pn-gconf-dbus = "difficult to identify official site and current status"

RECIPE_STATUS_pn-elfutils="green" # no update needed
RECIPE_MAINTAINER_pn-elfutils="green" = "Qing He <qing.he@intel.com>"
DEPENDENCY_CHECK_pn-gconf-dbus = "not done"
RECIPE_LATEST_VERSION_pn-elfutils="0.148"
RECIPE_INTEL_SECTION_pn-gconf-dbus = "base utils"
RECIPE_NO_OF_PATCHES_pn-elfutils="9"
RECIPE_TIME_BETWEEN_LAST_TWO_RELEASES_pn-elfutils="1 month"
RECIPE_LATEST_RELEASE_DATE_pn-elfutils="06/2010"

RECIPE_STATUS_pn-pkgconfig = "green"
RECIPE_MAINTAINER_pn-pkgconfig = "Qing He <qing.he@intel.com>"
DEPENDENCY_CHECK_pn-pkgconfig = "not done"
RECIPE_LATEST_VERSION_pn-pkgconfig = "0.25"
RECIPE_INTEL_SECTION_pn-pkgconfig = "base utils"
RECIPE_TIME_BETWEEN_LAST_TWO_RELEASES_pn-pkgconfig = "n/a"
RECIPE_LATEST_RELEASE_DATE_pn-pkgconfig = "05/2010"
RECIPE_COMMENTS_pn-pkgconfig = "git as candidate, 0.23: 01/2008, 0.24: 05/2010, 0.25: 05/2010"

RECIPE_STATUS_pn-less = "green"
RECIPE_MAINTAINER_pn-less = "Qing He <qing.he@intel.com>"
DEPENDENCY_CHECK_pn-less = "done"
RECIPE_LATEST_VERSION_pn-less = "436"
RECIPE_INTEL_SECTION_pn-less = "base utils"
RECIPE_TIME_BETWEEN_LAST_TWO_RELEASES_pn-less = "1 month"
RECIPE_LATEST_RELEASE_DATE_pn-less = "07/2009"
RECIPE_COMMENTS_pn-less = "also licensed under less, which is a 2-clause BSD-like permissive license"

RECIPE_STATUS_pn-genext2fs = "green"
RECIPE_MAINTAINER_pn-genext2fs = "Qing He <qing.he@intel.com>"
DEPENDENCY_CHECK_pn-genext2fs = "not done"
RECIPE_LATEST_VERSION_pn-genext2fs = "1.4.1"
RECIPE_INTEL_SECTION_pn-genext2fs = "base utils"
RECIPE_TIME_BETWEEN_LAST_TWO_RELEASES_pn-genext2fs = "3 months"
RECIPE_LATEST_RELEASE_DATE_pn-genext2fs = "04/2007"
RECIPE_COMMENTS_pn-genext2fs = ""

RECIPE_STATUS_pn-findutils = "green"
RECIPE_MAINTAINER_pn-findutils = "Qing He <qing.he@intel.com>"
DEPENDENCY_CHECK_pn-findutils = "not done"
RECIPE_PATCH_pn-findutils_01-27017 = "upstream patch"
RECIPE_PATCH_pn-findutils_01-28824 = "upstream patch"
RECIPE_PATCH_pn-findutils_01-28872 = "upstream patch"
RECIPE_LATEST_VERSION_pn-findutils = "4.4.2"
RECIPE_INTEL_SECTION_pn-findutils = "base utils"
RECIPE_TIME_BETWEEN_LAST_TWO_RELEASES_pn-findutils = "2 months"
RECIPE_LATEST_RELEASE_DATE_pn-findutils = "06/2009"
RECIPE_COMMENTS_pn-findutils = ""

RECIPE_STATUS_pn-file = "green"
RECIPE_MAINTAINER_pn-file = "Qing He <qing.he@intel.com>"
DEPENDENCY_CHECK_pn-file = "done"
RECIPE_LATEST_VERSION_pn-file = "5.04"
RECIPE_PATCH_pn-file+dump = "some new magic data"
RECIPE_PATCH_pn-file+filesystems = "some other new magic data"
RECIPE_INTEL_SECTION_pn-file = "base utils"
RECIPE_TIME_BETWEEN_LAST_TWO_RELEASES_pn-file = "8 months"
RECIPE_LATEST_RELEASE_DATE_pn-file = "01/2010"
RECIPE_COMMENTS_pn-file = "2-clause BSD"

RECIPE_STATUS_pn-rsync = "green"
RECIPE_MAINTAINER_pn-rsync = "Qing He <qing.he@intel.com>"
DEPENDENCY_CHECK_pn-rsync = "done"
RECIPE_LATEST_VERSION_pn-rsync = "3.0.7"
RECIPE_PATCH_pn-rsync+rsyncd.conf = "init script"
RECIPE_PATCH_pn-rsync+acinclude.m4 = "custom m4 macros"
RECIPE_INTEL_SECTION_pn-rsync = "base utils"
RECIPE_TIME_BETWEEN_LAST_TWO_RELEASES_pn-rsync = "7 months"
RECIPE_LATEST_RELEASE_DATE_pn-rsync = "12/2009"
RECIPE_COMMENTS_pn-rsync = ""

RECIPE_STATUS_pn-nfs-utils = "yellow"   # no auto stage
RECIPE_MAINTAINER_pn-nfs-utils = "Qing He <qing.he@intel.com>"
DEPENDENCY_CHECK_pn-nfs-utils = "done"  # still missing libwrap, libgss, libtirpc
RECIPE_LATEST_VERSION_pn-nfs-utils = "1.2.2"
RECIPE_PATCH_pn-nfs-utils+nfs-utils-1.0.6-uclibc.patch = "uclibc missing some functions"
RECIPE_PATCH_pn-nfs-utils+nfsserver = "init script"
RECIPE_INTEL_SECTION_pn-nfs-utils = "base utils"
RECIPE_TIME_BETWEEN_LAST_TWO_RELEASES_pn-nfs-utils = "3 months"
RECIPE_LATEST_RELEASE_DATE_pn-nfs-utils = "02/2010"
RECIPE_COMMENTS_pn-nfs-utils = ""

RECIPE_STATUS_pn-dropbear = "green"
RECIPE_MAINTAINER_pn-dropbear = "Qing He <qing.he@intel.com>"
DEPENDENCY_CHECK_pn-dropbear = "not done"
RECIPE_LATEST_VERSION_pn-dropbear = "0.52"
RECIPE_PATCH_pn-dropbear+urandom-xauth-changes-to-options.h = "xauth path change"
RECIPE_PATCH_pn-dropbear+configure = "use configure cache value for cross compiling"
RECIPE_PATCH_pn-dropbear+fix-skb-keys = "enlarge key buffer size"
RECIPE_PATCH_pn-dropbear+allow-nopw = "allow login with no password, applied on in occasions"
RECIPE_PATCH_pn-dropbear+init = "init script"
RECIPE_INTEL_SECTION_pn-dropbear = "base utils"
RECIPE_TIME_BETWEEN_LAST_TWO_RELEASES_pn-dropbear = "8 months"
RECIPE_LATEST_RELEASE_DATE_pn-dropbear = "11/2008"
RECIPE_COMMENTS_pn-dropbear = ""

RECIPE_STATUS_pn-hal = "green"
RECIPE_MAINTAINER_pn-hal = "Qing He <qing.he@intel.com>"
DEPENDENCY_CHECK_pn-hal = "not done"
RECIPE_LATEST_VERSION_pn-hal = "0.5.14"
RECIPE_INTEL_SECTION_pn-hal = "base utils"
RECIPE_TIME_BETWEEN_LAST_TWO_RELEASES_pn-hal = "4 months"
RECIPE_LATEST_RELEASE_DATE_pn-hal = "11/2009"
RECIPE_COMMENTS_pn-hal = "The licensing is very complicated, Most files are GPLv2+ | AFL \
with some borrowed code under LGPLv2.1, AFL itself is incompatible with GPL/LGPL"

RECIPE_STATUS_pn-hal-info = "green"
RECIPE_MAINTAINER_pn-hal-info = "Qing He <qing.he@intel.com>"
DEPENDENCY_CHECK_pn-hal-info = "not done"
RECIPE_LATEST_VERSION_pn-hal-info = "20091130"
RECIPE_INTEL_SECTION_pn-hal-info = "base utils"
RECIPE_TIME_BETWEEN_LAST_TWO_RELEASES_pn-hal-info = "4 months"
RECIPE_LATEST_RELEASE_DATE_pn-hal-info = "11/2009"
RECIPE_COMMENTS_pn-hal-info = ""

RECIPE_STATUS_pn-avahi = "green"
RECIPE_MAINTAINER_pn-avahi = "Edwin Zhai <edwin.zhai@intel.com>"
DEPENDENCY_CHECK_pn-avahi = "not done"
RECIPE_LATEST_VERSION_pn-avahi = "0.6.27"
RECIPE_INTEL_SECTION_pn-avahi = "base utils"
RECIPE_TIME_BETWEEN_LAST_TWO_RELEASES_pn-avahi = "1 month"
RECIPE_LATEST_RELEASE_DATE_pn-avahi = "07/2010"
RECIPE_COMMENTS_pn-avahi = ""

RECIPE_STATUS_pn-js = "yellow"    # may not work for platforms other than 32bit x86
RECIPE_MAINTAINER_pn-js = "Qing He <qing.he@intel.com>"
DEPENDENCY_CHECK_pn-js = "not done"
RECIPE_LATEST_VERSION_pn-js = "1.7.0+1.8.0rc1"
RECIPE_PATCH_pn-js+usepic = "get around broken PIC test for cross compiling"
RECIPE_PATCH_pn-js+link-with-gcc = "use $(CC) instead of $(LD) to link"
RECIPE_PATCH_pn-js+jsautocfg.h = "architecture specified configurations"
RECIPE_INTEL_SECTION_pn-js = "base utils"
RECIPE_TIME_BETWEEN_LAST_TWO_RELEASES_pn-js = "11 months"
RECIPE_LATEST_RELEASE_DATE_pn-js = "03/2009"
RECIPE_COMMENTS_pn-js = "1.7.0 is 10/2007, alternative java based packaged called Rhino"

RECIPE_STATUS_pn-pcmciautils = "green"
RECIPE_MAINTAINER_pn-pcmciautils = "Qing He <qing.he@intel.com>"
DEPENDENCY_CHECK_pn-pcmciautils = "not done"
RECIPE_LATEST_VERSION_pn-pcmciautils = "017"
RECIPE_PATCH_pn-pcmciautils+makefile-fix = "fix absolute path"
RECIPE_PATCH_pn-pcmciautils+version-workaround = "avoid a macro"
RECIPE_INTEL_SECTION_pn-pcmciautils = "base utils"
RECIPE_TIME_BETWEEN_LAST_TWO_RELEASES_pn-pcmciautils = "3 months"
RECIPE_LATEST_RELEASE_DATE_pn-pcmciautils = "01/2010"
RECIPE_COMMENTS_pn-pcmciautils = ""

RECIPE_STATUS_pn-unzip = "green"
RECIPE_MAINTAINER_pn-unzip = "Qing He <qing.he@intel.com>"
DEPENDENCY_CHECK_pn-unzip = "not done"
RECIPE_LATEST_VERSION_pn-unzip = "6.0"
RECIPE_INTEL_SECTION_pn-unzip = "base utils"
RECIPE_TIME_BETWEEN_LAST_TWO_RELEASES_pn-unzip = "49 months"
RECIPE_LATEST_RELEASE_DATE_pn-unzip = "04/2009"
RECIPE_COMMENTS_pn-unzip = "5.52 has a race condition vulnerability for Unix version"

RECIPE_STATUS_pn-zip = "green"
RECIPE_MAINTAINER_pn-zip = "Qing He <qing.he@intel.com>"
DEPENDENCY_CHECK_pn-zip = "not done"
RECIPE_LATEST_VERSION_pn-zip = "3.0"
RECIPE_INTEL_SECTION_pn-zip = "base utils"
RECIPE_TIME_BETWEEN_LAST_TWO_RELEASES_pn-zip = "21 months"
RECIPE_LATEST_RELEASE_DATE_pn-zip = "09/2009"
RECIPE_COMMENTS_pn-zip = ""

RECIPE_STATUS_pn-strace = "green"
RECIPE_MAINTAINER_pn-strace = "Qing He <qing.he@intel.com>"
DEPENDENCY_CHECK_pn-strace = "not done"
RECIPE_LATEST_VERSION_pn-strace = "4.5.20"
RECIPE_INTEL_SECTION_pn-strace = "base utils"
RECIPE_TIME_BETWEEN_LAST_TWO_RELEASES_pn-strace = "6 months"
RECIPE_LATEST_RELEASE_DATE_pn-strace = "04/2010"
RECIPE_COMMENTS_pn-strace = "3-clause BSD"

RECIPE_STATUS_pn-dhcp = "green"
RECIPE_MAINTAINER_pn-dhcp = "Qing He <qing.he@intel.com>"
DEPENDENCY_CHECK_pn-dhcp = "not done"
RECIPE_LATEST_VERSION_pn-dhcp = "4.1.1-P1"
RECIPE_INTEL_SECTION_pn-dhcp = "base utils"
RECIPE_TIME_BETWEEN_LAST_TWO_RELEASES_pn-dhcp = "n/a"
RECIPE_LATEST_RELEASE_DATE_pn-dhcp = "06/2010"
RECIPE_COMMENTS_pn-dhcp = "several major release, others are 3.1.3, 4.0.2-P1, need to identify"

RECIPE_STATUS_pn-v86d = "yellow"   # self written configure
RECIPE_MAINTAINER_pn-v86d = "Qing He <qing.he@intel.com>"
DEPENDENCY_CHECK_pn-v86d = "not done"
RECIPE_LATEST_VERSION_pn-v86d = "0.1.9"
RECIPE_PATCH_pn-v86d+fbsetup = "init script"
RECIPE_INTEL_SECTION_pn-v86d = "base utils"
RECIPE_TIME_BETWEEN_LAST_TWO_RELEASES_pn-v86d = "1 month"
RECIPE_LATEST_RELEASE_DATE_pn-v86d = "10/2008"
RECIPE_COMMENTS_pn-v86d = "contains code under other licenses"

RECIPE_STATUS_pn-udev = "yellow"   # needs to delete old versions
RECIPE_MAINTAINER_pn-udev = "Qing He <qing.he@intel.com>"
DEPENDENCY_CHECK_pn-udev = "not done"
RECIPE_LATEST_VERSION_pn-udev = "158"
RECIPE_INTEL_SECTION_pn-udev = "base utils"
RECIPE_TIME_BETWEEN_LAST_TWO_RELEASES_pn-udev = "<1 month"
RECIPE_LATEST_RELEASE_DATE_pn-udev = "06/2010"
RECIPE_COMMENTS_pn-udev = "may need different versions for different kernels"

RECIPE_STATUS_pn-tzdata = "green"
RECIPE_MAINTAINER_pn-tzdata = "Qing He <qing.he@intel.com>"
DEPENDENCY_CHECK_pn-tzdata = "not done"
RECIPE_LATEST_VERSION_pn-tzdata = "2010j"
RECIPE_INTEL_SECTION_pn-tzdata = "base utils"
RECIPE_TIME_BETWEEN_LAST_TWO_RELEASES_pn-tzdata = "1 month"
RECIPE_LATEST_RELEASE_DATE_pn-tzdata = "05/2010"
RECIPE_COMMENTS_pn-tzdata = ""

RECIPE_STATUS_pn-tinylogin = "yellow"    # replaced, place holder for tracking
RECIPE_MAINTAINER_pn-tinylogin = "Qing He <qing.he@intel.com>"
DEPENDENCY_CHECK_pn-tinylogin = "not done"
RECIPE_LATEST_VERSION_pn-tinylogin = "1.4"
RECIPE_INTEL_SECTION_pn-tinylogin = "base utils"
RECIPE_TIME_BETWEEN_LAST_TWO_RELEASES_pn-tinylogin = "n/a"
RECIPE_LATEST_RELEASE_DATE_pn-tinylogin = "n/a"
RECIPE_COMMENTS_pn-tinylogin = "merged into busybox"

RECIPE_STATUS_pn-spectrum-fw = "green"   # need upgrade
RECIPE_MAINTAINER_pn-spectrum-fw = "Ke Yu <ke.yu@intel.com>"
DEPENDENCY_CHECK_pn-spectrum-fw = "not done"
RECIPE_LATEST_VERSION_pn-spectrum-fw = "1.0"
RECIPE_INTEL_SECTION_pn-spectrum-fw = "base utils"
RECIPE_TIME_BETWEEN_LAST_TWO_RELEASES_pn-spectrum-fw = "n/a"
RECIPE_LATEST_RELEASE_DATE_pn-spectrum-fw = "n/a"
RECIPE_COMMENTS_pn-spectrum-fw = "difficult to identify official site and current status"

RECIPE_STATUS_pn-rpm = "red"   # need upgrade
RECIPE_MAINTAINER_pn-rpm = "Joshua Lock <joshua.lock@intel.com>"
DEPENDENCY_CHECK_pn-rpm = "not done"
RECIPE_LATEST_VERSION_pn-rpm = "4.8.0"
RECIPE_INTEL_SECTION_pn-rpm = "base utils"
RECIPE_TIME_BETWEEN_LAST_TWO_RELEASES_pn-rpm = "2 months"
RECIPE_LATEST_RELEASE_DATE_pn-rpm = "01/2010"
RECIPE_COMMENTS_pn-rpm = "the library alone is under dual license"

RECIPE_STATUS_pn-shared-mime-info = "green"
RECIPE_MAINTAINER_pn-shared-mime-info = "Qing He <qing.he@intel.com>"
DEPENDENCY_CHECK_pn-shared-mime-info = "not done"
RECIPE_LATEST_VERSION_pn-shared-mime-info = "0.71"
RECIPE_INTEL_SECTION_pn-shared-mime-info = "base utils"
RECIPE_TIME_BETWEEN_LAST_TWO_RELEASES_pn-shared-mime-info = "5 months"
RECIPE_LATEST_RELEASE_DATE_pn-shared-mime-info = "02/2010"
RECIPE_COMMENTS_pn-shared-mime-info = ""

RECIPE_STATUS_pn-util-linux = "green"
RECIPE_MAINTAINER_pn-util-linux = "Qing He <qing.he@intel.com>"
DEPENDENCY_CHECK_pn-util-linux = "note done"
RECIPE_LATEST_VERSION_pn-util-linux = "2.17.2"
RECIPE_INTEL_SECTION_pn-util-linux = "base utils"
RECIPE_TIME_BETWEEN_LAST_TWO_RELEASES_pn-util-linux = "2 months"
RECIPE_LATEST_RELEASE_DATE_pn-util-linux = "03/2010"
RECIPE_COMMENTS_pn-util-linux = ""

RECIPE_STATUS_pn-usbutils = "green"
RECIPE_MAINTAINER_pn-usbutils = "Qing He <qing.he@intel.com>"
DEPENDENCY_CHECK_pn-usbutils = "done"
RECIPE_LATEST_VERSION_pn-usbutils = "0.86"
RECIPE_INTEL_SECTION_pn-usbutils = "base utils"
RECIPE_TIME_BETWEEN_LAST_TWO_RELEASES_pn-usbutils = "2 months"
RECIPE_LATEST_RELEASE_DATE_pn-usbutils = "08/2009"
RECIPE_COMMENTS_pn-usbutils = ""

RECIPE_STATUS_pn-pciutils = "yellow"    # custom build system, several hacks
RECIPE_MAINTAINER_pn-pciutils = "Qing He <qing.he@intel.com>"
DEPENDENCY_CHECK_pn-pciutils = "done"
RECIPE_LATEST_VERSION_pn-pciutils = "3.1.5"
RECIPE_PATCH_pn-pciutils+configure = "fix for a handwritten config"
RECIPE_PATCH_pn-pciutils+guess-fix = "fix arch guess algorithm"
RECIPE_PATCH_pn-pciutils+pcimodules-pciutils = "add pcimodules util"
RECIPE_PATCH_pn-pciutils+lib-build-fix = "fix shared library build"
RECIPE_INTEL_SECTION_pn-pciutils = "base utils"
RECIPE_TIME_BETWEEN_LAST_TWO_RELEASES_pn-pciutils = "5 months"
RECIPE_LATEST_RELEASE_DATE_pn-pciutils = "01/2010"
RECIPE_COMMENTS_pn-pciutils = ""

RECIPE_STATUS_pn-gamin = "green"
RECIPE_MAINTAINER_pn-gamin = "Qing He <qing.he@intel.com>"
DEPENDENCY_CHECK_pn-gamin = "done"
RECIPE_LATEST_VERSION_pn-gamin = "0.1.10"
RECIPE_PATCH_pn-gamin+no-abstract-socket = "disable abstract socket support"
RECIPE_INTEL_SECTION_pn-gamin = "base utils"
RECIPE_TIME_BETWEEN_LAST_TWO_RELEASES_pn-gamin = "16 months"
RECIPE_LATEST_RELEASE_DATE_pn-gamin = "11/2008"
RECIPE_COMMENTS_pn-gamin = ""

RECIPE_STATUS_pn-sysstat = "red"    # need upgrade
RECIPE_MAINTAINER_pn-sysstat = "Qing He <qing.he@intel.com>"
RECIPE_LATEST_VERSION_pn-sysstat = "9.0.6.1"

RECIPE_STATUS_pn-sysklogd = "red"    # need upgrade
RECIPE_MAINTAINER_pn-sysklogd = "Qing He <qing.he@intel.com>"
RECIPE_LATEST_VERSION_pn-sysklogd = "1.5"

RECIPE_STATUS_pn-gawk = "red"    # need upgrade
RECIPE_MAINTAINER_pn-gawk = "Qing He <qing.he@intel.com>"
RECIPE_LATEST_VERSION_pn-gawk = "3.1.7"

RECIPE_STATUS_pn-mktemp="red"
RECIPE_MAINTAINER_pn-mktemp="Yu Ke <ke.yu@intel.com>"
RECIPE_LATEST_VERSION_pn-mktemp="1.7"

RECIPE_STATUS_pn-iputils="red"
RECIPE_MAINTAINER_pn-iputils="Yu Ke <ke.yu@intel.com>"
RECIPE_LATEST_VERSION_pn-iputils="s20100418"

RECIPE_STATUS_pn-xinetd="red"
RECIPE_MAINTAINER_pn-xinetd="Yu Ke <ke.yu@intel.com>"
RECIPE_LATEST_VERSION_pn-xinetd="2.3.14"

RECIPE_STATUS_pn-cracklib="red"
RECIPE_MAINTAINER_pn-cracklib="Yu Ke <ke.yu@intel.com>"
RECIPE_LATEST_VERSION_pn-cracklib="2.8.16"

RECIPE_STATUS_pn-openobex = "red"
RECIPE_LATEST_VERSION_pn-openobex = "1.5"
RECIPE_MAINTAINER_pn-openobex = "Qing He <qing.he@intel.com>"

RECIPE_STATUS_pn-sessreg = "red"
RECIPE_LATEST_VERSION_pn-sessreg = "1.0.5"
RECIPE_MAINTAINER_pn-sessreg = "Qing He <qing.he@intel.com>"

RECIPE_STATUS_pn-packagekit = "red"
RECIPE_LATEST_VERSION_pn-packagekit = "0.6.3"
RECIPE_MAINTAINER_pn-packagekit = "Qing He <qing.he@intel.com>"

RECIPE_STATUS_pn-sed = "red"
RECIPE_LATEST_VERSION_pn-sed = "4.2.1"
RECIPE_MAINTAINER_pn-sed = "Qing He <qing.he@intel.com>"

RECIPE_STATUS_pn-aspell = "red"
RECIPE_LATEST_VERSION_pn-aspell = "0.60.6"
RECIPE_MAINTAINER_pn-aspell = "Qing He <qing.he@intel.com>"

RECIPE_STATUS_pn-parted = "red"
RECIPE_LATEST_VERSION_pn-parted = "2.3"
RECIPE_MAINTAINER_pn-parted = "Qing He <qing.he@intel.com>"

RECIPE_STATUS_pn-resolvconf = "red"
RECIPE_LATEST_VERSION_pn-resolvconf = "1.45"
RECIPE_MAINTAINER_pn-resolvconf = "Qing He <qing.he@intel.com>"

RECIPE_STATUS_pn-openswan = "red"
RECIPE_LATEST_VERSION_pn-openswan = "2.6.26"
RECIPE_MAINTAINER_pn-openswan = "Qing He <qing.he@intel.com>"

RECIPE_STATUS_pn-u-boot-mkimage = "red"
DISTRO_PN_ALIAS_pn-u-boot-mkimage = "Ubuntu=uboot-mkimage Debian=uboot-mkimage"
RECIPE_LATEST_VERSION_pn-u-boot-mkimage = "2010.03"
RECIPE_MAINTAINER_pn-u-boot-mkimage = "Qing He <qing.he@intel.com>"

RECIPE_STATUS_pn-zaurusd = "red"
RECIPE_LATEST_VERSION_pn-zaurusd = "n/a"
RECIPE_MAINTAINER_pn-zaurusd = "Qing He <qing.he@intel.com>"

RECIPE_STATUS_pn-yaffs2-utils = "red"
RECIPE_LATEST_VERSION_pn-yaffs2-utils = ""
RECIPE_MAINTAINER_pn-yaffs2-utils = "Qing He <qing.he@intel.com>"

RECIPE_STATUS_pn-usbinit = "red"
RECIPE_LATEST_VERSION_pn-usbinit = "n/a"
RECIPE_MAINTAINER_pn-usbinit = "Qing He <qing.he@intel.com>"

RECIPE_STATUS_pn-ubootchart = "red"
RECIPE_LATEST_VERSION_pn-ubootchart = "0.0+r12"
RECIPE_MAINTAINER_pn-ubootchart = "Qing He <qing.he@intel.com>"

RECIPE_STATUS_pn-tracker = "red"
RECIPE_LATEST_VERSION_pn-tracker = "0.9.6"
RECIPE_MAINTAINER_pn-tracker = "Qing He <qing.he@intel.com>"

RECIPE_STATUS_pn-tiff = "red"
RECIPE_LATEST_VERSION_pn-tiff = "3.9.2"
RECIPE_MAINTAINER_pn-tiff = "Qing He <qing.he@intel.com>"

RECIPE_STATUS_pn-syncevolution = "red"
RECIPE_LATEST_VERSION_pn-syncevolution = "0.9.1"
RECIPE_MAINTAINER_pn-syncevolution = "Qing He <qing.he@intel.com>"

RECIPE_STATUS_pn-libexif = "red"
RECIPE_LATEST_VERSION_pn-libexif = "0.6.19"
RECIPE_MAINTAINER_pn-libexif = "Qing He <qing.he@intel.com>"

RECIPE_STATUS_pn-setserial = "red"
RECIPE_LATEST_VERSION_pn-setserial = "2.17"
RECIPE_MAINTAINER_pn-setserial = "Qing He <qing.he@intel.com>"

RECIPE_STATUS_pn-hdparm = "red"
RECIPE_LATEST_VERSION_pn-hdparm = "9.28"
RECIPE_MAINTAINER_pn-hdparm = "Qing He <qing.he@intel.com>"

RECIPE_STATUS_pn-wbxml2 = "red"
RECIPE_LATEST_VERSION_pn-wbxml2 = "0.10.8"
RECIPE_MAINTAINER_pn-wbxml2 = "Qing He <qing.he@intel.com>"

RECIPE_STATUS_pn-sreadahead = "red"
RECIPE_LATEST_VERSION_pn-sreadahead = "1.0"
RECIPE_MAINTAINER_pn-sreadahead = "Qing He <qing.he@intel.com>"

RECIPE_STATUS_pn-smart = "red"
RECIPE_LATEST_VERSION_pn-smart = "1.3"
RECIPE_MAINTAINER_pn-smart = "Qing He <qing.he@intel.com>"

RECIPE_STATUS_pn-qemu-config = "red"
RECIPE_LATEST_VERSION_pn-qemu-config = "n/a"
RECIPE_MAINTAINER_pn-qemu-config = "Qing He <qing.he@intel.com>"
```

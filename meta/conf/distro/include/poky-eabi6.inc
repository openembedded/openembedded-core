## meta/conf/distro/include/private/distro_fix.inc
```bitbake
RECIPE_STATUS_pn-acpid ?= "red" # not audited
RECIPE_LATEST_VERSION_pn-acpid ?= "1.0.10"

RECIPE_STATUS_pn-beecrypt ?= "red" # not audited
RECIPE_LATEST_VERSION_pn-beecrypt ?= "4.2.1"

RECIPE_STATUS_pn-boost ?= "red" # not audited
RECIPE_LATEST_VERSION_pn-boost ?= "1.43.0"

RECIPE_STATUS_pn-check ?= "red" # not audited
RECIPE_LATEST_VERSION_pn-check ?= "0.9.8"

RECIPE_STATUS_pn-latencytop ?= "red" # not audited
RECIPE_LATEST_VERSION_pn-latencytop ?= "0.5"

RECIPE_STATUS_pn-libacpi ?= "red" # not audited
RECIPE_LATEST_VERSION_pn-libacpi ?= "0.2"

RECIPE_STATUS_pn-smart ?= "red" # not audited
RECIPE_LATEST_VERSION_pn-smart ?= "1.3"

RECIPE_STATUS_pn-subversion ?= "red" # not audited
RECIPE_LATEST_VERSION_pn-subversion ?= "1.6.12"

RECIPE_STATUS_pn-libfribidi ?= "red" # not audited
RECIPE_LATEST_VERSION_pn-libfribidi ?= "0.19.2"

RECIPE_STATUS_pn-fuse ?= "red" # not audited
RECIPE_LATEST_VERSION_pn-fuse ?= "2.8.4"

RECIPE_STATUS_pn-gst-fluendo-mp3 ?= "red" # not audited
RECIPE_LATEST_VERSION_pn-gst-fluendo-mp3 ?= "0.10.10"

RECIPE_STATUS_pn-gst-fluendo-mpegdemux ?= "red" # not audited
RECIPE_LATEST_VERSION_pn-gst-fluendo-mpegdemux ?= "0.10.23"

RECIPE_STATUS_pn-libxklavier ?= "red" # not audited
RECIPE_LATEST_VERSION_pn-libxklavier ?= "5.0"

RECIPE_STATUS_pn-hdparm ?= "red" # not audited
RECIPE_LATEST_VERSION_pn-hdparm ?= "9.28"

RECIPE_STATUS_pn-kf ?= "red" # not audited
RECIPE_LATEST_VERSION_pn-kf ?= "0.5.4.1"

RECIPE_STATUS_pn-console-tools ?= "red" # not audited
RECIPE_LATEST_VERSION_pn-console-tools ?= "0.3.2"

RECIPE_STATUS_pn-libetpan ?= "red" # not audited
RECIPE_LATEST_VERSION_pn-libetpan ?= "1"

RECIPE_STATUS_pn-libexif ?= "red" # not audited
RECIPE_LATEST_VERSION_pn-libexif ?= "0.6.19"

RECIPE_STATUS_pn-libsyncml ?= "red" # not audited
RECIPE_LATEST_VERSION_pn-libsyncml ?= "0.5.4"

RECIPE_STATUS_pn-libusb1 ?= "red" # not audited
RECIPE_LATEST_VERSION_pn-libusb1 ?= "1.0.8"

RECIPE_STATUS_pn-x11vnc ?= "red" # not audited
RECIPE_LATEST_VERSION_pn-x11vnc ?= "0.9.11_dev"

RECIPE_STATUS_pn-usbutils ?= "red" # not audited
RECIPE_LATEST_VERSION_pn-usbutils ?= "0.87"

RECIPE_STATUS_pn-telepathy-mission-control ?= "red" # not audited
RECIPE_LATEST_VERSION_pn-telepathy-mission-control ?= "5.5.0"

RECIPE_STATUS_pn-libomxil ?= "red" # not audited
RECIPE_LATEST_VERSION_pn-libomxil ?= "0.9.2.1"

RECIPE_STATUS_pn-libpcre ?= "red" # not audited
RECIPE_LATEST_VERSION_pn-libpcre ?= "8.10"

RECIPE_STATUS_pn-powertop ?= "red" # not audited
RECIPE_LATEST_VERSION_pn-powertop ?= "1.11"

RECIPE_STATUS_pn-psmisc ?= "red" # not audited
RECIPE_LATEST_VERSION_pn-psmisc ?= "22.11"

RECIPE_STATUS_pn-elfutils ?= "red" # not audited
RECIPE_LATEST_VERSION_pn-elfutils ?= "0.131-4"

RECIPE_STATUS_pn-ribosome ?= "red" # not audited
RECIPE_LATEST_VERSION_pn-ribosome ?= "r0"

RECIPE_STATUS_pn-mtools ?= "red" # not audited
RECIPE_LATEST_VERSION_pn-mtools ?= "4.0.13"

RECIPE_STATUS_pn-setserial ?= "red" # not audited
RECIPE_LATEST_VERSION_pn-setserial ?= "2.17"

RECIPE_STATUS_pn-sreadahead ?= "red" # not audited
RECIPE_LATEST_VERSION_pn-sreadahead ?= "1.0"

RECIPE_STATUS_pn-droid-fonts ?= "red" # not audited
RECIPE_LATEST_VERSION_pn-droid-fonts ?= "2.1_r2.1s"

RECIPE_STATUS_pn-anerley ?= "red" # not audited
RECIPE_LATEST_VERSION_pn-anerley ?= "0.2.13"

RECIPE_STATUS_pn-bickley ?= "red" # not audited
RECIPE_LATEST_VERSION_pn-bickley ?= "0.4.4"

RECIPE_STATUS_pn-bisho ?= "red" # not audited
RECIPE_LATEST_VERSION_pn-bisho ?= "0.24.1"

RECIPE_STATUS_pn-bognor-regis ?= "red" # not audited
RECIPE_LATEST_VERSION_pn-bognor-regis ?= "0.5.2-2"

RECIPE_STATUS_pn-carrick ?= "red" # not audited
RECIPE_LATEST_VERSION_pn-carrick ?= "1"

RECIPE_STATUS_pn-dalston ?= "red" # not audited
RECIPE_LATEST_VERSION_pn-dalston ?= "0.1.12"

RECIPE_STATUS_pn-hornsey ?= "red" # not audited
RECIPE_LATEST_VERSION_pn-hornsey ?= "1.5.1"

RECIPE_STATUS_pn-moblin-panel-applications ?= "red" # not audited
RECIPE_LATEST_VERSION_pn-moblin-panel-applications ?= "0.1.28"

RECIPE_STATUS_pn-moblin-panel-media ?= "red" # not audited
RECIPE_LATEST_VERSION_pn-moblin-panel-media ?= "0.0.18"

RECIPE_STATUS_pn-moblin-panel-myzone ?= "red" # not audited
RECIPE_LATEST_VERSION_pn-moblin-panel-myzone ?= "0.1.32"

RECIPE_STATUS_pn-moblin-panel-pasteboard ?= "red" # not audited
RECIPE_LATEST_VERSION_pn-moblin-panel-pasteboard ?= "0.0.6"

RECIPE_STATUS_pn-moblin-panel-people ?= "red" # not audited
RECIPE_LATEST_VERSION_pn-moblin-panel-people ?= "0.1.12"

RECIPE_STATUS_pn-moblin-panel-status ?= "red" # not audited
RECIPE_LATEST_VERSION_pn-moblin-panel-status ?= "0.1.21"

RECIPE_STATUS_pn-mojito ?= "red" # not audited
RECIPE_LATEST_VERSION_pn-mojito ?= "0.21.7"

RECIPE_STATUS_pn-mutter ?= "red" # not audited
RECIPE_LATEST_VERSION_pn-mutter ?= "2.29.1_0.4"

RECIPE_STATUS_pn-mutter-moblin ?= "red" # not audited
RECIPE_LATEST_VERSION_pn-mutter-moblin ?= "0.75.13"

RECIPE_STATUS_pn-nbtk ?= "red" # not audited
RECIPE_LATEST_VERSION_pn-nbtk ?= "1.2.3"

RECIPE_STATUS_pn-claws-mail ?= "red" # not audited
RECIPE_LATEST_VERSION_pn-claws-mail ?= "3.7.6"

RECIPE_STATUS_pn-wbxml2 ?= "red" # not audited
RECIPE_LATEST_VERSION_pn-wbxml2 ?= "0.10.8"

RECIPE_STATUS_pn-wv ?= "red" # not audited
RECIPE_LATEST_VERSION_pn-wv ?= "1.2.1"

RECIPE_STATUS_pn-zile ?= "red" # not audited
RECIPE_LATEST_VERSION_pn-zile ?= "2.2.57"

RECIPE_STATUS_pn-consolekit ?= "red" # not audited
RECIPE_LATEST_VERSION_pn-consolekit ?= "0.4.1"

RECIPE_STATUS_pn-msynctool ?= "red" # not audited
RECIPE_LATEST_VERSION_pn-msynctool ?= "0.38"

RECIPE_STATUS_pn-pm-utils ?= "red" # not audited
RECIPE_LATEST_VERSION_pn-pm-utils ?= "1.3.0"

RECIPE_STATUS_pn-devicekit-power ?= "red" # not audited
RECIPE_LATEST_VERSION_pn-devicekit-power ?= "014"

RECIPE_STATUS_pn-libsamplerate0 ?= "red" # not audited
RECIPE_LATEST_VERSION_pn-libsamplerate0 ?= "0.1.7"

RECIPE_STATUS_pn-mpfr ?= "red" # not audited
RECIPE_LATEST_VERSION_pn-mpfr ?= "2.4.2"

RECIPE_STATUS_pn-util-linux ?= "red" # not audited
RECIPE_LATEST_VERSION_pn-util-linux ?= "2.18"

RECIPE_STATUS_pn-formfactor ?= "red" # not audited
RECIPE_LATEST_VERSION_pn-formfactor ?= "0.0"

RECIPE_STATUS_pn-oprofileui ?= "red" # not audited
RECIPE_LATEST_VERSION_pn-oprofileui ?= "0.0+svnr197"

RECIPE_STATUS_pn-db ?= "red" # not audited
RECIPE_LATEST_VERSION_pn-db ?= "5.0.26"

RECIPE_STATUS_pn-gettext ?= "red" # not audited
RECIPE_LATEST_VERSION_pn-gettext ?= "0.18.1.1"

RECIPE_STATUS_pn-makedevs ?= "red" # not audited
RECIPE_LATEST_VERSION_pn-makedevs ?= "1.0.0"

RECIPE_STATUS_pn-valgrind ?= "red" # not audited
RECIPE_LATEST_VERSION_pn-valgrind ?= "3.5.0"

RECIPE_STATUS_pn-qemu-config ?= "red" # not audited
RECIPE_LATEST_VERSION_pn-qemu-config ?= "1.0"

RECIPE_STATUS_pn-linux ?= "red" # not audited
RECIPE_LATEST_VERSION_pn-linux ?= "2.6.34.1"
```

## meta/conf/distro/include/private/distro_kernel.inc
```bitbake
RECIPE_STATUS_pn-hostap-utils="yellow" # patch investigation needed; hostap-utils.inc is only included by one bb file.
RECIPE_LATEST_VERSION_pn-hostap-utils="0.4.7"
RECIPE_NO_OF_PATCHES_pn-hostap-utils="1"
RECIPE_LATEST_RELEASE_DATE_pn-hostap-utils="2008/12/03"
RECIPE_TIME_BETWEEN_LAST_TWO_RELEASES_pn-hostap-utils="7 months"

RECIPE_STATUS_pn-kexec-tools="green"
RECIPE_LATEST_VERSION_pn-kexec-tools="2.0.1"
RECIPE_NO_OF_PATCHES_pn-kexec-tools="1"
RECIPE_LATEST_RELEASE_DATE_pn-kexec-tools="2009/08/12"
RECIPE_TIME_BETWEEN_LAST_TWO_RELEASES_pn-kexec-tools="1 year"
```

## meta/conf/distro/include/private/distro_base_libs_2.inc
```bitbake
RECIPE_STATUS_pn-gdbm = "green"
DEPENDENCY_CHECK_pn-gdbm = "not done"
RECIPE_LATEST_VERSION_pn-gdbm = "1.8.3"
RECIPE_PATCH_pn-gdbm+makefile = "use oe generic DESTDIR instead of package specific INSTALL_ROOT"
RECIPE_PATCH_pn-gdbm+libtool-mode = "explict specify install mode in libtool"
RECIPE_INTEL_SECTION_pn-gdbm = "base libs"
RECIPE_TIME_BETWEEN_LAST_TWO_RELEASES_pn-gdbm = "n/a"
RECIPE_LATEST_RELEASE_DATE_pn-gdbm = "10/2002"
RECIPE_COMMENTS_pn-gdbm = ""

RECIPE_STATUS_pn-pth = "yellow"    # custom do_configure
DEPENDENCY_CHECK_pn-pth = "not done"
RECIPE_LATEST_VERSION_pn-pth = "2.0.7"
RECIPE_INTEL_SECTION_pn-pth = "base libs"
RECIPE_TIME_BETWEEN_LAST_TWO_RELEASES_pn-pth = "n/a"
RECIPE_LATEST_RELEASE_DATE_pn-pth = "06/2006"
RECIPE_COMMENTS_pn-pth = ""

RECIPE_STATUS_pn-python-pycurl = "yellow"  # several exports to work with python
DEPENDENCY_CHECK_pn-python-pycurl = "not done"
RECIPE_LATEST_VERSION_pn-python-pycurl = "7.19.0"
RECIPE_PATCH_pn-python-pycurl+no-static-link = "no static libraries"
RECIPE_INTEL_SECTION_pn-python-pycurl = "base libs"
RECIPE_TIME_BETWEEN_LAST_TWO_RELEASES_pn-python-pycurl = "2 months"
RECIPE_LATEST_RELEASE_DATE_pn-python-pycurl = "09/2008"
RECIPE_COMMENTS_pn-python-pycurl = "the so called MIT/X here is actually ISC license, depends on libcurl (> 7.19.0)"

RECIPE_STATUS_pn-libusb1 = "green"
DEPENDENCY_CHECK_pn-libusb1 = "not done"
RECIPE_LATEST_VERSION_pn-libusb1 = "1.0.8"
RECIPE_INTEL_SECTION_pn-libusb1 = "base libs"
RECIPE_TIME_BETWEEN_LAST_TWO_RELEASES_pn-libusb1 = "n/a"
RECIPE_LATEST_RELEASE_DATE_pn-libusb = "05/2010"
RECIPE_COMMENTS_pn-libusb1 = ""

RECIPE_STATUS_pn-libusb-compat = "green"
DEPENDENCY_CHECK_pn-libusb-compat = "done"
RECIPE_LATEST_VERSION_pn-libusb-compat = "0.1.3"
RECIPE_INTEL_SECTION_pn-libusb-compat = "base utils"
RECIPE_TIME_BETWEEN_LAST_TWO_RELEASES_pn-libusb-compat = "1 month"
RECIPE_LATEST_RELEASE_DATE_pn-libusb-compat = "07/2009"
RECIPE_COMMENTS_pn-libusb-compat = "replaces libusb, but doesn't provides libusbpp"


RECIPE_STATUS_pn-libnl = "yellow"    # still need to update to git
DEPENDENCY_CHECK_pn-libnl = "not done"
RECIPE_LATEST_VERSION_pn-libnl = "1.1"
RECIPE_PATCH_pn-libnl+local-includes = "fix compilation in Makefile"
RECIPE_PATCH_pn-libnl+compilefix = "fix compilation"
RECIPE_INTEL_SECTION_pn-libnl = "base libs"
RECIPE_TIME_BETWEEN_LAST_TWO_RELEASES_pn-libnl = "n/a"
RECIPE_LATEST_RELEASE_DATE_pn-libnl = "01/2008"
RECIPE_COMMENTS_pn-libnl = "git is active and ~150 commits ahead of 1.1"

RECIPE_STATUS_pn-zlib = "yellow"  # local config scripts
DEPENDENCY_CHECK_pn-zlib = "not done"
RECIPE_LATEST_VERSION_pn-zlib = "1.2.5"
RECIPE_PATCH_pn-zlib+configure.ac = "override default build method"
RECIPE_PATCH_pn-zlib+Makefile.am = "override default build method"
RECIPE_INTEL_SECTION_pn-zlib = "base libs"
RECIPE_TIME_BETWEEN_LAST_TWO_RELEASES_pn-zlib = "3 months"
RECIPE_LATEST_RELEASE_DATE_pn-zlib = "03/2010"
RECIPE_COMMENTS_pn-zlib = "rconflicts: libxml2 (< 2.7.7) (rbreaks)"

RECIPE_STATUS_pn-libxml2 = "yellow"
DEPENDENCY_CHECK_pn-libxml2 = "done"
RECIPE_LATEST_VERSION_pn-libxml2 = "2.7.7"
RECIPE_PATCH_pn-libxml2+install = "use poky environment variables"
RECIPE_INTEL_SECTION_pn-libxml2 = "base libs"
RECIPE_TIME_BETWEEN_LAST_TWO_RELEASES_pn-libxml2 = "5 months"
RECIPE_LATEST_RELEASE_DATE_pn-libxml2 = "03/2010"
RECIPE_COMMENTS_pn-libxml2 = ""

RECIPE_STATUS_pn-readline = "green"
DEPENDENCY_CHECK_pn-readline = "not done"
RECIPE_LATEST_VERSION_pn-readline = "6.1"
RECIPE_PATCH_pn-readline+configure-fix = "fix configure for build"
RECIPE_PATCH_pn-readline+acinclude.m4 = "local include file for autotools"
RECIPE_INTEL_SECTION_pn-readline = "base libs"
RECIPE_TIME_BETWEEN_LAST_TWO_RELEASES_pn-readline = "11 months"
RECIPE_LATEST_RELEASE_DATE_pn-readline = "01/2010"
RECIPE_COMMENTS_pn-readline = ""

RECIPE_STATUS_pn-libgcrypt = "green"
DEPENDENCY_CHECK_pn-libgcrypt = "not done"
RECIPE_LATEST_VERSION_pn-libgcrypt = "1.4.5"
RECIPE_PATCH_pn-libgcrypt+add-pkgconfig-support = "add .pc file"
RECIPE_INTEL_SECTION_pn-libgcrypt = "base libs"
RECIPE_TIME_BETWEEN_LAST_TWO_RELEASES_pn-libgcrypt = "11 months"
RECIPE_LATEST_RELEASE_DATE_pn-libgcrypt = "12/2009"
RECIPE_COMMENTS_pn-libgcrypt = ""

RECIPE_STATUS_pn-gnutls = "yellow"   # need explict pre configure
DEPENDENCY_CHECK_pn-gnutls = "done"
RECIPE_LATEST_VERSION_pn-gnutls = "2.8.6"
RECIPE_PATCH_pn-gnutls+gnutls-openssl = "unkown"
RECIPE_PATCH_pn-gnutls+gnutls-texinfo-euro = "fix if @euro is missing in texinfo"
RECIPE_PATCH_pn-gnutls+configure-fix = "fix Requires.private and Libs.private in autotools script"
RECIPE_INTEL_SECTION_pn-gnutls = "base libs"
RECIPE_TIME_BETWEEN_LAST_TWO_RELEASES_pn-gnutls = "4 months"
RECIPE_LATEST_RELEASE_DATE_pn-gnutls = "03/2010"
RECIPE_COMMENTS_pn-gnutls = "requires libtasn1, but has an internal copy"

RECIPE_STATUS_pn-lzo = "green"
DEPENDENCY_CHECK_pn-lzo = "not done"
RECIPE_LATEST_VERSION_pn-lzo = "2.03"
RECIPE_PATCH_pn-lzo+autofoo = "minor configure.ac fix"
RECIPE_PATCH_pn-lzo+acinclude.m4 = "lzo specific m4 macros"
RECIPE_INTEL_SECTION_pn-lzo = "base libs"
RECIPE_TIME_BETWEEN_LAST_TWO_RELEASES_pn-lzo = "30 months"
RECIPE_LATEST_RELEASE_DATE_pn-lzo = "04/2008"
RECIPE_COMMENTS_pn-lzo = ""

RECIPE_STATUS_pn-libtasn1 = "green"
DEPENDENCY_CHECK_pn-libtasn1 = "not done"
RECIPE_LATEST_VERSION_pn-libtasn1 = "2.7"
RECIPE_INTEL_SECTION_pn-libtasn1 = "base libs"
RECIPE_TIME_BETWEEN_LAST_TWO_RELEASES_pn-libtasn1 = "1 month"
RECIPE_LATEST_RELEASE_DATE_pn-libtasn1 = "05/2010"
RECIPE_COMMENTS_pn-libtasn1 = ""

RECIPE_STATUS_pn-openssl = "green"
DEPENDENCY_CHECK_pn-openssl = "not done"
RECIPE_LATEST_VERSION_pn-openssl = "1.0.0a"    # OK
RECIPE_PATCH_pn-openssl+debian-ca = "unknown"
RECIPE_PATCH_pn-openssl+debian-debian-targets = "unknown"
RECIPE_PATCH_pn-openssl+debian-engines-path = "unknown"
RECIPE_PATCH_pn-openssl+debian-make-targets = "unknown"
RECIPE_PATCH_pn-openssl+debian-man-dir = "unknown"
RECIPE_PATCH_pn-openssl+debian-man-section = "unknown"
RECIPE_PATCH_pn-openssl+debian-no-rpath = "unknown"
RECIPE_PATCH_pn-openssl+debian-no-symbolic = "unknown"
RECIPE_PATCH_pn-openssl+debian-pic = "PIC code generation fix for perl based asm"
RECIPE_PATCH_pn-openssl+debian-pkg-config = "unknown"
RECIPE_PATCH_pn-openssl+debian-valgrind = "fix valgrind errors"
RECIPE_PATCH_pn-openssl+debian-rc4-amd64 = "unknown"
RECIPE_PATCH_pn-openssl+debian-rehash-crt = "unknown"
RECIPE_PATCH_pn-openssl+debian-rehash_pod = "unknown"
RECIPE_PATCH_pn-openssl+debian-shared-lib-ext = "add shared library extension in Configure"
RECIPE_PATCH_pn-openssl+debian-stddef = "add missing header"
RECIPE_PATCH_pn-openssl+debian-version-script = "add 0.9.8 version info into shared library"
RECIPE_PATCH_pn-openssl+debian-perl-path = "fix shebang lines of many perl scripts"
RECIPE_PATCH_pn-openssl+configure-targets = "add poky target to Configure (not autoconf based)"
RECIPE_PATCH_pn-openssl+shared-libs = "use make -e to export poky environment to child makefiles"
RECIPE_INTEL_SECTION_pn-openssl = "base libs"
RECIPE_TIME_BETWEEN_LAST_TWO_RELEASES_pn-openssl = "3 months"
RECIPE_LATEST_RELEASE_DATE_pn-openssl = "06/2010"
RECIPE_COMMENTS_pn-openssl = "0.9.8o is actually used for stability concerns"

RECIPE_STATUS_pn-libnss-mdns = "green"
DEPENDENCY_CHECK_pn-libnss-mdns = "done"
RECIPE_LATEST_VERSION_pn-libnss-mdns = "0.10"
RECIPE_PATCH_pn-libnss-mdns+alignment-fix = "fix alignment"
RECIPE_INTEL_SECTION_pn-libnss-mdns = "base libs"
RECIPE_TIME_BETWEEN_LAST_TWO_RELEASES_pn-libnss-mdns = "n/a"
RECIPE_LATEST_RELEASE_DATE_pn-libnss-mdns = "05/2007"
RECIPE_COMMENTS_pn-libnss-mdns = ""

RECIPE_STATUS_pn-ncurses = "red"   # need upgrade
DEPENDENCY_CHECK_pn-ncurses = "not done"
RECIPE_LATEST_VERSION_pn-ncurses = "5.7"
RECIPE_INTEL_SECTION_pn-ncurses = "base libs"
RECIPE_TIME_BETWEEN_LAST_TWO_RELEASES_pn-ncurses = "23 months"
RECIPE_LATEST_RELEASE_DATE_pn-ncurses = "11/2008"
RECIPE_COMMENTS_pn-ncurses = ""

RECIPE_STATUS_pn-popt = "green"
DEPENDENCY_CHECK_pn-popt = "done"
RECIPE_LATEST_VERSION_pn-popt = "1.16"
RECIPE_INTEL_SECTION_pn-popt = "base libs"
RECIPE_TIME_BETWEEN_LAST_TWO_RELEASES_pn-popt = "13 months"
RECIPE_LATEST_RELEASE_DATE_pn-popt = "05/2010"
RECIPE_COMMENTS_pn-popt = ""

RECIPE_STATUS_pn-sqlite3 = "green"   # need upgrade
DEPENDENCY_CHECK_pn-sqlite3 = "not done"
RECIPE_LATEST_VERSION_pn-sqlite3 = "3.6.23.1"
RECIPE_INTEL_SECTION_pn-sqlite3 = "base libs"
RECIPE_TIME_BETWEEN_LAST_TWO_RELEASES_pn-sqlite3 = "1 month"
RECIPE_LATEST_RELEASE_DATE_pn-sqlite3 = "03/2010"
RECIPE_COMMENTS_pn-sqlite3 = ""

RECIPE_STATUS_pn-libpthread-stubs = "green"
DEPENDENCY_CHECK_pn-libpthread-stubs = "done"
RECIPE_LATEST_VERSION_pn-libpthread-stubs = "0.3"
RECIPE_INTEL_SECTION_pn-libpthread-stubs = "base libs"
RECIPE_TIME_BETWEEN_LAST_TWO_RELEASES_pn-libpthread-stubs = "n/a"
RECIPE_LATEST_RELEASE_DATE_pn-libpthread-stubs = "10/2009"
RECIPE_COMMENTS_pn-libpthread-stubs = "0.1: 11/2006, 0.2: 09/2009, 0.3: 10/2009"

RECIPE_STATUS_pn-attr = "yellow"   # the recipe is quite hacky
DEPENDENCY_CHECK_pn-attr = "done"
RECIPE_LATEST_VERSION_pn-attr = "2.4.44"
RECIPE_PATCH_pn-attr+double-free = ""
RECIPE_PATCH_pn-attr+memory-leak2 = ""
RECIPE_PATCH_pn-attr+memory-leak-in-copy = ""
RECIPE_PATCH_pn-attr+pull-in-string.h = ""
RECIPE_PATCH_pn-attr+thinko-in-restore = "stdin mishandling"
RECIPE_INTEL_SECTION_pn-attr = "base libs"
RECIPE_TIME_BETWEEN_LAST_TWO_RELEASES_pn-attr = "13 months"
RECIPE_LATEST_RELEASE_DATE_pn-attr = "08/2009"
RECIPE_COMMENTS_pn-attr = ""

RECIPE_STATUS_pn-libcap = "yellow"   # hand crafted Makefiles
DEPENDENCY_CHECK_pn-libcap = "done"
RECIPE_LATEST_VERSION_pn-libcap = "2.19"
RECIPE_INTEL_SECTION_pn-libcap = "base libs"
RECIPE_TIME_BETWEEN_LAST_TWO_RELEASES_pn-libcap = "1 month"
RECIPE_LATEST_RELEASE_DATE_pn-libcap = "01/2010"
RECIPE_COMMENTS_pn-libcap = ""

RECIPE_STATUS_pn-libevent = "green"
DEPENDENCY_CHECK_pn-libevent = "done"
RECIPE_LATEST_VERSION_pn-libevent = "1.4.14b"
RECIPE_INTEL_SECTION_pn-libevent = "base libs"
RECIPE_TIME_BETWEEN_LAST_TWO_RELEASES_pn-libevent = "7 months"
RECIPE_LATEST_RELEASE_DATE_pn-libevent = "06/2010"
RECIPE_COMMENTS_pn-libevent = ""

RECIPE_STATUS_pn-libnfsidmap = "green"
DEPENDENCY_CHECK_pn-libnfsidmap = "done"
RECIPE_LATEST_VERSION_pn-libnfsidmap = "0.23"
RECIPE_INTEL_SECTION_pn-libnfsidmap = "base libs"
RECIPE_TIME_BETWEEN_LAST_TWO_RELEASES_pn-libnfsidmap = "4 months"
RECIPE_LATEST_RELEASE_DATE_pn-libnfsidmap = "12/2009"
RECIPE_COMMENTS_pn-libnfsidmap = ""

RECIPE_STATUS_pn-acl = "yellow"   # hacky as attr
DEPENDENCY_CHECK_pn-acl = "done"
RECIPE_LATEST_VERSION_pn-acl = "2.2.49"
RECIPE_INTEL_SECTION_pn-acl = "base libs"
RECIPE_TIME_BETWEEN_LAST_TWO_RELEASES_pn-acl = "4 months"
RECIPE_LATEST_RELEASE_DATE_pn-acl = "11/2009"
RECIPE_COMMENTS_pn-acl = ""
```

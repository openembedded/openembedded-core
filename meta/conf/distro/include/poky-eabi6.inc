## meta/conf/distro/include/private/distro_multimedia.inc
```bitbake
RECIPE_STATUS_pn-liba52="yellow" # patch investigation needed
DISTRO_PN_ALIAS_pn-liba52 = "Mandriva=a52dec Debian=a52dec"
RECIPE_LATEST_VERSION_pn-liba52="0.7.4"
RECIPE_NO_OF_PATCHES_pn-liba52="1"
RECIPE_LATEST_RELEASE_DATE_pn-liba52="2002/07/27"
RECIPE_TIME_BETWEEN_LAST_TWO_RELEASES_pn-liba52="5 months"
RECIPE_MAINTAINER_pn-liba52 = "Dongxiao Xu <dongxiao.xu@intel.com>"

RECIPE_STATUS_pn-libid3tag="yellow" # patch investigation needed
RECIPE_LATEST_VERSION_pn-libid3tag="0.15.1b"
RECIPE_NO_OF_PATCHES_pn-libid3tag="1"
RECIPE_LATEST_RELEASE_DATE_pn-libid3tag="2004/02/18"
RECIPE_TIME_BETWEEN_LAST_TWO_RELEASES_pn-libid3tag="8 months"
RECIPE_MAINTAINER_pn-libid3tag = "Dongxiao Xu <dongxiao.xu@intel.com>"

RECIPE_STATUS_pn-libmad="yellow" # patch investigation needed
RECIPE_LATEST_VERSION_pn-libmad="0.15.1b"
RECIPE_NO_OF_PATCHES_pn-libmad="2"
RECIPE_LATEST_RELEASE_DATE_pn-libmad="2004/02/18"
RECIPE_TIME_BETWEEN_LAST_TWO_RELEASES_pn-libmad="8 months"
RECIPE_MAINTAINER_pn-libmad = "Dongxiao Xu <dongxiao.xu@intel.com>"

RECIPE_STATUS_pn-lame="green"
RECIPE_LATEST_VERSION_pn-lame="3.98.4"
RECIPE_NO_OF_PATCHES_pn-lame="1"
RECIPE_LATEST_RELEASE_DATE_pn-lame="2010/04/14"
RECIPE_TIME_BETWEEN_LAST_TWO_RELEASES_pn-lame="20 months"
RECIPE_MAINTAINER_pn-lame = "Dongxiao Xu <dongxiao.xu@intel.com>"

RECIPE_STATUS_pn-flac="green"
RECIPE_LATEST_VERSION_pn-flac="1.2.1"
RECIPE_NO_OF_PATCHES_pn-flac="3"
RECIPE_LATEST_RELEASE_DATE_pn-flac="2007/09/16"
RECIPE_TIME_BETWEEN_LAST_TWO_RELEASES_pn-flac="2 months"
RECIPE_MAINTAINER_pn-flac = "Dongxiao Xu <dongxiao.xu@intel.com>"

RECIPE_STATUS_pn-libvorbis="green"
RECIPE_LATEST_VERSION_pn-libvorbis="1.3.1"
RECIPE_NO_OF_PATCHES_pn-libvorbis="0"
RECIPE_LATEST_RELEASE_DATE_pn-libvorbis="2010/05/26"
RECIPE_TIME_BETWEEN_LAST_TWO_RELEASES_pn-libvorbis="8 months"
RECIPE_MAINTAINER_pn-libvorbis = "Dongxiao Xu <dongxiao.xu@intel.com>"

RECIPE_STATUS_pn-libogg="green"
RECIPE_LATEST_VERSION_pn-libogg="1.2.0"
RECIPE_NO_OF_PATCHES_pn-libogg="0"
RECIPE_LATEST_RELEASE_DATE_pn-libogg="2010/05/26"
RECIPE_TIME_BETWEEN_LAST_TWO_RELEASES_pn-libogg="9 months"
RECIPE_MAINTAINER_pn-libogg = "Dongxiao Xu <dongxiao.xu@intel.com>"

RECIPE_STATUS_pn-mpeg2dec="green"
RECIPE_LATEST_VERSION_pn-mpeg2dec="0.4.1"
RECIPE_NO_OF_PATCHES_pn-mpeg2dec="0"
RECIPE_LATEST_RELEASE_DATE_pn-mpeg2dec="2006/09/19"
RECIPE_TIME_BETWEEN_LAST_TWO_RELEASES_pn-mpeg2dec="2 years"
RECIPE_MAINTAINER_pn-mpeg2dec = "Dongxiao Xu <dongxiao.xu@intel.com>"

RECIPE_STATUS_pn-gstreamer="green"
RECIPE_LATEST_VERSION_pn-gstreamer="0.10.29"
RECIPE_NO_OF_PATCHES_pn-gstreamer="2"
RECIPE_LATEST_RELEASE_DATE_pn-gstreamer="2010/04/27"
RECIPE_TIME_BETWEEN_LAST_TWO_RELEASES_pn-gstreamer="1 month"
RECIPE_MAINTAINER_pn-gstreamer = "Dongxiao Xu <dongxiao.xu@intel.com>"

RECIPE_STATUS_pn-gst-plugins-base="green"
DISTRO_PN_ALIAS_pn-gst-plugins-base = "Meego=gst-plugins-base Fedora=gstreamer-plugins-base OpenSuSE=gstreamer-plugins-base Ubuntu=gst-plugins-base0.10 Mandriva=gstreamer0.10-plugins-base Debian=gst-plugins-base0.10"
RECIPE_LATEST_VERSION_pn-gst-plugins-base="0.10.29"
RECIPE_NO_OF_PATCHES_pn-gst-plugins-base="0"
RECIPE_LATEST_RELEASE_DATE_pn-gst-plugins-base="2010/04/27"
RECIPE_TIME_BETWEEN_LAST_TWO_RELEASES_pn-gst-plugins-base="2 months"
RECIPE_MAINTAINER_pn-gst-plugins-base = "Dongxiao Xu <dongxiao.xu@intel.com>"

RECIPE_STATUS_pn-gst-plugins-good="green"
DISTRO_PN_ALIAS_pn-gst-plugins-good = "Meego=gst-plugins-good Fedora=gstreamer-plugins-good OpenSuSE=gstreamer-plugins-good Ubuntu=gst-plugins-good0.10 Mandriva=gstreamer0.10-plugins-good Debian=gst-plugins-good0.10"
RECIPE_LATEST_VERSION_pn-gst-plugins-good="0.10.23"
RECIPE_NO_OF_PATCHES_pn-gst-plugins-good="0"
RECIPE_LATEST_RELEASE_DATE_pn-gst-plugins-good="2010/05/30"
RECIPE_TIME_BETWEEN_LAST_TWO_RELEASES_pn-gst-plugins-good="1 month"
RECIPE_MAINTAINER_pn-gst-plugins-good = "Dongxiao Xu <dongxiao.xu@intel.com>"

RECIPE_STATUS_pn-gst-plugins-ugly="green"
DISTRO_PN_ALIAS_pn-gst-plugins-ugly = "OpenSuSE=gstreamer-plugins-ugly Mandriva=gstreamer0.10-plugins-ugly Debian=gst-plugins-ugly0.10"
RECIPE_LATEST_VERSION_pn-gst-plugins-ugly="0.10.15"
RECIPE_NO_OF_PATCHES_pn-gst-plugins-ugly="0"
RECIPE_LATEST_RELEASE_DATE_pn-gst-plugins-ugly="2010/05/30"
RECIPE_TIME_BETWEEN_LAST_TWO_RELEASES_pn-gst-plugins-ugly="3 months"
RECIPE_MAINTAINER_pn-gst-plugins-ugly = "Dongxiao Xu <dongxiao.xu@intel.com>"

RECIPE_STATUS_pn-gst-plugins-bad="green"
DISTRO_PN_ALIAS_pn-gst-plugins-bad = "Fedora=gstreamer-plugins-bad-free OpenSuSE=gstreamer-plugins-bad Debian=gst-plugins-bad0.10"
RECIPE_LATEST_VERSION_pn-gst-plugins-bad="0.10.19"
RECIPE_NO_OF_PATCHES_pn-gst-plugins-bad="0"
RECIPE_LATEST_RELEASE_DATE_pn-gst-plugins-bad="2010/05/30"
RECIPE_TIME_BETWEEN_LAST_TWO_RELEASES_pn-gst-plugins-bad="3 months"
RECIPE_MAINTAINER_pn-gst-plugins-bad = "Dongxiao Xu <dongxiao.xu@intel.com>"

RECIPE_STATUS_pn-alsa-utils="green"
RECIPE_LATEST_VERSION_pn-alsa-utils="1.0.23"
RECIPE_NO_OF_PATCHES_pn-alsa-utils="1"
RECIPE_LATEST_RELEASE_DATE_pn-alsa-utils="2010/04/16"
RECIPE_TIME_BETWEEN_LAST_TWO_RELEASES_pn-alsa-utils="4 months"
RECIPE_MAINTAINER_pn-alsa-utils = "Dongxiao Xu <dongxiao.xu@intel.com>"

RECIPE_STATUS_pn-alsa-lib="green"
RECIPE_LATEST_VERSION_pn-alsa-lib="1.0.23"
RECIPE_NO_OF_PATCHES_pn-alsa-lib="1"
RECIPE_LATEST_RELEASE_DATE_pn-alsa-lib="2010/04/16"
RECIPE_TIME_BETWEEN_LAST_TWO_RELEASES_pn-alsa-lib="4 months"
RECIPE_MAINTAINER_pn-alsa-lib = "Dongxiao Xu <dongxiao.xu@intel.com>"

RECIPE_STATUS_pn-tremor="green"
RECIPE_LATEST_VERSION_pn-tremor="20100422"
RECIPE_NO_OF_PATCHES_pn-tremor="0"
RECIPE_LATEST_RELEASE_DATE_pn-tremor="2010/04/22"
RECIPE_TIME_BETWEEN_LAST_TWO_RELEASES_pn-tremor="n/a"
RECIPE_MAINTAINER_pn-tremor = "Dongxiao Xu <dongxiao.xu@intel.com>"

RECIPE_STATUS_pn-gaku="green"
RECIPE_LATEST_VERSION_pn-gaku="399"
RECIPE_NO_OF_PATCHES_pn-gaku="0"
RECIPE_LATEST_RELEASE_DATE_pn-gaku="2008/07/03"
RECIPE_TIME_BETWEEN_LAST_TWO_RELEASES_pn-gaku="n/a"
RECIPE_MAINTAINER_pn-gaku = "Dongxiao Xu <dongxiao.xu@intel.com>"

RECIPE_STATUS_pn-xvideo-tests="green"
RECIPE_LATEST_VERSION_pn-xvideo-tests="270"
RECIPE_NO_OF_PATCHES_pn-xvideo-tests="0"
RECIPE_LATEST_RELEASE_DATE_pn-xvideo-tests="2007/06/22"
RECIPE_TIME_BETWEEN_LAST_TWO_RELEASES_pn-xvideo-tests="n/a"
RECIPE_MAINTAINER_pn-xvideo-tests = "Dongxiao Xu <dongxiao.xu@intel.com>"

RECIPE_STATUS_pn-speex="green"
RECIPE_LATEST_VERSION_pn-speex="1.2rc1"
RECIPE_NO_OF_PATCHES_pn-speex="0"
RECIPE_LATEST_RELEASE_DATE_pn-speex="2008/07/24"
RECIPE_TIME_BETWEEN_LAST_TWO_RELEASES_pn-speex="8 months"
RECIPE_MAINTAINER_pn-speex = "Dongxiao Xu <dongxiao.xu@intel.com>"

RECIPE_STATUS_pn-libmusicbrainz="green"
RECIPE_LATEST_VERSION_pn-libmusicbrainz="3.0.2"
RECIPE_NO_OF_PATCHES_pn-libmusicbrainz="0"
RECIPE_LATEST_RELEASE_DATE_pn-libmusicbrainz="2008/09/13"
RECIPE_TIME_BETWEEN_LAST_TWO_RELEASES_pn-libmusicbrainz="14 months"
RECIPE_MAINTAINER_pn-libmusicbrainz = "Dongxiao Xu <dongxiao.xu@intel.com>"

RECIPE_STATUS_pn-clutter-gst-0.10 = "red"
DISTRO_PN_ALIAS_pn-clutter-gst-0.10 = "OpenSuSE=clutter-gst Debian=clutter-gst"
RECIPE_LATEST_VERSION_pn-clutter-gst-0.10 = "1.0.0"
RECIPE_MAINTAINER_pn-clutter-gst-0.10 = "Dongxiao Xu <dongxiao.xu@intel.com>"

RECIPE_STATUS_pn-clutter-gst-0.6 = "red"
DISTRO_PN_ALIAS_pn-clutter-gst-0.6 = "OpenSuSE=clutter-gst Debian=clutter-gst"
RECIPE_LATEST_VERSION_pn-clutter-gst-0.6 = "0.6"
RECIPE_MAINTAINER_pn-clutter-gst-0.6 = "Dongxiao Xu <dongxiao.xu@intel.com>"

RECIPE_STATUS_pn-clutter-gst-0.8 = "red"
DISTRO_PN_ALIAS_pn-clutter-gst-0.8 = "OpenSuSE=clutter-gst Debian=clutter-gst"
RECIPE_LATEST_VERSION_pn-clutter-gst-0.8 = "0.8"
RECIPE_MAINTAINER_pn-clutter-gst-0.8 = "Dongxiao Xu <dongxiao.xu@intel.com>"

RECIPE_STATUS_pn-clutter-gst-1.0 = "red"
DISTRO_PN_ALIAS_pn-clutter-gst-1.0 = "OpenSuSE=clutter-gst Debian=clutter-gst"
RECIPE_LATEST_VERSION_pn-clutter-gst-1.0 = "1.0"
RECIPE_MAINTAINER_pn-clutter-gst-1.0 = "Dongxiao Xu <dongxiao.xu@intel.com>"

RECIPE_STATUS_pn-farsight2 = "red"
RECIPE_LATEST_VERSION_pn-farsight2 = "0.0.20"
RECIPE_MAINTAINER_pn-farsight2 = "Dongxiao Xu <dongxiao.xu@intel.com>"

RECIPE_STATUS_pn-gst-openmax = "red"
RECIPE_LATEST_VERSION_pn-gst-openmax = "0.10.0.5"
RECIPE_MAINTAINER_pn-gst-openmax = "Dongxiao Xu <dongxiao.xu@intel.com>"

RECIPE_STATUS_pn-gst-ffmpeg = "red"
DISTRO_PN_ALIAS_pn-gst-ffmpeg = "Mandriva=gstreamer0.10-ffmpeg Debian=gstreamer0.10-ffmpeg"
RECIPE_LATEST_VERSION_pn-gst-ffmpeg = "0.10.10"
RECIPE_MAINTAINER_pn-gst-ffmpeg = "Dongxiao Xu <dongxiao.xu@intel.com>"

RECIPE_STATUS_pn-moblin-sound-theme = "red"
RECIPE_LATEST_VERSION_pn-moblin-sound-theme = "0.3"
RECIPE_MAINTAINER_pn-moblin-sound-theme = "Dongxiao Xu <dongxiao.xu@intel.com>"

RECIPE_STATUS_pn-librds = "red"
RECIPE_LATEST_VERSION_pn-librds = "0.0.1"
RECIPE_MAINTAINER_pn-librds = "Dongxiao Xu <dongxiao.xu@intel.com>"

RECIPE_STATUS_pn-alsa-oss = "red"
RECIPE_LATEST_VERSION_pn-alsa-oss = "1.0.17"
RECIPE_MAINTAINER_pn-alsa-oss = "Dongxiao Xu <dongxiao.xu@intel.com>"

RECIPE_STATUS_pn-libsndfile1 = "red"
DISTRO_PN_ALIAS_pn-libsndfile1 = "Meego=libsndfile Fedora=libsndfile OpenSuSE=libsndfile Ubuntu=libsndfile Mandriva=libsndfile Debian=libsndfile"
RECIPE_LATEST_VERSION_pn-libsndfile1 = "1.0.21 "
RECIPE_MAINTAINER_pn-libsndfile1 = "Dongxiao Xu <dongxiao.xu@intel.com>"

RECIPE_STATUS_pn-pulseaudio = "red"
RECIPE_LATEST_VERSION_pn-pulseaudio = "0.9.21"
RECIPE_MAINTAINER_pn-pulseaudio = "Dongxiao Xu <dongxiao.xu@intel.com>"

RECIPE_STATUS_pn-taglib = "red"
RECIPE_LATEST_VERSION_pn-taglib = "1.6.3"
RECIPE_MAINTAINER_pn-taglib = "Dongxiao Xu <dongxiao.xu@intel.com>"

RECIPE_STATUS_pn-libnice = "red"
RECIPE_LATEST_VERSION_pn-libnice = "0.0.12"
RECIPE_MAINTAINER_pn-libnice = "Dongxiao Xu <dongxiao.xu@intel.com>"

RECIPE_STATUS_pn-bognor-regis = "red"
RECIPE_LATEST_VERSION_pn-bognor-regis = "0.5.2-2"
RECIPE_MAINTAINER_pn-bognor-regis = "Dongxiao Xu <dongxiao.xu@intel.com>"

RECIPE_STATUS_pn-gst-fluendo-mp3 = "red"
RECIPE_LATEST_VERSION_pn-gst-fluendo-mp3 = "0.10.10"
RECIPE_MAINTAINER_pn-gst-fluendo-mp3 = "Dongxiao Xu <dongxiao.xu@intel.com>"

RECIPE_STATUS_pn-gst-fluendo-mpegdemux = "red"
RECIPE_LATEST_VERSION_pn-gst-fluendo-mpegdemux = "0.10.23"
RECIPE_MAINTAINER_pn-gst-fluendo-mpegdemux = "Dongxiao Xu <dongxiao.xu@intel.com>"

RECIPE_STATUS_pn-hornsey = "red"
RECIPE_LATEST_VERSION_pn-hornsey = "1.5.1"
RECIPE_MAINTAINER_pn-hornsey = "Dongxiao Xu <dongxiao.xu@intel.com>"

RECIPE_STATUS_pn-libomxil = "red"
RECIPE_LATEST_VERSION_pn-libomxil = "0.9.2.1"
RECIPE_MAINTAINER_pn-libomxil = "Dongxiao Xu <dongxiao.xu@intel.com>"

RECIPE_STATUS_pn-libsamplerate0 = "red"
DISTRO_PN_ALIAS_pn-libsamplerate0 = "Meego=libsamplerate Fedora=libsamplerate OpenSuSE=libsamplerate Ubuntu=libsamplerate Mandriva=libsamplerate Debian=libsamplerate"
RECIPE_LATEST_VERSION_pn-libsamplerate0 = "0.1.7"
RECIPE_MAINTAINER_pn-libsamplerate0 = "Dongxiao Xu <dongxiao.xu@intel.com>"
```

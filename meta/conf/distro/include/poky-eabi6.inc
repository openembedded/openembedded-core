## meta/conf/distro/include/poky-eabi6.inc
```bitbake
#
# Poky configuration to use EABI
#

TARGET_VENDOR = "-poky"

PREFERRED_PROVIDER_virtual/arm-poky-linux-gnueabi-libc-for-gcc = "glibc-intermediate"
PREFERRED_PROVIDER_virtual/${TARGET_PREFIX}gcc-initial = "gcc-cross-initial"
PREFERRED_PROVIDER_virtual/${TARGET_PREFIX}gcc = "gcc-cross"
PREFERRED_PROVIDER_virtual/${TARGET_PREFIX}g++ = "gcc-cross"

PREFERRED_VERSION_gcc ?= "3.4.4+csl-arm-2005q3"
PREFERRED_VERSION_gcc-cross ?= "3.4.4+csl-arm-2005q3"
PREFERRED_VERSION_gcc-cross-initial ?= "3.4.4+csl-arm-2005q3"
PREFERRED_VERSION_binutils ?= "2.16.91.0.7"
PREFERRED_VERSION_binutils-cross ?= "2.16.91.0.7"
PREFERRED_VERSION_linux-libc-headers ?= "2.6.15.99"
PREFERRED_VERSION_glibc ?= "2.5"
PREFERRED_VERSION_glibc-intermediate ?= "2.5"
PREFERRED_VERSION_glibc-initial ?= "2.5"
PREFERRED_VERSION_elfutils ?= "0.108"

GLIBCTARGETOS = "linux${@['','-gnueabi'][bb.data.getVar('TARGET_ARCH',d,1) in ['arm', 'armeb']]}"
UCLIBCTARGETOS = "linux${@['-uclibc','-uclibcgnueabi'][bb.data.getVar('TARGET_ARCH',d,1) in ['arm', 'armeb']]}"
```

## meta/conf/distro/include/poky-eglibc.inc
```bitbake
#
# eglibc specific configuration
#

# Add glibc overrides to the overrides for eglibc.
OVERRIDES .= ":libc-glibc"

PREFERRED_PROVIDER_virtual/libiconv ?= "eglibc"
PREFERRED_PROVIDER_virtual/libintl ?= "eglibc"
PREFERRED_PROVIDER_virtual/libc ?= "eglibc"
PREFERRED_PROVIDER_virtual/${TARGET_PREFIX}libc-initial = "eglibc-initial"
PREFERRED_PROVIDER_virtual/${TARGET_PREFIX}libc-for-gcc = "eglibc"

TARGET_OS = "${GLIBCTARGETOS}"

CXXFLAGS += "-fvisibility-inlines-hidden"

LIBC_DEPENDENCIES = "libsegfault \
		     eglibc \
    		     eglibc-dbg \
    		     eglibc-dev \
    		     eglibc-utils \
    		     eglibc-thread-db \
    		     eglibc-localedata-i18n \
    		     eglibc-gconv-ibm850 \
    		     eglibc-gconv-cp1252 \
    		     eglibc-gconv-iso8859-1 \
    		     eglibc-gconv-iso8859-15 \
    		     locale-base-en-gb "
```

## meta/conf/distro/include/poky-external-csl2006q3.inc
```bitbake
TARGET_VENDOR = "-none"

EXTERNAL_TOOLCHAIN = "/usr/local/csl/arm-2006q3"

PATH =. ":${EXTERNAL_TOOLCHAIN}/bin:"

PREFERRED_PROVIDER_linux-libc-headers = "external-csl-toolchain"
PREFERRED_PROVIDER_virtual/arm-none-linux-gnueabi-gcc = "external-csl-toolchain"
PREFERRED_PROVIDER_virtual/arm-none-linux-gnueabi-gcc-initial = "external-csl-toolchain"
PREFERRED_PROVIDER_virtual/arm-none-linux-gnueabi-binutils = "external-csl-toolchain"
PREFERRED_PROVIDER_virtual/arm-none-linux-gnueabi-libc-for-gcc = "external-csl-toolchain"
PREFERRED_PROVIDER_virtual/libc = "external-csl-toolchain"
PREFERRED_PROVIDER_virtual/libintl = "external-csl-toolchain"
PREFERRED_PROVIDER_virtual/libiconv = "external-csl-toolchain"
PREFERRED_PROVIDER_glibc-thread-db = "external-csl-toolchain"
PREFERRED_PROVIDER_virtual/linux-libc-headers = "external-csl-toolchain"

TARGET_CPPFLAGS_prepend = " -isystem${EXTERNAL_TOOLCHAIN}/${TARGET_SYS}/include "
TARGET_LDFLAGS_prepend = " -L${EXTERNAL_TOOLCHAIN}/${TARGET_SYS}/lib -Wl,-rpath-link,${EXTERNAL_TOOLCHAIN}/${TARGET_SYS}/lib "

GLIBCTARGETOS = "linux${@['','-gnueabi'][bb.data.getVar('TARGET_ARCH',d,1) in ['arm', 'armeb']]}"
UCLIBCTARGETOS = "linux${@['-uclibc','-uclibcgnueabi'][bb.data.getVar('TARGET_ARCH',d,1) in ['arm', 'armeb']]}"
```

## meta/conf/distro/include/poky-external.inc
```bitbake
#
# Configuration to use a toolchain built by meta-toolchain.bb
#

TARGET_VENDOR = "-poky"

EXTERNAL_TOOLCHAIN = "${SDK_PREFIX}"

PATH =. ":${EXTERNAL_TOOLCHAIN}/bin:"

PREFERRED_PROVIDER_linux-libc-headers = "external-poky-toolchain"
PREFERRED_PROVIDER_virtual/arm-poky-linux-gnueabi-gcc = "external-poky-toolchain"
PREFERRED_PROVIDER_virtual/arm-poky-linux-gnueabi-gcc-initial = "external-poky-toolchain"
PREFERRED_PROVIDER_virtual/arm-poky-linux-binutils = "external-poky-toolchain"
PREFERRED_PROVIDER_virtual/arm-poky-linux-libc-for-gcc = "external-poky-toolchain"
PREFERRED_PROVIDER_virtual/i586-poky-linux-gcc = "external-poky-toolchain"
PREFERRED_PROVIDER_virtual/i586-poky-linux-gcc-initial = "external-poky-toolchain"
PREFERRED_PROVIDER_virtual/i586-poky-linux-binutils = "external-poky-toolchain"
PREFERRED_PROVIDER_virtual/i586-poky-linux-libc-for-gcc = "external-poky-toolchain"
PREFERRED_PROVIDER_virtual/libc = "external-poky-toolchain"
PREFERRED_PROVIDER_virtual/libintl = "external-poky-toolchain"
PREFERRED_PROVIDER_virtual/libiconv = "external-poky-toolchain"
PREFERRED_PROVIDER_glibc-thread-db = "external-poky-toolchain"
PREFERRED_PROVIDER_virtual/linux-libc-headers = "external-poky-toolchain"

TARGET_CPPFLAGS_prepend = " -isystem${EXTERNAL_TOOLCHAIN}/${TARGET_SYS}/include "
TARGET_LDFLAGS_prepend = " -L${EXTERNAL_TOOLCHAIN}/${TARGET_SYS}/lib -Wl,-rpath-link,${EXTERNAL_TOOLCHAIN}/${TARGET_SYS}/lib "
TARGET_CFLAGS = "${TARGET_CPPFLAGS} ${SELECTED_OPTIMIZATION}"

TOOLCHAIN_OPTIONS = " --sysroot=${STAGING_DIR_HOST}"
```

## meta/conf/distro/include/poky-fixed-revisions.inc
```bitbake
# Preferred Versions:
#
PREFERRED_VERSION_libmatchbox ?= "1.9"
PREFERRED_VERSION_matchbox-theme-sato ?= "0.1"
PREFERRED_VERSION_elfutils ?= "0.89"
PREFERRED_VERSION_hal ?= "0.5.14"
PREFERRED_VERSION_hal-info ?= "20091130"
PREFERRED_VERSION_udev ?= "164"
PREFERRED_VERSION_wpa-supplicant ?= "0.7.3"

PULSEAUDIOVERSION ?= "0.9.21"
PULSEAUDIOVERSION_arm ?= "0.9.15"
PREFERRED_VERSION_pulseaudio ?= "${PULSEAUDIOVERSION}"

# Force the python versions in one place
PYTHON_BASEVERSION ?= "2.6"
PREFERRED_VERSION_python ?= "2.6.6"
PREFERRED_VERSION_python-native ?= "2.6.6"

# Force the older version of liberation-fonts until we fix the fontforge issue
PREFERRED_VERSION_liberation-fonts ?= "1.04"
```

## meta/conf/distro/include/poky-floating-srcrev.inc
```bitbake
PREFERRED_VERSION_matchbox-common ?= ""
PREFERRED_VERSION_matchbox-config-gtk ?= ""
PREFERRED_VERSION_matchbox-desktop ?= ""
PREFERRED_VERSION_matchbox-keyboard ?= ""
PREFERRED_VERSION_matchbox-panel ?= ""
PREFERRED_VERSION_matchbox-stroke ?= ""
PREFERRED_VERSION_matchbox-themes-extra ?= ""
PREFERRED_VERSION_matchbox-wm ?= ""
PREFERRED_VERSION_dates ?= ""

SRCREV_pn-gconf-dbus ?= "${AUTOREV}"
SRCREV_pn-contacts ?= "${AUTOREV}"
SRCREV_pn-dates ?= "${AUTOREV}"
#SRCREV_pn-gtkhtml2 ?= "${AUTOREV}"
SRCREV_pn-web ?= "${AUTOREV}"
SRCREV_pn-eds-dbus ?= "${AUTOREV}"
SRCREV_pn-matchbox-common ?= "${AUTOREV}"
SRCREV_pn-matchbox-config-gtk ?= "${AUTOREV}"
SRCREV_pn-matchbox-desktop ?= "${AUTOREV}"
SRCREV_pn-matchbox-keyboard ?= "${AUTOREV}"
SRCREV_pn-matchbox-panel ?= "${AUTOREV}"
SRCREV_pn-matchbox-panel-2 ?= "${AUTOREV}"
SRCREV_pn-matchbox-stroke ?= "${AUTOREV}"
SRCREV_pn-matchbox-themes-extra ?= "${AUTOREV}"
SRCREV_pn-matchbox-terminal ?= "${AUTOREV}"
SRCREV_pn-matchbox-wm ?= "${AUTOREV}"
SRCREV_pn-matchbox-wm-2 ?= "${AUTOREV}"
SRCREV_pn-settings-daemon ?= "${AUTOREV}"
SRCREV_pn-screenshot ?= "${AUTOREV}"
SRCREV_pn-libfakekey ?= "${AUTOREV}"
SRCREV_pn-oprofileui ?= "${AUTOREV}"
SRCREV_pn-zaurusd ?= "${AUTOREV}"
SRCREV_pn-owl-video-widget ?= "${AUTOREV}"
SRCREV_pn-psplash ?= "${AUTOREV}"
SRCREV_pn-exmap-console ?= "${AUTOREV}"
SRCREV_pn-gtk-sato-engine ?= "${AUTOREV}"
SRCREV_pn-matchbox-theme-sato ?= "${AUTOREV}"
SRCREV_pn-matchbox-theme-sato-2 ?= "${AUTOREV}"
SRCREV_pn-tasks ?= "${AUTOREV}"
SRCREV_pn-sato-icon-theme ?= "${AUTOREV}"
SRCREV_pn-matchbox-desktop-sato ?= "${AUTOREV}"
SRCREV_pn-oh-puzzles ?= "${AUTOREV}"
SRCREV_pn-libowl ?= "${AUTOREV}"
SRCREV_pn-matchbox-applet-light ?= "${AUTOREV}"
SRCREV_pn-fstests ?= "${AUTOREV}"
SRCREV_pn-xvideo-tests ?= "${AUTOREV}"
SRCREV_pn-clutter ?= "${AUTOREV}"
SRCREV_pn-clutter-gst ?= "${AUTOREV}"
SRCREV_pn-gaku ?= "${AUTOREV}"
SRCREV_pn-gypsy ?= "${AUTOREV}"
SRCREV_pn-webkit-gtk ?= "${AUTOREV}"
SRCREV_pn-aaina ?= "${AUTOREV}"
SRCREV_pn-clutter-cairo ?= "${AUTOREV}"
SRCREV_pn-table ?= "${AUTOREV}"
SRCREV_pn-libmatchbox ?= "${AUTOREV}"
SRCREV_pn-tasks ?= "${AUTOREV}"
SRCREV_pn-libjana = "${AUTOREV}"
```

## meta/conf/distro/include/poky-glibc.inc
```bitbake
#
# glibc specific configuration
#

# Add glibc to the overrides.
OVERRIDES =. "libc-glibc:"

#glibc
PREFERRED_PROVIDER_virtual/libiconv ?= "glibc"
PREFERRED_PROVIDER_virtual/libintl ?= "glibc"
PREFERRED_PROVIDER_virtual/libc ?= "glibc"
PREFERRED_PROVIDER_virtual/${TARGET_PREFIX}libc-initial ?= "glibc-initial"

#glibc-nativesdk
PREFERRED_PROVIDER_virtual/libiconv-nativesdk ?= "glibc-nativesdk"
PREFERRED_PROVIDER_virtual/libc-nativesdk ?= "glibc-nativesdk"
PREFERRED_PROVIDER_virtual/${SDK_PREFIX}libc-initial-nativesdk ?= "glibc-initial-nativesdk"

TARGET_OS = "${GLIBCTARGETOS}"

CXXFLAGS += "-fvisibility-inlines-hidden"

LIBC_DEPENDENCIES = "\
    libsegfault \
    glibc \
    glibc-dbg \
    glibc-dev \
    glibc-utils \
    glibc-thread-db \
    glibc-localedata-i18n \
    glibc-gconv-ibm850 \
    glibc-gconv-cp1252 \
    glibc-gconv-iso8859-1 \
    glibc-gconv-iso8859-15 \
    locale-base-en-gb \
    "
```

## meta/conf/distro/include/poky-moblin.inc
```bitbake
TARGET_VENDOR = "-poky"

PREFERRED_PROVIDER_virtual/${TARGET_PREFIX}libc-for-gcc = "glibc"
PREFERRED_PROVIDER_virtual/${TARGET_PREFIX}binutils = "binutils-cross"
PREFERRED_PROVIDER_virtual/${TARGET_PREFIX}gcc-initial = "gcc-cross-initial"
PREFERRED_PROVIDER_virtual/${TARGET_PREFIX}gcc-intermediate = "gcc-cross-intermediate"
PREFERRED_PROVIDER_virtual/${TARGET_PREFIX}gcc = "gcc-cross"
PREFERRED_PROVIDER_virtual/${TARGET_PREFIX}g++ = "gcc-cross"

GCCVERSION ?= "4.2.3"
BINUVERSION = "2.18"

PREFERRED_VERSION_gcc ?= "${GCCVERSION}"
PREFERRED_VERSION_gcc-cross ?= "${GCCVERSION}"
PREFERRED_VERSION_gcc-cross-initial ?= "${GCCVERSION}"
PREFERRED_VERSION_gcc-cross-intermediate ?= "${GCCVERSION}"
PREFERRED_VERSION_gcc-cross-sdk ?= "${GCCVERSION}"
PREFERRED_VERSION_binutils ?= "${BINUVERSION}"
PREFERRED_VERSION_binutils-cross ?= "${BINUVERSION}"
PREFERRED_VERSION_linux-libc-headers ?= "2.6.24"
PREFERRED_VERSION_glibc ?= "2.6.1"
PREFERRED_VERSION_glibc-initial ?= "2.6.1"
PREFERRED_VERSION_elfutils ?= "0.131"

require conf/distro/include/as-needed.inc
```

## meta/conf/distro/include/poky-oabi.inc
```bitbake
#
# Poky configuration to use its Original (Old) Softfloat ABI
#
TARGET_VENDOR = "-poky"

PREFERRED_PROVIDER_virtual/${TARGET_PREFIX}gcc-initial = "gcc-cross-initial"
PREFERRED_PROVIDER_virtual/${TARGET_PREFIX}gcc = "gcc-cross"
PREFERRED_PROVIDER_virtual/${TARGET_PREFIX}g++ = "gcc-cross"
PREFERRED_PROVIDER_virtual/${TARGET_PREFIX}libc-for-gcc = "glibc"
PREFERRED_PROVIDER_virtual/${TARGET_PREFIX}binutils = "binutils-cross"

PREFERRED_VERSION_binutils ?= "2.16"
PREFERRED_VERSION_binutils-cross ?= "2.15.94.0.1"
PREFERRED_VERSION_gcc ?= "3.4.4"
PREFERRED_VERSION_gcc-cross ?= "3.4.4"
PREFERRED_VERSION_gcc-cross-initial ?= "3.4.4"
PREFERRED_VERSION_linux-libc-headers ?= "2.6.11.1"
PREFERRED_VERSION_glibc ?= "2.3.5+cvs20050627"

GLIBCTARGETOS = "linux"
UCLIBCTARGETOS = "linux-uclibc"
```

## meta/conf/distro/include/poky-uclibc.inc
```bitbake
#
# uclibc specific configuration
#

# Add uclibc overrides to the overrides.
OVERRIDES =. "libc-uclibc:"

PREFERRED_PROVIDER_virtual/libc = "uclibc"
PREFERRED_PROVIDER_virtual/${TARGET_PREFIX}libc-for-gcc = "uclibc"
PREFERRED_PROVIDER_virtual/libiconv ?= "libiconv"
PREFERRED_PROVIDER_virtual/libintl ?= "gettext"

USE_NLS ?= "no"
USE_NLS_glib-2.0 = "yes"

TARGET_OS = "${UCLIBCTARGETOS}"

CXXFLAGS += "-fvisibility-inlines-hidden"

IMAGE_LINGUAS = ""

DEPLOY_DIR = "${TMPDIR}/deploy-uclibc"
DEPLOY_DIR_IMAGE = "${TMPDIR}/deploy/images"

LIBC_DEPENDENCIES = "\
    uclibc \
    uclibc-dbg \
    uclibc-dev \
    uclibc-thread-db \
    "
```

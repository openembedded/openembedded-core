## meta/conf/distro/include/preferred-xorg-versions.inc
```bitbake
#
# The latest Xorg package versions
#

PREFERRED_VERSION_applewmproto ?= "1.4.1"
PREFERRED_VERSION_bigreqsproto ?= "1.1.1"
PREFERRED_VERSION_bigreqsproto-native ?= "1.1.1"
PREFERRED_VERSION_bigreqsproto-nativesdk ?= "1.1.1"
PREFERRED_VERSION_compositeproto ?= "0.4.2"
PREFERRED_VERSION_damageproto ?= "1.2.1"
PREFERRED_VERSION_dmxproto ?= "2.3"
PREFERRED_VERSION_evieext ?= "1.1.0"
PREFERRED_VERSION_fixesproto ?= "4.1.2"
PREFERRED_VERSION_fontcacheproto ?= "0.1.3"
PREFERRED_VERSION_fontcacheproto-native ?= "0.1.3"
PREFERRED_VERSION_fontsproto ?= "2.1.1"
PREFERRED_VERSION_fontsproto-native ?= "2.1.1"
PREFERRED_VERSION_gccmakedep ?= "1.0.2"
PREFERRED_VERSION_glproto ?= "1.4.12"
PREFERRED_VERSION_imake ?= "1.0.4"
PREFERRED_VERSION_inputproto ?= "2.0.1"
PREFERRED_VERSION_inputproto-native ?= "2.0.1"
PREFERRED_VERSION_inputproto-nativesdk ?= "2.0.1"
PREFERRED_VERSION_kbproto ?= "1.0.5"
PREFERRED_VERSION_kbproto-native ?= "1.0.5"
PREFERRED_VERSION_kbproto-nativesdk ?= "1.0.5"
PREFERRED_VERSION_libapplewm ?= "1.0.0"
PREFERRED_VERSION_libdmx ?= "1.1.1"
PREFERRED_VERSION_libfontenc ?= "1.1.0"
PREFERRED_VERSION_libfontenc-native ?= "1.1.0"
PREFERRED_VERSION_libfs ?= "1.0.1"
PREFERRED_VERSION_libice ?= "1.0.7"
PREFERRED_VERSION_liblbxutil ?= "1.1.0"
PREFERRED_VERSION_liboldx ?= "1.0.1"
PREFERRED_VERSION_libsm ?= "1.2.0"
PREFERRED_VERSION_libwindowswm ?= "1.0.0"
PREFERRED_VERSION_libx11 ?= "1.3.4"
PREFERRED_VERSION_libx11-diet ?= "1.3"
PREFERRED_VERSION_libx11-native ?= "1.3.4"
PREFERRED_VERSION_libx11-nativesdk ?= "1.3.4"
PREFERRED_VERSION_libx11-trim ?= "1.3.4"
PREFERRED_VERSION_libxau ?= "1.0.6"
PREFERRED_VERSION_libxau-native ?= "1.0.6"
PREFERRED_VERSION_libxau-nativesdk ?= "1.0.6"
PREFERRED_VERSION_libxaw ?= "1.0.5"
PREFERRED_VERSION_libxcomposite ?= "0.4.3"
PREFERRED_VERSION_libxcursor ?= "1.1.11"
PREFERRED_VERSION_libxdamage ?= "1.1.3"
PREFERRED_VERSION_libxdmcp ?= "1.1.0"
PREFERRED_VERSION_libxdmcp-native ?= "1.1.0"
PREFERRED_VERSION_libxdmcp-nativesdk ?= "1.1.0"
PREFERRED_VERSION_libxevie ?= "1.0.2"
PREFERRED_VERSION_libxext ?= "1.2.0"
PREFERRED_VERSION_libxext-nativesdk ?= "1.2.0"
PREFERRED_VERSION_libxfixes ?= "4.0.5"
PREFERRED_VERSION_libxfont ?= "1.4.3"
PREFERRED_VERSION_libxfont-native ?= "1.4.3"
PREFERRED_VERSION_libxfontcache ?= "1.0.5"
PREFERRED_VERSION_libxft ?= "2.2.0"
PREFERRED_VERSION_libxi ?= "1.4.0"
PREFERRED_VERSION_libxinerama ?= "1.1.1"
PREFERRED_VERSION_libxkbfile ?= "1.0.7"
PREFERRED_VERSION_libxkbui ?= "1.0.2"
PREFERRED_VERSION_libxmu ?= "1.1.0"
PREFERRED_VERSION_libxp ?= "1.0.0"
PREFERRED_VERSION_libxpm ?= "3.5.9"
PREFERRED_VERSION_libxprintapputil ?= "1.0.1"
PREFERRED_VERSION_libxprintutil ?= "1.0.1"
PREFERRED_VERSION_libxrandr ?= "1.3.1"
PREFERRED_VERSION_libxrandr-nativesdk ?= "1.3.1"
PREFERRED_VERSION_libxrender ?= "0.9.6"
PREFERRED_VERSION_libxrender-nativesdk ?= "0.9.6"
PREFERRED_VERSION_libxres ?= "1.0.5"
PREFERRED_VERSION_libxscrnsaver ?= "1.2.1"
PREFERRED_VERSION_libxt ?= "1.0.9"
PREFERRED_VERSION_libxtrap ?= "1.0.0"
PREFERRED_VERSION_libxtst ?= "1.2.0"
PREFERRED_VERSION_libxv ?= "1.0.6"
PREFERRED_VERSION_libxvmc ?= "1.0.6"
PREFERRED_VERSION_libxxf86dga ?= "1.1.2"
PREFERRED_VERSION_libxxf86misc ?= "1.0.3"
PREFERRED_VERSION_libxxf86vm ?= "1.1.1"
PREFERRED_VERSION_lndir ?= "1.0.1"
PREFERRED_VERSION_makedepend ?= "1.0.3"
PREFERRED_VERSION_makedepend-native ?= "1.0.3"
PREFERRED_VERSION_pixman ?= "0.21.2"
PREFERRED_VERSION_printproto ?= "1.0.4"
PREFERRED_VERSION_randrproto ?= "1.3.2"
PREFERRED_VERSION_randrproto-nativesdk ?= "1.3.2"
PREFERRED_VERSION_recordproto ?= "1.14.1"
PREFERRED_VERSION_renderproto ?= "0.11.1"
PREFERRED_VERSION_renderproto-nativesdk ?= "0.11.1"
PREFERRED_VERSION_resourceproto ?= "1.1.1"
PREFERRED_VERSION_scrnsaverproto ?= "1.2.1"
PREFERRED_VERSION_trapproto ?= "3.4.3"
PREFERRED_VERSION_util-macros ?= "1.11.0"
PREFERRED_VERSION_util-macros-native ?= "1.11.0"
PREFERRED_VERSION_videoproto ?= "2.3.1"
PREFERRED_VERSION_windowswmproto ?= "1.0.4"
PREFERRED_VERSION_x11perf ?= "1.5.2"
PREFERRED_VERSION_xauth ?= "1.0.5"
PREFERRED_VERSION_xcmiscproto ?= "1.2.1"
PREFERRED_VERSION_xcmiscproto-native ?= "1.2.1"
PREFERRED_VERSION_xcmiscproto-nativesdk ?= "1.2.1"
PREFERRED_VERSION_xdpyinfo ?= "1.2.0"
PREFERRED_VERSION_xev ?= "1.0.3"
PREFERRED_VERSION_xextproto ?= "7.1.2"
PREFERRED_VERSION_xextproto-native ?= "7.1.2"
PREFERRED_VERSION_xextproto-nativesdk ?= "7.1.2"
PREFERRED_VERSION_xf86bigfontproto ?= "1.2.0"
PREFERRED_VERSION_xf86bigfontproto-native ?= "1.2.0"
PREFERRED_VERSION_xf86bigfontproto-nativesdk ?= "1.2.0"
PREFERRED_VERSION_xf86dgaproto ?= "2.1"
PREFERRED_VERSION_xf86driproto ?= "2.1.0"
PREFERRED_VERSION_dri2proto ?= "2.3"
PREFERRED_VERSION_xf86miscproto ?= "0.9.3"
PREFERRED_VERSION_xf86rushproto ?= "1.1.2"
PREFERRED_VERSION_xf86vidmodeproto ?= "2.3"
PREFERRED_VERSION_xhost ?= "1.0.4"
PREFERRED_VERSION_xinit ?= "1.3.0"
PREFERRED_VERSION_xineramaproto ?= "1.2"
PREFERRED_VERSION_xmodmap ?= "1.0.5"
PREFERRED_VERSION_xorg-cf-files ?= "1.0.3"
PREFERRED_VERSION_xprop ?= "1.2.0"
PREFERRED_VERSION_xproto ?= "7.0.20"
PREFERRED_VERSION_xproto-native ?= "7.0.20"
PREFERRED_VERSION_xproto-nativesdk ?= "7.0.20"
PREFERRED_VERSION_xproxymanagementprotocol ?= "1.0.3"
PREFERRED_VERSION_xrandr ?= "1.3.4"
PREFERRED_VERSION_xrdb ?= "1.0.5"
PREFERRED_VERSION_xserver-kdrive ?= "1.7.99.2"
PREFERRED_VERSION_xserver-xf86-dri-lite ?= "1.9.2"
PREFERRED_VERSION_xset ?= "1.2.1"
PREFERRED_VERSION_xtrans ?= "1.2.6"
PREFERRED_VERSION_xtrans-native ?= "1.2.6"
PREFERRED_VERSION_xtrans-nativesdk ?= "1.2.6"
PREFERRED_VERSION_xvinfo ?= "1.0.2"
PREFERRED_VERSION_xwininfo ?= "1.1.0"
PREFERRED_VERSION_mesa-dri ?= "7.9"
PREFERRED_VERSION_libdrm ?= "2.4.22"
PREFERRED_VERSION_xcb-proto ?= "1.6"
PREFERRED_VERSION_libxcb ?= "1.7"
PREFERRED_VERSION_libxcb-nativesdk ?= "1.7"
PREFERRED_VERSION_libpciaccess ?= "0.12.0"
PREFERRED_VERSION_xf86-input-evdev ?= "2.6.0"
PREFERRED_VERSION_xf86-input-mouse ?= "1.6.0"
PREFERRED_VERSION_xf86-input-keyboard ?= "1.5.0"
PREFERRED_VERSION_xf86-input-synaptics ?= "1.3.0"
PREFERRED_VERSION_xf86-video-intel ?= "2.13.0"
```

## meta/conf/distro/include/private/distro_base_libs_1.inc
```bitbake
RECIPE_STATUS_pn-icu = "yellow" #do_configure for autotool;icu-3.6.inc
DEPENDENCY_CHECK_pn-icu = "not done"
RECIPE_LATEST_VERSION_pn-icu = "3_6"
RECIPE_PATCH_pn-icu+gccfix = "to be pushed upstream"
RECIPE_PATCH_pn-icu+use-g++-for-linking = "Unclear"
RECIPE_INTEL_SECTION_pn-icu = "base libs"
RECIPE_TIME_BETWEEN_LAST_TWO_RELEASES_pn-icu = "n/a"
RECIPE_LATEST_RELEASE_DATE_pn-icu = "08/2006"
RECIPE_COMMENTS_pn-icu = "arm optimizations; license similar to MIT, however sub-license is not allowed; autoreconf is not used and current style is not clean. need enhancement in the future"

RECIPE_STATUS_pn-eggdbus = "yellow" # patch comment
DEPENDENCY_CHECK_pn-eggdbus = "not done"
RECIPE_LATEST_VERSION_pn-eggdbus = "0.6"
RECIPE_PATCH_pn-eggdbus+gtk-doc = "local; no comment; poky doesn't have full gtk-doc support, and eggdbus itself references AM_CONDITIONAL in Makefile.am earlier before configure script is run"
RECIPE_PATCH_pn-eggdbus+marshal = "local; no comment; one binary generated in eggdbus build needs to be invoked. So point to native version"
RECIPE_INTEL_SECTION_pn-eggdbus = "base libs"
RECIPE_TIME_BETWEEN_LAST_TWO_RELEASES_pn-eggdbus = "4 months"
RECIPE_LATEST_RELEASE_DATE_pn-eggdbus = "11/2009"
RECIPE_COMMENTS_pn-eggdbus = "http://mail.gnome.org/archives/gtk-devel-list/2008-December/msg00059.html contains more detail introduction"

RECIPE_STATUS_pn-libdaemon = "green"
DEPENDENCY_CHECK_pn-libdaemon = "not done"
RECIPE_LATEST_VERSION_pn-libdaemon = "0.14"
RECIPE_INTEL_SECTION_pn-libdaemon = "base libs"
RECIPE_TIME_BETWEEN_LAST_TWO_RELEASES_pn-libdaemon = "15 months"
RECIPE_LATEST_RELEASE_DATE_pn-libdaemon = "11/2009"
RECIPE_COMMENTS_pn-libdaemon = ""

RECIPE_STATUS_pn-glib-2.0 = "green"
DEPENDENCY_CHECK_pn-glib-2.0 = "not done"
RECIPE_LATEST_VERSION_pn-glib-2.0 = "2.24.1"
RECIPE_PATCH_pn-glib-2.0+60_wait-longer-for-threads-to-die = "to be pushed upstream"
RECIPE_PATCH_pn-glib-2.0+configure-libtool = "local"
RECIPE_PATCH_pn-glib-2.0+gatomic-proper-pointer-get-cast = "in upstream"
RECIPE_PATCH_pn-glib-2.0+glib-gettextize-dir = "marked as REMOVAL"
RECIPE_INTEL_SECTION_pn-glib-2.0 = "base libs"
RECIPE_TIME_BETWEEN_LAST_TWO_RELEASES_pn-glib-2.0 = "7 months"
RECIPE_LATEST_RELEASE_DATE_pn-glib-2.0 = "05/2010"
RECIPE_COMMENTS_pn-glib-2.0 = ""

RECIPE_STATUS_pn-pam = "green"
DEPENDENCY_CHECK_pn-pam = "not done"
RECIPE_LATEST_VERSION_pn-pam = "1.1.1"
RECIPE_PATCH_pn-pam+disable_crossbinary = "added by RP; 2008; padout requires native compilation and not used in the target. so disable it. local patch"
RECIPE_INTEL_SECTION_pn-pam = "base libs"
RECIPE_TIME_BETWEEN_LAST_TWO_RELEASES_pn-pam = "6 months"
RECIPE_LATEST_RELEASE_DATE_pn-pam = "12/2009"
RECIPE_COMMENTS_pn-pam = ""

RECIPE_STATUS_pn-libgpg-error = "yellow" # specific .pc handle
DEPENDENCY_CHECK_pn-libgpg-error = "not done"
RECIPE_LATEST_VERSION_pn-libgpg-error = "1.8"
RECIPE_PATCH_pn-libgpg-error+pkgconfig = "long existing since 0.7; no exact commit; it's to add a .pc.in. perhaps we don't require it now?"
RECIPE_INTEL_SECTION_pn-libgpg-error = "base libs"
RECIPE_TIME_BETWEEN_LAST_TWO_RELEASES_pn-libgpg-error = "18 months"
RECIPE_LATEST_RELEASE_DATE_pn-libgpg-error = "05/2010"
RECIPE_COMMENTS_pn-libgpg-error = ""

RECIPE_STATUS_pn-gpgme = "green"
DEPENDENCY_CHECK_pn-gpgme = "not done"
RECIPE_LATEST_VERSION_pn-gpgme = "1.3.0"
RECIPE_INTEL_SECTION_pn-gpgme = "base libs"
RECIPE_TIME_BETWEEN_LAST_TWO_RELEASES_pn-gpgme = "6 months"
RECIPE_LATEST_RELEASE_DATE_pn-gpgme = "01/2010"
RECIPE_COMMENTS_pn-gpgme = ""

RECIPE_STATUS_pn-expat = "green"
DEPENDENCY_CHECK_pn-expat = "not done"
RECIPE_LATEST_VERSION_pn-expat = "2.0.1"
RECIPE_PATCH_pn-expat+autotools = "added in 2.0.0; 70774a74; 2006; don't include its own version of m4"
RECIPE_INTEL_SECTION_pn-expat = "base libs"
RECIPE_TIME_BETWEEN_LAST_TWO_RELEASES_pn-expat = "17 months"
RECIPE_LATEST_RELEASE_DATE_pn-expat = "06/2007"
RECIPE_COMMENTS_pn-expat = ""

RECIPE_STATUS_pn-dbus = "green"
DEPENDENCY_CHECK_pn-dbus = "not done"
RECIPE_LATEST_VERSION_pn-dbus = "1.2.24"
RECIPE_PATCH_pn-dbus+tmpdir = "an old patch dated to 2005; no exact commit; seems to handle tmp dir check at build time. need test whether valid now"
RECIPE_PATCH_pn-dbus+fix-install-daemon = "by RP; 2009; 8e39848b; handle dbus-daemon install; need more study later"
RECIPE_INTEL_SECTION_pn-dbus = "base libs"
RECIPE_TIME_BETWEEN_LAST_TWO_RELEASES_pn-dbus = "1 months"
RECIPE_LATEST_RELEASE_DATE_pn-dbus = "03/2010"
RECIPE_COMMENTS_pn-dbus = "unstable version at 1.3.1; though current latest version in poky is 1.2.14, it's 1.2.4 preferred"

RECIPE_STATUS_pn-dbus-glib = "green"
DEPENDENCY_CHECK_pn-dbus-glib = "not done"
RECIPE_LATEST_VERSION_pn-dbus-glib = "0.86"
RECIPE_PATCH_pn-dbus-glib+fix_asneeded = "added in 2009; adjust link order of expat. not sure the reason yet. disable for now"
RECIPE_PATCH_pn-dbus-glib+no-examples = "no need to build example. local patch"
RECIPE_INTEL_SECTION_pn-dbus-glib = "base libs"
RECIPE_TIME_BETWEEN_LAST_TWO_RELEASES_pn-dbus-glib = "6 months"
RECIPE_LATEST_RELEASE_DATE_pn-dbus-glib = "03/2010"
RECIPE_COMMENTS_pn-dbus-glib = ""

RECIPE_STATUS_pn-neon="green"
DEPENDENCY_CHECK_pn-neon = "not done"
RECIPE_LATEST_VERSION_pn-neon="0.29.3"
RECIPE_NO_OF_PATCHES_pn-neon="0"
RECIPE_INTEL_SECTION_pn-neon = "base libs"
RECIPE_LATEST_RELEASE_DATE_pn-neon="01/2010"
RECIPE_TIME_BETWEEN_LAST_TWO_RELEASES_pn-neon="15 days"
RECIPE_COMMENTS_pn-neon = ""

RECIPE_STATUS_pn-libpng = "green"
DEPENDENCY_CHECK_pn-libpng = "not done"
RECIPE_LATEST_VERSION_pn-libpng = "1.4.3"
RECIPE_PATCH_pn-libpng+makefile = "by RP; 2008; to define ECHO explicitly for lbitool 2.2.2. need check whether it's still valide for new libtool. candidate for upstream"
RECIPE_INTEL_SECTION_pn-libpng = "base libs"
RECIPE_TIME_BETWEEN_LAST_TWO_RELEASES_pn-libpng = "1 month"
RECIPE_LATEST_RELEASE_DATE_pn-libpng = "06/2010"
RECIPE_COMMENTS_pn-libpng = ""

RECIPE_STATUS_pn-libidn = "green"
DEPENDENCY_CHECK_pn-libidn = "not done"
RECIPE_LATEST_VERSION_pn-libidn = "1.19"
RECIPE_INTEL_SECTION_pn-libidn = "base libs"
RECIPE_TIME_BETWEEN_LAST_TWO_RELEASES_pn-libidn = "3 months"
RECIPE_LATEST_RELEASE_DATE_pn-libidn = "05/2010"
RECIPE_COMMENTS_pn-libidn = ""

RECIPE_STATUS_pn-glibc = "green" # OK
DEPENDENCY_CHECK_pn-glibc = "not done"
RECIPE_LATEST_VERSION_pn-glibc = "2.11.2"
RECIPE_INTEL_SECTION_pn-glibc = "base libs"
RECIPE_TIME_BETWEEN_LAST_TWO_RELEASES_pn-glibc = "5 months"
RECIPE_LATEST_RELEASE_DATE_pn-glibc = "05/2010"
RECIPE_COMMENTS_pn-glibc = ""

RECIPE_STATUS_pn-liboil = "green"
DEPENDENCY_CHECK_pn-liboil = "not done"
RECIPE_LATEST_VERSION_pn-liboil = "0.3.17"
RECIPE_NO_OF_PATCHES_pn-liboil = "1"
RECIPE_INTEL_SECTION_pn-liboil = "base libs"
RECIPE_TIME_BETWEEN_LAST_TWO_RELEASES_pn-liboil = "11 months"
RECIPE_LATEST_RELEASE_DATE_pn-liboil = "02/2010"
RECIPE_COMMENTS_pn-liboil = ""

RECIPE_STATUS_pn-libassuan = "green"
DEPENDENCY_CHECK_pn-libassuan = "not done"
RECIPE_LATEST_VERSION_pn-libassuan = "2.0.0"
RECIPE_NO_OF_PATCHES_pn-libassuan = "0"
RECIPE_INTEL_SECTION_pn-libassuan = "base libs"
RECIPE_TIME_BETWEEN_LAST_TWO_RELEASES_pn-libassuan = "2 years"
RECIPE_LATEST_RELEASE_DATE_pn-libassuan = "01/2010"
RECIPE_COMMENTS_pn-libassuan = ""

RECIPE_STATUS_pn-db = "green"
DEPENDENCY_CHECK_pn-db = "not done"
RECIPE_LATEST_VERSION_pn-db = "5.0.26"
RECIPE_INTEL_SECTION_pn-db = "base libs"
RECIPE_TIME_BETWEEN_LAST_TWO_RELEASES_pn-db = "n/a"
RECIPE_LATEST_RELEASE_DATE_pn-db = "n/a"
RECIPE_COMMENTS_pn-db = ""
```

## meta/conf/distro/include/private/distro_commands.inc
```bitbake
RECIPE_STATUS_pn-at = "green"
DEPENDENCY_CHECK_pn-at = "not done" 
RECIPE_LATEST_VERSION_pn-at = "3.1.12"
RECIPE_INTEL_SECTION_pn-at = "base"
RECIPE_NO_OF_PATCHES_pn-at = "3"
RECIPE_TIME_BETWEEN_LAST_TWO_RELEASES_pn-at = "13 months"
RECIPE_LATEST_RELEASE_DATE_pn-at = "11/2009"

RECIPE_STATUS_pn-cpio = "red"
DEPENDENCY_CHECK_pn-cpio = "not done"
RECIPE_LATEST_VERSION_pn-cpio = "2.11"
RECIPE_INTEL_SECTION_pn-cpio = "base"
RECIPE_NO_OF_PATCHES_pn-cpio = "0"
RECIPE_TIME_BETWEEN_LAST_TWO_RELEASES_pn-cpio = "9 months"
RECIPE_LATEST_RELEASE_DATE_pn-cpio = "03/2010"

RECIPE_STATUS_pn-cronie = "red"
DEPENDENCY_CHECK_pn-cronie = "not done"
RECIPE_LATEST_VERSION_pn-cronie = "1.4.4"
RECIPE_INTEL_SECTION_pn-cronie = "base"
RECIPE_NO_OF_PATCHES_pn-cronie = "0"
RECIPE_TIME_BETWEEN_LAST_TWO_RELEASES_pn-cronie = "3 months"
RECIPE_LATEST_RELEASE_DATE_pn-cronie = "02/2010"

RECIPE_STATUS_pn-crontabs = "red" 
DEPENDENCY_CHECK_pn-crontabs = "not done"
RECIPE_LATEST_VERSION_pn-crontabs = "n/a"
RECIPE_INTEL_SECTION_pn-crontabs = "base"
RECIPE_NO_OF_PATCHES_pn-crontabs = "0"
RECIPE_TIME_BETWEEN_LAST_TWO_RELEASES_pn-crontabs = "n/a"
RECIPE_LATEST_RELEASE_DATE_pn-crontabs = "n/a"

RECIPE_STATUS_pn-grep = "red" 
DEPENDENCY_CHECK_pn-grep = "not done"
RECIPE_LATEST_VERSION_pn-grep = "2.6.3"
RECIPE_INTEL_SECTION_pn-grep = "base"
RECIPE_NO_OF_PATCHES_pn-grep = "0"
RECIPE_TIME_BETWEEN_LAST_TWO_RELEASES_pn-grep = "1 month"
RECIPE_LATEST_RELEASE_DATE_pn-grep = "04/2010"

RECIPE_STATUS_pn-mailx = "red" 
DEPENDENCY_CHECK_pn-mailx = "not done"
RECIPE_LATEST_VERSION_pn-mailx = "8.1.2"
RECIPE_INTEL_SECTION_pn-mailx = "base"
RECIPE_NO_OF_PATCHES_pn-mailx = "0"
RECIPE_TIME_BETWEEN_LAST_TWO_RELEASES_pn-mailx = "n/a"
RECIPE_LATEST_RELEASE_DATE_pn-mailx = "n/a"

RECIPE_STATUS_pn-openssh = "red" 
DEPENDENCY_CHECK_pn-openssh = "not done"
RECIPE_LATEST_VERSION_pn-openssh = "5.5p1"
RECIPE_INTEL_SECTION_pn-openssh = "base"
RECIPE_NO_OF_PATCHES_pn-openssh = "0"
RECIPE_TIME_BETWEEN_LAST_TWO_RELEASES_pn-openssh = "1 month"
RECIPE_LATEST_RELEASE_DATE_pn-openssh = "04/2010"

RECIPE_STATUS_pn-tar = "green" 
DEPENDENCY_CHECK_pn-tar = "not done"
RECIPE_LATEST_VERSION_pn-tar = "1.23"
RECIPE_INTEL_SECTION_pn-tar = "base"
RECIPE_NO_OF_PATCHES_pn-tar = "2"
RECIPE_TIME_BETWEEN_LAST_TWO_RELEASES_pn-tar = "12 months"
RECIPE_LATEST_RELEASE_DATE_pn-tar = "03/2010"
```

## meta/conf/distro/include/private/distro_connectivity.inc
```bitbake
RECIPE_STATUS_pn-lrzsz="yellow" # patch investigation needed.
RECIPE_LATEST_VERSION_pn-lrzsz="0.12.20"
RECIPE_NO_OF_PATCHES_pn-lrzsz="3"
RECIPE_LATEST_RELEASE_DATE_pn-lrzsz="1998/12/31"
RECIPE_TIME_BETWEEN_LAST_TWO_RELEASES_pn-lrzsz="12 months"
RECIPE_MAINTAINER_pn-lrzsz = "Dongxiao Xu <dongxiao.xu@intel.com>"

RECIPE_STATUS_pn-wireless-tools="yellow" # patch investigation needed
RECIPE_LATEST_VERSION_pn-wireless-tools="29"
RECIPE_NO_OF_PATCHES_pn-wireless-tools="3"
RECIPE_LATEST_RELEASE_DATE_pn-wireless-tools="2007/09/18"
RECIPE_TIME_BETWEEN_LAST_TWO_RELEASES_pn-wireless-tools="18 months"
RECIPE_MAINTAINER_pn-wireless-tools = "Dongxiao Xu <dongxiao.xu@intel.com>"

RECIPE_STATUS_pn-bluez-dtl1-workaround="yellow" # LICENSE double check
RECIPE_LATEST_VERSION_pn-bluez-dtl1-workaround="1.0"
RECIPE_NO_OF_PATCHES_pn-bluez-dtl1-workaround="0"
RECIPE_LATEST_RELEASE_DATE_pn-bluez-dtl1-workaround="n/a"
RECIPE_TIME_BETWEEN_LAST_TWO_RELEASES_pn-bluez-dtl1-workaround="n/a"
RECIPE_MAINTAINER_pn-bluez-dtl1-workaround = "Dongxiao Xu <dongxiao.xu@intel.com>"

RECIPE_STATUS_pn-irda-utils="green"
RECIPE_LATEST_VERSION_pn-irda-utils="0.9.18"
RECIPE_NO_OF_PATCHES_pn-irda-utils="0"
RECIPE_LATEST_RELEASE_DATE_pn-irda-utils="2006/07/10"
RECIPE_TIME_BETWEEN_LAST_TWO_RELEASES_pn-irda-utils="4 months"
RECIPE_MAINTAINER_pn-irda-utils = "Dongxiao Xu <dongxiao.xu@intel.com>"

RECIPE_STATUS_pn-bluez4="green"
DISTRO_PN_ALIAS_pn-bluez4="Meego=bluz Fedora=bluz Ubuntu=bluz OpenSuSE=bluz Mandriva=bluz"
RECIPE_LATEST_VERSION_pn-bluez4="4.66"
RECIPE_NO_OF_PATCHES_pn-bluez4="2"
RECIPE_LATEST_RELEASE_DATE_pn-bluez4="2010/05/24"
RECIPE_TIME_BETWEEN_LAST_TWO_RELEASES_pn-bluez4="1 month"
DISTRO_PN_ALIAS_pn-bluez4= "Fedora=bluez Ubuntu=bluez Debian=bluez-utils Opensuse=bluez"
RECIPE_MAINTAINER_pn-bluez4 = "Dongxiao Xu <dongxiao.xu@intel.com>"

RECIPE_STATUS_pn-libpcap="green"
RECIPE_LATEST_VERSION_pn-libpcap="1.1.1"
RECIPE_NO_OF_PATCHES_pn-libpcap="2"
RECIPE_LATEST_RELEASE_DATE_pn-libpcap="2010/04/05"
RECIPE_TIME_BETWEEN_LAST_TWO_RELEASES_pn-libpcap="2 months"
RECIPE_MAINTAINER_pn-libpcap = "Dongxiao Xu <dongxiao.xu@intel.com>"

RECIPE_STATUS_pn-wpa-supplicant="green"
DISTRO_PN_ALIAS_pn-wpa-supplicant = "Meego=wpa_supplicant Fedora=wpa_supplicant OpenSuSE=wpa_supplicant Ubuntu=wpasupplicant Mandriva=wpa_supplicant Debian=wpasupplicant"
RECIPE_LATEST_VERSION_pn-wpa-supplicant="0.7.2"
RECIPE_NO_UPDATE_REASON_pn-wpa-supplicant="0.7.2 is development version, and latest stable version is 0.6.10"
RECIPE_NO_OF_PATCHES_pn-wpa-supplicant="0"
RECIPE_LATEST_RELEASE_DATE_pn-wpa-supplicant="2010/04/18"
RECIPE_TIME_BETWEEN_LAST_TWO_RELEASES_pn-wpa-supplicant="3 months"
RECIPE_MAINTAINER_pn-wpa-supplicant = "Dongxiao Xu <dongxiao.xu@intel.com>"

RECIPE_STATUS_pn-ppp="green"
RECIPE_LATEST_VERSION_pn-ppp="2.4.5"
RECIPE_NO_OF_PATCHES_pn-ppp="5"
RECIPE_LATEST_RELEASE_DATE_pn-ppp="2009/11/17"
RECIPE_TIME_BETWEEN_LAST_TWO_RELEASES_pn-ppp="4 years"
RECIPE_MAINTAINER_pn-ppp = "Dongxiao Xu <dongxiao.xu@intel.com>"

RECIPE_STATUS_pn-libproxy="green"
RECIPE_LATEST_VERSION_pn-libproxy="0.4.4"
RECIPE_NO_UPDATE_REASON_pn-libproxy="There are some issues in 0.4.4, and the fix is not pushed in yet"
RECIPE_NO_OF_PATCHES_pn-libproxy="1"
RECIPE_LATEST_RELEASE_DATE_pn-libproxy="2010/05/19"
RECIPE_TIME_BETWEEN_LAST_TWO_RELEASES_pn-libproxy="3 months"
RECIPE_MAINTAINER_pn-libproxy = "Dongxiao Xu <dongxiao.xu@intel.com>"

RECIPE_STATUS_pn-networkmanager="red"
DISTRO_PN_ALIAS_pn-networkmanager = "Fedora=NetworkManager OpenSuSE=NetworkManager Ubuntu=network-manager Debian=network-manager"
RECIPE_LATEST_VERSION_pn-networkmanager="0.8"
RECIPE_NO_UPDATE_REASON_pn-networkmanager="poky will use connman instead"
RECIPE_NO_OF_PATCHES_pn-networkmanager="4"
RECIPE_LATEST_RELEASE_DATE_pn-networkmanager="2010/04/18"
RECIPE_TIME_BETWEEN_LAST_TWO_RELEASES_pn-networkmanager="3 months"
RECIPE_MAINTAINER_pn-networkmanager = "Dongxiao Xu <dongxiao.xu@intel.com>"

RECIPE_STATUS_pn-networkmanager-applet="red"
RECIPE_LATEST_VERSION_pn-networkmanager-applet="n/a"
RECIPE_NO_UPDATE_REASON_pn-networkmanager-applet="poky will use connman instead"
RECIPE_NO_OF_PATCHES_pn-networkmanager-applet="4"
RECIPE_LATEST_RELEASE_DATE_pn-networkmanager-applet="n/a"
RECIPE_TIME_BETWEEN_LAST_TWO_RELEASES_pn-networkmanager-applet="n/a"
RECIPE_MAINTAINER_pn-networkmanager-applet = "Dongxiao Xu <dongxiao.xu@intel.com>"

RECIPE_STATUS_pn-connman = "green"
DISTRO_PN_ALIAS_pn-connman = "Meego=connman"
RECIPE_LATEST_VERSION_pn-connman = "0.56"
RECIPE_NO_OF_PATCHES_pn-connman="0"
RECIPE_LATEST_RELEASE_DATE_pn-connman="2010/08/05"
RECIPE_TIME_BETWEEN_LAST_TWO_RELEASES_pn-connman="10 days"
RECIPE_MAINTAINER_pn-connman = "Dongxiao Xu <dongxiao.xu@intel.com>"

RECIPE_STATUS_pn-connman-gnome = "green"
RECIPE_LATEST_VERSION_pn-connman-gnome = "0.5"
RECIPE_NO_OF_PATCHES_pn-connman-gnome="1"
RECIPE_LATEST_RELEASE_DATE_pn-connman-gnome="n/a"
RECIPE_TIME_BETWEEN_LAST_TWO_RELEASES_pn-connman-gnome="n/a"
RECIPE_MAINTAINER_pn-connman-gnome = "Dongxiao Xu <dongxiao.xu@intel.com>"

RECIPE_STATUS_pn-empathy = "red"
RECIPE_LATEST_VERSION_pn-empathy = "2.31.2"
RECIPE_MAINTAINER_pn-empathy = "Dongxiao Xu <dongxiao.xu@intel.com>"

RECIPE_STATUS_pn-gupnp = "red"
RECIPE_LATEST_VERSION_pn-gupnp = "0.13.3"
RECIPE_MAINTAINER_pn-gupnp = "Dongxiao Xu <dongxiao.xu@intel.com>"

RECIPE_STATUS_pn-gupnp-av = "red"
RECIPE_LATEST_VERSION_pn-gupnp-av = "0.5.5"
RECIPE_MAINTAINER_pn-gupnp-av = "Dongxiao Xu <dongxiao.xu@intel.com>"

RECIPE_STATUS_pn-gupnp-tools = "red"
RECIPE_LATEST_VERSION_pn-gupnp-tools = "0.8"
RECIPE_MAINTAINER_pn-gupnp-tools = "Dongxiao Xu <dongxiao.xu@intel.com>"

RECIPE_STATUS_pn-libopensync = "red"
RECIPE_LATEST_VERSION_pn-libopensync = "0.39"
RECIPE_MAINTAINER_pn-libopensync = "Dongxiao Xu <dongxiao.xu@intel.com>"

RECIPE_STATUS_pn-libopensync-plugin-evolution2 = "red"
RECIPE_LATEST_VERSION_pn-libopensync-plugin-evolution2 = "0.39"
RECIPE_MAINTAINER_pn-libopensync-plugin-evolution2 = "Dongxiao Xu <dongxiao.xu@intel.com>"

RECIPE_STATUS_pn-libopensync-plugin-syncml = "red"
RECIPE_LATEST_VERSION_pn-libopensync-plugin-syncml = "0.39"
RECIPE_MAINTAINER_pn-libopensync-plugin-syncml = "Dongxiao Xu <dongxiao.xu@intel.com>"

RECIPE_STATUS_pn-mobile-broadband-provider-info = "red"
RECIPE_LATEST_VERSION_pn-mobile-broadband-provider-info = "084f664306398abf0df88cb82add5a577fc4ce72"
RECIPE_MAINTAINER_pn-mobile-broadband-provider-info = "Dongxiao Xu <dongxiao.xu@intel.com>"

RECIPE_STATUS_pn-ofono = "red"
RECIPE_LATEST_VERSION_pn-ofono = "0.21"
RECIPE_MAINTAINER_pn-ofono = "Dongxiao Xu <dongxiao.xu@intel.com>"

RECIPE_STATUS_pn-libtelepathy = "red"
RECIPE_LATEST_VERSION_pn-libtelepathy = "0.3.3"
RECIPE_MAINTAINER_pn-libtelepathy = "Dongxiao Xu <dongxiao.xu@intel.com>"

RECIPE_STATUS_pn-telepathy-farsight = "red"
RECIPE_LATEST_VERSION_pn-telepathy-farsight = "0.0.14"
RECIPE_MAINTAINER_pn-telepathy-farsight = "Dongxiao Xu <dongxiao.xu@intel.com>"

RECIPE_STATUS_pn-telepathy-gabble = "red"
RECIPE_LATEST_VERSION_pn-telepathy-gabble = "0.9.11"
RECIPE_MAINTAINER_pn-telepathy-gabble = "Dongxiao Xu <dongxiao.xu@intel.com>"

RECIPE_STATUS_pn-telepathy-glib = "red"
RECIPE_LATEST_VERSION_pn-telepathy-glib = "0.11.6"
RECIPE_MAINTAINER_pn-telepathy-glib = "Dongxiao Xu <dongxiao.xu@intel.com>"

RECIPE_STATUS_pn-telepathy-idle = "red"
RECIPE_LATEST_VERSION_pn-telepathy-idle = "0.1.6"
RECIPE_MAINTAINER_pn-telepathy-idle = "Dongxiao Xu <dongxiao.xu@intel.com>"

RECIPE_STATUS_pn-telepathy-python = "red"
RECIPE_LATEST_VERSION_pn-telepathy-python = "0.15.17"
RECIPE_MAINTAINER_pn-telepathy-python = "Dongxiao Xu <dongxiao.xu@intel.com>"

RECIPE_STATUS_pn-bluez-hcidump = "red"
RECIPE_LATEST_VERSION_pn-bluez-hcidump = "1.42"
RECIPE_MAINTAINER_pn-bluez-hcidump = "Dongxiao Xu <dongxiao.xu@intel.com>"

RECIPE_STATUS_pn-ppp-dialin = "red"
RECIPE_LATEST_VERSION_pn-ppp-dialin = "n/a"
RECIPE_MAINTAINER_pn-ppp-dialin = "Dongxiao Xu <dongxiao.xu@intel.com>"

RECIPE_STATUS_pn-samba = "red"
RECIPE_LATEST_VERSION_pn-samba = "3.5.3"
RECIPE_MAINTAINER_pn-samba = "Dongxiao Xu <dongxiao.xu@intel.com>"

RECIPE_STATUS_pn-libgsmd = "red"
RECIPE_LATEST_VERSION_pn-libgsmd = "n/a"
DISTRO_PN_ALIAS_pn-libgsmd = "Fedora=gsm Ubuntu=libgsm Debian=libgsm Opensuse=libgsm"
RECIPE_MAINTAINER_pn-libgsmd = "Dongxiao Xu <dongxiao.xu@intel.com>"

RECIPE_STATUS_pn-gnet = "red"
RECIPE_LATEST_VERSION_pn-gnet = "2.0.8"
RECIPE_MAINTAINER_pn-gnet = "Dongxiao Xu <dongxiao.xu@intel.com>"

RECIPE_STATUS_pn-zeroconf = "red"
RECIPE_LATEST_VERSION_pn-zeroconf = "0.9"
DISTRO_PN_ALIAS_pn-libgsmd = "Mandriva=mono-zeroconf Debian=mono-zeroconf Opensuse=mono-zeroconf"
RECIPE_MAINTAINER_pn-zeroconf = "Dongxiao Xu <dongxiao.xu@intel.com>"

RECIPE_STATUS_pn-gypsy = "red"
RECIPE_LATEST_VERSION_pn-gypsy = "0.7"
RECIPE_MAINTAINER_pn-gypsy = "Dongxiao Xu <dongxiao.xu@intel.com>"

RECIPE_STATUS_pn-librest = "red"
RECIPE_LATEST_VERSION_pn-librest = "0.6"
RECIPE_MAINTAINER_pn-librest = "Dongxiao Xu <dongxiao.xu@intel.com>"

RECIPE_STATUS_pn-libopensync-plugin-file = "red"
RECIPE_LATEST_VERSION_pn-libopensync-plugin-file = "0.39"
RECIPE_MAINTAINER_pn-libopensync-plugin-file = "Dongxiao Xu <dongxiao.xu@intel.com>"

RECIPE_STATUS_pn-libopensync-plugin-vformat = "red"
RECIPE_LATEST_VERSION_pn-libopensync-plugin-vformat = ""0.39"
RECIPE_MAINTAINER_pn-libopensync-plugin-vformat = "Dongxiao Xu <dongxiao.xu@intel.com>"

RECIPE_STATUS_pn-libsynthesis = "red"
RECIPE_LATEST_VERSION_pn-libsynthesis = "b682e6be01f2a0ee97e034d03320059f779978a3"
RECIPE_MAINTAINER_pn-libsynthesis = "Dongxiao Xu <dongxiao.xu@intel.com>"

RECIPE_STATUS_pn-twitter-glib = "red"
RECIPE_LATEST_VERSION_pn-twitter-glib = "0.9.8"
RECIPE_MAINTAINER_pn-twitter-glib = "Dongxiao Xu <dongxiao.xu@intel.com>"

RECIPE_STATUS_pn-libsocialweb = "red"
RECIPE_LATEST_VERSION_pn-libsocialweb = "n/a"
RECIPE_MAINTAINER_pn-libsocialweb = "Dongxiao Xu <dongxiao.xu@intel.com>"

RECIPE_STATUS_pn-libccss = "red"
DISTRO_PN_ALIAS_pn-libccss = "OpenSuSE=ccss"
RECIPE_LATEST_VERSION_pn-libccss = "aaed6b2b1a206b7a0c55a786b980bdec21004a93"
RECIPE_MAINTAINER_pn-libccss = "Dongxiao Xu <dongxiao.xu@intel.com>"

RECIPE_STATUS_pn-bisho = "red"
RECIPE_LATEST_VERSION_pn-bisho = "n/a"
RECIPE_MAINTAINER_pn-bisho = "Dongxiao Xu <dongxiao.xu@intel.com>"

RECIPE_STATUS_pn-libsyncml = "red"
RECIPE_LATEST_VERSION_pn-libsyncml = "0.5.4"
RECIPE_MAINTAINER_pn-libsyncml = "Dongxiao Xu <dongxiao.xu@intel.com>"

RECIPE_STATUS_pn-telepathy-mission-control = "red"
RECIPE_LATEST_VERSION_pn-telepathy-mission-control = "5.5.0"
RECIPE_MAINTAINER_pn-telepathy-mission-control = "Dongxiao Xu <dongxiao.xu@intel.com>"

RECIPE_STATUS_pn-libetpan = "red"
RECIPE_LATEST_VERSION_pn-libetpan = "1"
RECIPE_MAINTAINER_pn-libetpan = "Dongxiao Xu <dongxiao.xu@intel.com>"

RECIPE_STATUS_pn-bickley = "red"
RECIPE_LATEST_VERSION_pn-bickley = "0.4.4"
RECIPE_MAINTAINER_pn-bickley = "Dongxiao Xu <dongxiao.xu@intel.com>"

RECIPE_STATUS_pn-mojito = "red"
RECIPE_LATEST_VERSION_pn-mojito = "n/a"
RECIPE_MAINTAINER_pn-mojito = "Dongxiao Xu <dongxiao.xu@intel.com>"
```

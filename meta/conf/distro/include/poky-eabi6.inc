## meta/conf/distro/include/private/distro_base_utils_1.inc
```bitbake
RECIPE_STATUS_pn-dbus-wait = "green"
DEPENDENCY_CHECK_pn-dbus-wait = "not done"
RECIPE_LATEST_VERSION_pn-dbus-wait = "402"
RECIPE_INTEL_SECTION_pn-dbus-wait = "base utils"
RECIPE_TIME_BETWEEN_LAST_TWO_RELEASES_pn-dbus-wait = "n/a"
RECIPE_LATEST_RELEASE_DATE_pn-dbus-wait = "08/2008"
RECIPE_COMMENTS_pn-dbus-wait = "o-hand project"
RECIPE_MAINTAINER_pn-dbus-wait= "Kevin Tian <kevin.tian@intel.com>"

RECIPE_STATUS_pn-e2fsprogs = "yellow" # patch comment
DEPENDENCY_CHECK_pn-e2fsprogs = "not done"
RECIPE_LATEST_VERSION_pn-e2fsprogs = "1.41.12"
RECIPE_PATCH_pn-e2fsprogs+quotefix = "to be pushed upstream"
RECIPE_PATCH_pn-e2fsprogs+mkdir = "to be pushed upstream; no comment; MKINSTALLDIRS is not supported in new version autotool"
RECIPE_PATCH_pn-e2fsprogs+acinclude = "to be pushed upstream;"
RECIPE_INTEL_SECTION_pn-e2fsprogs = "base utils"
RECIPE_TIME_BETWEEN_LAST_TWO_RELEASES_pn-e2fsprogs = "2 months"
RECIPE_LATEST_RELEASE_DATE_pn-e2fsprogs = "05/2010"
RECIPE_COMMENTS_pn-e2fsprogs = ""
RECIPE_MAINTAINER_pn-e2fsprogs = "Kevin Tian <kevin.tian@intel.com>"

RECIPE_STATUS_pn-initramfs-boot = "green"
DEPENDENCY_CHECK_pn-initramfs-boot = "not done"
RECIPE_LATEST_VERSION_pn-initramfs-boot = "1.0"
RECIPE_PATCH_pn-initramfs-boot+init-boot = "local"
RECIPE_INTEL_SECTION_pn-initramfs-boot = "base utils"
RECIPE_TIME_BETWEEN_LAST_TWO_RELEASES_pn-initramfs-boot = "n/a"
RECIPE_LATEST_RELEASE_DATE_pn-initramfs-boot = "n/a"
RECIPE_COMMENTS_pn-initramfs-boot = "local scripts follow Poky's MIT license"
RECIPE_MAINTAINER_pn-initramfs-boot = "Kevin Tian <kevin.tian@intel.com>"

RECIPE_STATUS_pn-initramfs-live-boot = "green"
DEPENDENCY_CHECK_pn-initramfs-live-boot = "not done"
RECIPE_LATEST_VERSION_pn-initramfs-live-boot = "1.0"
RECIPE_PATCH_pn-initramfs-live-boot+init-live = "local"
RECIPE_INTEL_SECTION_pn-initramfs-live-boot = "base utils"
RECIPE_TIME_BETWEEN_LAST_TWO_RELEASES_pn-initramfs-live-boot = "n/a"
RECIPE_LATEST_RELEASE_DATE_pn-initramfs-live-boot = "n/a"
RECIPE_COMMENTS_pn-initramfs-live-boot = "local scripts follow Poky's MIT license"
RECIPE_MAINTAINER_pn-initramfs-live-boot = "Kevin Tian <kevin.tian@intel.com>"

RECIPE_STATUS_pn-initramfs-live-install = "green"
DEPENDENCY_CHECK_pn-initramfs-live-install = "not done"
RECIPE_LATEST_VERSION_pn-initramfs-live-install = "1.0"
RECIPE_PATCH_pn-initramfs-live-install+init-install = "local"
RECIPE_INTEL_SECTION_pn-initramfs-live-install = "base utils"
RECIPE_TIME_BETWEEN_LAST_TWO_RELEASES_pn-initramfs-live-install = "n/a"
RECIPE_LATEST_RELEASE_DATE_pn-initramfs-live-install = "n/a"
RECIPE_COMMENTS_pn-initramfs-live-install = "local scripts follow Poky's MIT license"
RECIPE_MAINTAINER_pn-initramfs-live-install = "Kevin Tian <kevin.tian@intel.com>"

RECIPE_STATUS_pn-initscripts = "green"
DEPENDENCY_CHECK_pn-initscripts = "not done"
RECIPE_LATEST_VERSION_pn-initscripts = "1.0"
RECIPE_PATCH_pn-initscripts = "many local scripts"
RECIPE_INTEL_SECTION_pn-initscripts = "base utils"
RECIPE_TIME_BETWEEN_LAST_TWO_RELEASES_pn-initscripts = "n/a"
RECIPE_LATEST_RELEASE_DATE_pn-initscripts = "n/a"
RECIPE_COMMENTS_pn-initscripts = "local scripts follow Poky's MIT license"
RECIPE_MAINTAINER_pn-initscripts = "Kevin Tian <kevin.tian@intel.com>"

RECIPE_STATUS_pn-keymaps = "green" 
DEPENDENCY_CHECK_pn-keymaps = "not done"
RECIPE_LATEST_VERSION_pn-keymaps = "1.0"
RECIPE_PATCH_pn-keymaps = "many local keymap files"
RECIPE_INTEL_SECTION_pn-keymaps = "base utils"
RECIPE_TIME_BETWEEN_LAST_TWO_RELEASES_pn-keymaps = "n/a"
RECIPE_LATEST_RELEASE_DATE_pn-keymaps = "n/a"
RECIPE_COMMENTS_pn-keymaps = "local scripts follow Poky's MIT license, however it contains a GPL notation"
RECIPE_MAINTAINER_pn-keymaps = "Kevin Tian <kevin.tian@intel.com>"

RECIPE_STATUS_pn-modutils-initscripts = "green"
DEPENDENCY_CHECK_pn-modutils-initscripts = "not done"
RECIPE_LATEST_VERSION_pn-modutils-initscripts = "1.0"
RECIPE_PATCH_pn-modutils-initscripts+modutils = "local"
RECIPE_INTEL_SECTION_pn-modutils-initscripts = "base utils"
RECIPE_TIME_BETWEEN_LAST_TWO_RELEASES_pn-modutils-initscripts = "n/a"
RECIPE_LATEST_RELEASE_DATE_pn-modutils-initscripts = "n/a"
RECIPE_COMMENTS_pn-modutils-initscripts = "local scripts follow Poky's MIT license"
RECIPE_MAINTAINER_pn-modutils-initscripts = "Kevin Tian <kevin.tian@intel.com>"

RECIPE_STATUS_pn-network-suspend-scripts = "yellow" # no PV
DEPENDENCY_CHECK_pn-network-suspend-scripts = "not done"
RECIPE_LATEST_VERSION_pn-network-suspend-scripts = "1.0"
RECIPE_PATCH_pn-network-suspend-scripts = "local scripts"
RECIPE_INTEL_SECTION_pn-network-suspend-scripts = "base utils"
RECIPE_TIME_BETWEEN_LAST_TWO_RELEASES_pn-network-suspend-scripts = "n/a"
RECIPE_LATEST_RELEASE_DATE_pn-network-suspend-scripts = "n/a"
RECIPE_COMMENTS_pn-network-suspend-scripts = "local scripts follow Poky's MIT license"
RECIPE_MAINTAINER_pn-network-suspend-scripts = "Kevin Tian <kevin.tian@intel.com>"

RECIPE_STATUS_pn-opkg-collateral = "green" 
DEPENDENCY_CHECK_pn-opkg-collateral = "not done"
RECIPE_LATEST_VERSION_pn-opkg-collateral = "1.0"
RECIPE_PATCH_pn-opkg-collateral = "local"
RECIPE_INTEL_SECTION_pn-opkg-collateral = "base utils"
RECIPE_TIME_BETWEEN_LAST_TWO_RELEASES_pn-opkg-collateral = "n/a"
RECIPE_LATEST_RELEASE_DATE_pn-opkg-collateral = "n/a"
RECIPE_COMMENTS_pn-opkg-collateral = "local scripts follow Poky's MIT license, no need to have its own"
RECIPE_MAINTAINER_pn-opkg-collateral = "Kevin Tian <kevin.tian@intel.com>"

RECIPE_STATUS_pn-opkg-config-base = "green"
DEPENDENCY_CHECK_pn-opkg-config-base = "not done"
RECIPE_LATEST_VERSION_pn-opkg-config-base = "1.0"
RECIPE_INTEL_SECTION_pn-opkg-config-base = "base utils"
RECIPE_TIME_BETWEEN_LAST_TWO_RELEASES_pn-opkg-config-base = "n/a"
RECIPE_LATEST_RELEASE_DATE_pn-opkg-config-base = "n/a"
RECIPE_COMMENTS_pn-opkg-config-base = "local scripts follow Poky's MIT license"
RECIPE_MAINTAINER_pn-opkg-config-base = "Kevin Tian <kevin.tian@intel.com>"

RECIPE_STATUS_pn-poky-feed-config-opkg = "green"
DEPENDENCY_CHECK_pn-poky-feed-config-opkg = "not done"
RECIPE_LATEST_VERSION_pn-poky-feed-config-opkg = "1.0"
RECIPE_INTEL_SECTION_pn-poky-feed-config-opkg = "base utils"
RECIPE_TIME_BETWEEN_LAST_TWO_RELEASES_pn-poky-feed-config-opkg = "n/a"
RECIPE_LATEST_RELEASE_DATE_pn-poky-feed-config-opkg = "n/a"
RECIPE_COMMENTS_pn-poky-feed-config-opkg = "local scripts follow Poky's MIT license"
RECIPE_MAINTAINER_pn-poky-feed-config-opkg = "Kevin Tian <kevin.tian@intel.com>"

RECIPE_STATUS_pn-opkg = "green"
DEPENDENCY_CHECK_pn-opkg = "not done"
RECIPE_LATEST_VERSION_pn-opkg = "0.1.8"
RECIPE_INTEL_SECTION_pn-opkg = "base utils"
RECIPE_TIME_BETWEEN_LAST_TWO_RELEASES_pn-opkg = "2 months"
RECIPE_LATEST_RELEASE_DATE_pn-opkg = "02/2010"
RECIPE_COMMENTS_pn-opkg = ""
RECIPE_MAINTAINER_pn-opkg = "Dongxiao Xu <dongxiao.xu@intel.com"

RECIPE_STATUS_pn-opkg-utils = "green"
DEPENDENCY_CHECK_pn-opkg-utils = "not done"
RECIPE_LATEST_VERSION_pn-opkg-utils = "4747"
RECIPE_INTEL_SECTION_pn-opkg-utils = "base utils"
RECIPE_TIME_BETWEEN_LAST_TWO_RELEASES_pn-opkg-utils = "3 months"
RECIPE_LATEST_RELEASE_DATE_pn-opkg-utils = "11/2008"
RECIPE_COMMENTS_pn-opkg-utils = ""
RECIPE_MAINTAINER_pn-opkg-utils = "Dongxiao Xu <dongxiao.xu@intel.com"

RECIPE_STATUS_pn-polkit = "green"
DEPENDENCY_CHECK_pn-polkit = "not done"
RECIPE_LATEST_VERSION_pn-polkit = "0.96"
RECIPE_INTEL_SECTION_pn-polkit = "base utils"
RECIPE_TIME_BETWEEN_LAST_TWO_RELEASES_pn-polkit = "2 months"
RECIPE_LATEST_RELEASE_DATE_pn-polkit = "01/2010"
RECIPE_COMMENTS_pn-polkit = ""
RECIPE_MAINTAINER_pn-polkit = "Kevin Tian <kevin.tian@intel.com>"

RECIPE_STATUS_pn-psplash = "not done"
DEPENDENCY_CHECK_pn-psplash = "not done"
RECIPE_LATEST_VERSION_pn-psplash = "0.0+svnr424"
RECIPE_PATCH_pn-psplash+psplash-init = "local scripts"
RECIPE_INTEL_SECTION_pn-psplash = "base utils"
RECIPE_TIME_BETWEEN_LAST_TWO_RELEASES_pn-psplash = "6 months"
RECIPE_LATEST_RELEASE_DATE_pn-psplash = "05/2009"
RECIPE_COMMENTS_pn-psplash = ""
RECIPE_MAINTAINER_pn-psplash = "Kevin Tian <kevin.tian@intel.com>"

RECIPE_STATUS_pn-pax-utils = "green"
DEPENDENCY_CHECK_pn-pax-utils = "not done"
RECIPE_LATEST_VERSION_pn-pax-utils = "0.2.1"
RECIPE_INTEL_SECTION_pn-pax-utils = "base utils"
RECIPE_TIME_BETWEEN_LAST_TWO_RELEASES_pn-pax-utils = "15 months"
RECIPE_LATEST_RELEASE_DATE_pn-pax-utils = "02/2010"
RECIPE_COMMENTS_pn-pax-utils = ""
RECIPE_MAINTAINER_pn-pax-utils = "Kevin Tian <kevin.tian@intel.com>"

RECIPE_STATUS_pn-sudo = "green"
DEPENDENCY_CHECK_pn-sudo = "not done"
RECIPE_LATEST_VERSION_pn-sudo = "1.7.2p7"
RECIPE_PATCH_pn-sudo+autofoo = "to be pushed upstream"
RECIPE_PATCH_pn-sudo+noexec-link = "to be pushed upstream"
RECIPE_INTEL_SECTION_pn-sudo = "base utils"
RECIPE_TIME_BETWEEN_LAST_TWO_RELEASES_pn-sudo = "1 months"
RECIPE_LATEST_RELEASE_DATE_pn-sudo = "06/2010"
RECIPE_COMMENTS_pn-sudo = ""
RECIPE_MAINTAINER_pn-sudo = "Kevin Tian <kevin.tian@intel.com>"

RECIPE_STATUS_pn-blktool = "green"
DEPENDENCY_CHECK_pn-blktool = "not done"
RECIPE_LATEST_VERSION_pn-blktool = "4-6"
RECIPE_INTEL_SECTION_pn-blktool = "base utils"
RECIPE_TIME_BETWEEN_LAST_TWO_RELEASES_pn-blktool = "3 years"
RECIPE_LATEST_RELEASE_DATE_pn-blktool = "02/2010"
RECIPE_COMMENTS_pn-blktool = ""
RECIPE_MAINTAINER_pn-blktool = "Kevin Tian <kevin.tian@intel.com>"

RECIPE_STATUS_pn-iproute2 = "green"
DEPENDENCY_CHECK_pn-iproute2 = "not done"
RECIPE_LATEST_VERSION_pn-iproute2 = "2.6.34"
RECIPE_PATCH_pn-iproute2+configure-cross = "to be pushed upstream"
RECIPE_INTEL_SECTION_pn-iproute2 = "base utils"
RECIPE_TIME_BETWEEN_LAST_TWO_RELEASES_pn-iproute2 = "3 months"
RECIPE_LATEST_RELEASE_DATE_pn-iproute2 = "05/2010"
RECIPE_COMMENTS_pn-iproute2 = ""
RECIPE_MAINTAINER_pn-iproute2 = "Kevin Tian <kevin.tian@intel.com>"

RECIPE_STATUS_pn-netbase = "green"
DEPENDENCY_CHECK_pn-netbase = "not done"
RECIPE_LATEST_VERSION_pn-netbase = "4.41"
RECIPE_PATCH_pn-netbase+busybox = "marked as REMOVAL"
RECIPE_PATCH_pn-many = "local scripts"
RECIPE_INTEL_SECTION_pn-netbase = "base utils"
RECIPE_TIME_BETWEEN_LAST_TWO_RELEASES_pn-netbase = "2 years"
RECIPE_LATEST_RELEASE_DATE_pn-netbase = "04/2010"
RECIPE_COMMENTS_pn-netbase = ""
RECIPE_MAINTAINER_pn-netbase = "Kevin Tian <kevin.tian@intel.com>"

RECIPE_STATUS_pn-busybox = "green"
DEPENDENCY_CHECK_pn-busybox = "not done"
RECIPE_LATEST_VERSION_pn-busybox = "1.16.2"
RECIPE_PATCH_pn-busybox+udhcpscript = "added in 1.00-rc3; c9bb6478;2004;fix the deleting routers error message in case of no existing default routes;"
RECIPE_PATCH_pn-busybox+udhcpc-fix-nfsroot = "added in 1.13.2; ec4da6df;2009;fix nfsroot issues with resetting IP and deleting routes;to be pushed upstream"
RECIPE_PATCH_pn-busybox+B921600 = "added in 1.11.3; 5b1ed09b; 2008; added support for 921600 baudrate of serail line; to be pushed upstream"
RECIPE_PATCH_pn-busybox+get_header_tar = "added in 1.13.2; 5a0e1d47; 2009; fix tar problem with filenames that are exactly 100 bytes; to be pushed upstream"
RECIPE_PATCH_pn-busybox+busybox-appletlib-dependency = "added in 1.13.2; 58c556d9; 2009; solve parallel build issue; to be pushed upstream"
RECIPE_PATCH_pn-busybox+run-parts.in.usr-bin = "aded in 1.15.3; f1b326c8; 2010; change install dir for run-parts to avoid impacting debianutils install. perhaps a local patch"
RECIPE_INTEL_SECTION_pn-busybox = "base utils"
RECIPE_TIME_BETWEEN_LAST_TWO_RELEASES_pn-busybox = "3 months"
RECIPE_LATEST_RELEASE_DATE_pn-busybox = "0i6/2010"
RECIPE_COMMENTS_pn-busybox = "some special overrides/unsets for CFLAGS, etc. need to understand the tricks behind"
RECIPE_MAINTAINER_pn-busybox = "Kevin Tian <kevin.tian@intel.com>"

RECIPE_STATUS_pn-module-init-tools = "green"
DEPENDENCY_CHECK_pn-module-init-tools = "not done"
RECIPE_LATEST_VERSION_pn-module-init-tools = "3.12"
RECIPE_PATCH_pn-module-init-tools+ignore_arch_directory = "added as 1st set of patches from bk to git in 2005; no exact commit; aim to ignore all files in /etc/modprobe.d/arch; not sure why"
RECIPE_PATCH_pn-module-init-tools+modutils_extension = "added as 1st set of patches from bk to git in 2005; no exact commit; aim to handle renaming of modutils; local patch"
RECIPE_PATCH_pn-module-init-tools+no_man_rebuild = "added as 1st set of patches from bk to git in 2005; no exact commit; disable manual rebuild; local patch"
RECIPE_PATCH_pn-module-init-tools+manpagesopt = "added as 1st set of patches from bk to git in 2005; no exact commit; add option to allow disabling manual build; local patch"
RECIPE_PATCH_pn-module-init-tools+module-init-tools-remove-index = "added as 1st set of patches from bk to git in 2005; no exact commit; from uclibc; to use strchr instead of index; to be pushed upstream?"
RECIPE_PATCH_pn-module-init-tools+no-static-binaries = "by jdike in 2010; disable native statically-linked insmod as there's no static libc. since it's not required, simply disable it; local patch"
RECIPE_INTEL_SECTION_pn-module-init-tools = "base utils"
RECIPE_TIME_BETWEEN_LAST_TWO_RELEASES_pn-module-init-tools = "3 months"
RECIPE_LATEST_RELEASE_DATE_pn-module-init-tools = "10/2009"
RECIPE_COMMENTS_pn-module-init-tools = "most tweaks about alternative handle and rename"
RECIPE_MAINTAINER_pn-module-init-tools = "Kevin Tian <kevin.tian@intel.com>"

RECIPE_STATUS_pn-fakeroot = "green"
DEPENDENCY_CHECK_pn-fakeroot = "not done"
RECIPE_LATEST_VERSION_pn-fakeroot = "1.14.4"
RECIPE_PATCH_pn-fakeroot+configure-libtool = "mark for REMOVAL"
RECIPE_PATCH_pn-fakeroot+absolutepaths = "added by RP in 2010; to avoid build system python linking to staging library; to be pushed upstream"
RECIPE_INTEL_SECTION_pn-fakeroot = "base utils"
RECIPE_TIME_BETWEEN_LAST_TWO_RELEASES_pn-fakeroot = "6 months"
RECIPE_LATEST_RELEASE_DATE_pn-fakeroot = "11/2009"
RECIPE_COMMENTS_pn-fakeroot = ""
RECIPE_MAINTAINER_pn-fakeroot = "Kevin Tian <kevin.tian@intel.com>"

RECIPE_STATUS_pn-prism-firmware = "green"
DEPENDENCY_CHECK_pn-prism-firmware = "not done"
RECIPE_LATEST_VERSION_pn-prism-firmware = "1.8.4"
RECIPE_NO_UPDATE_REASON_pn-prism-firmware = "1.7.4 and 1.8.4 are both released at same time, while 1.8.4 is known with connection issue"
RECIPE_INTEL_SECTION_pn-prism-firmware = "base utils"
RECIPE_TIME_BETWEEN_LAST_TWO_RELEASES_pn-prism-firmware = "same time"
RECIPE_LATEST_RELEASE_DATE_pn-prism-firmware = "07/2005"
RECIPE_COMMENTS_pn-prism-firmware = "1.7.4 and 1.8.4 are both released at same time. perhaps then we don't need upgrade this one?"
RECIPE_MAINTAINER_pn-prism-firmware = "Kevin Tian <kevin.tian@intel.com>"

RECIPE_STATUS_pn-base-files = "green"
DEPENDENCY_CHECK_pn-base-files = "not done"
RECIPE_LATEST_VERSION_pn-base-files = "3.0.14"
RECIPE_INTEL_SECTION_pn-base-files = "base utils"
RECIPE_TIME_BETWEEN_LAST_TWO_RELEASES_pn-base-files = "n/a"
RECIPE_LATEST_RELEASE_DATE_pn-base-files = "n/a"
RECIPE_COMMENTS_pn-base-files = "licenses are pacakges here; all local files. RP said that the version 3.0.14 may come from debian. no need to upgrade it now"
RECIPE_MAINTAINER_pn-pn-base-files = "Kevin Tian <kevin.tian@intel.com>"

RECIPE_STATUS_pn-base-passwd = "green"
DEPENDENCY_CHECK_pn-base-passwd = "not done"
RECIPE_LATEST_VERSION_pn-base-passwd = "3.5.22"
RECIPE_PATCH_pn-base-passwd+nobash = "change /bin/bash to /bin/sh in passwd.master; another specific poky tweak"
RECIPE_PATCH_pn-base-passwd+root-home = "change home for root user in passwd.master; perhaps a poky specific tweak; oe even has other root-home patch for different configurations"
RECIPE_INTEL_SECTION_pn-base-passwd = "base utils"
RECIPE_TIME_BETWEEN_LAST_TWO_RELEASES_pn-base-passwd = "1 year"
RECIPE_LATEST_RELEASE_DATE_pn-base-passwd = "09/2009"
RECIPE_COMMENTS_pn-base-passwd = ""
RECIPE_MAINTAINER_pn-base-passwd = "Kevin Tian <kevin.tian@intel.com>"

RECIPE_STATUS_pn-apmd = "green" 
DEPENDENCY_CHECK_pn-apmd = "not done"
RECIPE_LATEST_VERSION_pn-apmd = "3.2.2-14"
RECIPE_PATCH_pn-apmd+debian = "in upstream"
RECIPE_PATCH_pn-apmd+workaround = "unclear"
RECIPE_PATCH_pn-apmd+unlinux = "added in 3.2.2; 9456cdc1; 2007; to prevent build from interfering with host kernel headers. curious whether it's still required or any better way?"
RECIPE_PATCH_pn-apmd+libtool = "added in 3.2.2; 35de05e6; 2008; by RP; to solve compability with libtool 2.2.4. perhaps for upstream"
RECIPE_INTEL_SECTION_pn-apmd = "base utils"
RECIPE_TIME_BETWEEN_LAST_TWO_RELEASES_pn-apmd = "1 year"
RECIPE_LATEST_RELEASE_DATE_pn-apmd = "07/2009"
RECIPE_COMMENTS_pn-apmd = ""
RECIPE_MAINTAINER_pn-apmd = "Kevin Tian <kevin.tian@intel.com>"

RECIPE_STATUS_pn-gperf = "green"
DEPENDENCY_CHECK_pn-gperf = "not done"
RECIPE_LATEST_VERSION_pn-gperf = "3.0.4"
RECIPE_PATCH_pn-gperf+autoreconf = "added in 2007; e02b1a6c; perhaps it's required if only purpose is to downgraded AC_PREREQ from 2.60 to 2.59; acinclude.m4 perhaps could be generated automatically"
RECIPE_INTEL_SECTION_pn-gperf = "base utils"
RECIPE_TIME_BETWEEN_LAST_TWO_RELEASES_pn-gperf = "2 years"
RECIPE_LATEST_RELEASE_DATE_pn-gperf = "02/2009"
RECIPE_COMMENTS_pn-gperf = "3.0.4 is GPLv3, however we only require native version so far"
RECIPE_MAINTAINER_pn-gperf = "Kevin Tian <kevin.tian@intel.com>"

RECIPE_STATUS_pn-valgrind = "green"
DEPENDENCY_CHECK_pn-valgrind = "not done"
RECIPE_LATEST_VERSION_pn-valgrind = "3.5.0"
RECIPE_INTEL_SECTION_pn-valgrind = "base utils"
RECIPE_TIME_BETWEEN_LAST_TWO_RELEASES_pn-valgrind = "6 months"
RECIPE_LATEST_RELEASE_DATE_pn-valgrind = "08/2009"
RECIPE_COMMENTS_pn-valgrind = ""
RECIPE_MAINTAINER_pn-valgrind = "Dongxiao Xu <dongxiao.xu@intel.com>"

RECIPE_STATUS_pn-formfactor = "green"
DEPENDENCY_CHECK_pn-formfactor = "not done"
RECIPE_LATEST_VERSION_pn-formfactor = "0.0"
RECIPE_INTEL_SECTION_pn-formfactor = "base utils"
RECIPE_TIME_BETWEEN_LAST_TWO_RELEASES_pn-formfactor = "n/a"
RECIPE_LATEST_RELEASE_DATE_pn-formfactor = "n/a"
RECIPE_COMMENTS_pn-formfactor = ""
RECIPE_MAINTAINER_pn-formfactor = "Dongxiao Xu <dongxiao.xu@intel.com>"

RECIPE_STATUS_pn-makedevs = "green"
DEPENDENCY_CHECK_pn-makedevs = "not done"
RECIPE_LATEST_VERSION_pn-makedevs = "1.0.0"
RECIPE_INTEL_SECTION_pn-makedevs = "base utils"
RECIPE_TIME_BETWEEN_LAST_TWO_RELEASES_pn-makedevs = "n/a"
RECIPE_LATEST_RELEASE_DATE_pn-makedevs = "n/a"
RECIPE_COMMENTS_pn-makedevs = ""
RECIPE_MAINTAINER_pn-makedevs = "Dongxiao Xu <dongxiao.xu@intel.com>"

RECIPE_STATUS_pn-cwautomacros = "green"
DEPENDENCY_CHECK_pn-cwautomacros = "not done"
RECIPE_LATEST_VERSION_pn-cwautomacros = "20090610"
RECIPE_INTEL_SECTION_pn-cwautomacros = "base utils"
RECIPE_TIME_BETWEEN_LAST_TWO_RELEASES_pn-cwautomacros = "6 months"
RECIPE_LATEST_RELEASE_DATE_pn-cwautomacros = "06/2009"
RECIPE_COMMENTS_pn-cwautomacros = ""
RECIPE_MAINTAINER_pn-cwautomacros = "Dongxiao Xu <dongxiao.xu@intel.com>"

RECIPE_STATUS_pn-which = "green"
DEPENDENCY_CHECK_pn-which = "not done"
RECIPE_LATEST_VERSION_pn-which = "2.20"
RECIPE_INTEL_SECTION_pn-which = "base utils"
RECIPE_TIME_BETWEEN_LAST_TWO_RELEASES_pn-which = "7 months"
RECIPE_LATEST_RELEASE_DATE_pn-which = "08/2008"
RECIPE_COMMENTS_pn-which = ""
RECIPE_MAINTAINER_pn-which = "Dongxiao Xu <dongxiao.xu@intel.com>"

RECIPE_STATUS_pn-quota = "green"
DEPENDENCY_CHECK_pn-quota = "not done"
RECIPE_LATEST_VERSION_pn-quota = "3.17"
RECIPE_INTEL_SECTION_pn-quota = "base utils"
RECIPE_TIME_BETWEEN_LAST_TWO_RELEASES_pn-quota = "10 months"
RECIPE_LATEST_RELEASE_DATE_pn-quota = "01/2009"
RECIPE_COMMENTS_pn-quota = ""
RECIPE_MAINTAINER_pn-quota = "Dongxiao Xu <dongxiao.xu@intel.com>"

RECIPE_STATUS_pn-gzip = "green"
RECIPE_MAINTAINER_pn-gzip = "Kevin Tian <kevin.tian@intel.com>"
RECIPE_LATEST_VERSION_pn-gzip = "1.4"

RECIPE_STATUS_pn-iptables = "green"
RECIPE_MAINTAINER_pn-iptables = "Kevin Tian <kevin.tian@intel.com>"
RECIPE_LATEST_VERSION_pn-iptables = "1.4.8"

RECIPE_STATUS_pn-ethtool = "red"
RECIPE_MAINTAINER_pn-ethtool = "Kevin Tian <kevin.tian@intel.com>"
RECIPE_LATEST_VERSION_pn-ethtool = "2.6.34"

RECIPE_STATUS_pn-net-tools = "red"
RECIPE_MAINTAINER_pn-net-tools = "Kevin Tian <kevin.tian@intel.com>"
RECIPE_LATEST_VERSION_pn-net-tools = "1.60-23"

RECIPE_STATUS_pn-shadow = "green"
DEPENDENCY_CHECK_pn-shadow = "not done"
RECIPE_MAINTAINER_pn-shadow = "Kevin Tian <kevin.tian@intel.com>"
RECIPE_LATEST_VERSION_pn-shadow = "4.1.4.2-1"
RECIPE_INTEL_SECTION_pn-shadow = "base utils"
RECIPE_TIME_BETWEEN_LAST_TWO_RELEASES_pn-shadow = "2 months"
RECIPE_LATEST_RELEASE_DATE_pn-shadow = "07/2009"
RECIPE_COMMENTS_pn-formfactor = ""

RECIPE_STATUS_pn-coreutils = "red"
RECIPE_MAINTAINER_pn-coreutils = "Kevin Tian <kevin.tian@intel.com>"
RECIPE_LATEST_VERSION_pn-coreutils = "8.5"




RECIPE_STATUS_pn-libuser = "red"
RECIPE_MAINTAINER_pn-libuser = "Edwin Zhai <edwin.zhai@intel.com>"
RECIPE_LATEST_VERSION_pn-libuser = "0.56.16"

RECIPE_STATUS_pn-bc = "green"
RECIPE_MAINTAINER_pn-bc = "Edwin Zhai <edwin.zhai@intel.com>"
DEPENDENCY_CHECK_pn-bc = "not done"
RECIPE_LATEST_VERSION_pn-bc = "1.06"
RECIPE_NO_OF_PATCHES_pn-bc = "0"
RECIPE_INTEL_SECTION_pn-bc = "base utils"
RECIPE_TIME_BETWEEN_LAST_TWO_RELEASES_pn-bc = "29 months"
RECIPE_LATEST_RELEASE_DATE_pn-bc = "11/2000"
RECIPE_COMMENTS_pn-bc = ""

RECIPE_STATUS_pn-ed = "green"
RECIPE_MAINTAINER_pn-ed = "Edwin Zhai <edwin.zhai@intel.com>"
DEPENDENCY_CHECK_pn-ed = "not done"
RECIPE_LATEST_VERSION_pn-ed = "1.4"
RECIPE_NO_OF_PATCHES_pn-ed = "1"
RECIPE_INTEL_SECTION_pn-ed = "base utils"
RECIPE_TIME_BETWEEN_LAST_TWO_RELEASES_pn-ed = "2 months"
RECIPE_LATEST_RELEASE_DATE_pn-ed = "07/2009"
RECIPE_COMMENTS_pn-ed = "GPLv3 was used since ed 0.6"

RECIPE_STATUS_pn-pax = "green"
RECIPE_MAINTAINER_pn-pax = "Edwin Zhai <edwin.zhai@intel.com>"
DEPENDENCY_CHECK_pn-pax = "not done"
RECIPE_LATEST_VERSION_pn-pax = "3.4"
RECIPE_NO_OF_PATCHES_pn-pax = "0"
RECIPE_INTEL_SECTION_pn-pax = "base utils"
RECIPE_TIME_BETWEEN_LAST_TWO_RELEASES_pn-pax = "n/a"
RECIPE_LATEST_RELEASE_DATE_pn-pax = "08/2005"
RECIPE_COMMENTS_pn-pax = ""


RECIPE_STATUS_pn-watchdog = "red"
RECIPE_MAINTAINER_pn-watchdog = "Dexuan Cui <dexuan.cui@intel.com>"
RECIPE_LATEST_VERSION_pn-watchdog = "5.9"

RECIPE_STATUS_pn-json-glib  = "red"
RECIPE_LATEST_VERSION_pn-json-glib  = "0.7.6+d5922b42604c09ba7ebcb0adc1566d0a33a99808"
RECIPE_MAINTAINER_pn-json-glib  = "Kevin Tian <kevin.tian@intel.com>"

RECIPE_STATUS_pn-libatomics-ops = "red"
RECIPE_LATEST_VERSION_pn-libatomics-ops = "7.2alpha4"
RECIPE_MAINTAINER_pn-libatomics-ops = "Kevin Tian <kevin.tian@intel.com>"

RECIPE_STATUS_pn-libffi  = "red"
RECIPE_LATEST_VERSION_pn-libffi  = "3.0.9"
RECIPE_MAINTAINER_pn-libffi  = "Kevin Tian <kevin.tian@intel.com>"

RECIPE_STATUS_pn-libgdbus  = "red"
RECIPE_LATEST_VERSION_pn-libgdbus  = "Release-0.2"
RECIPE_MAINTAINER_pn-libgdbus  = "Kevin Tian <kevin.tian@intel.com>"

RECIPE_STATUS_pn-libjana = "red"
RECIPE_LATEST_VERSION_pn-libjana = "acd72f232c72f8692dcacdd885eea756778042c2"
RECIPE_MAINTAINER_pn-libjana = "Kevin Tian <kevin.tian@intel.com>"

RECIPE_STATUS_pn-apr = "red"
RECIPE_LATEST_VERSION_pn-apr = "1.4.2"
RECIPE_MAINTAINER_pn-apr = "Kevin Tian <kevin.tian@intel.com>"

RECIPE_STATUS_pn-apr-util = "red"
RECIPE_LATEST_VERSION_pn-apr-util = "1.3.9"
RECIPE_MAINTAINER_pn-apr-util = "Kevin Tian <kevin.tian@intel.com>"

RECIPE_STATUS_pn-apt = "red"
RECIPE_LATEST_VERSION_pn-apt = "0.7.25.3"
RECIPE_MAINTAINER_pn-apt = "Kevin Tian <kevin.tian@intel.com>"

RECIPE_STATUS_pn-chrpath = "red"
RECIPE_LATEST_VERSION_pn-chrpath = "0.13-2"
RECIPE_MAINTAINER_pn-chrpath = "Kevin Tian <kevin.tian@intel.com>"

RECIPE_STATUS_pn-dosfstools = "red"
RECIPE_LATEST_VERSION_pn-dosfstools = "2.11"
RECIPE_MAINTAINER_pn-dosfstools = "Kevin Tian <kevin.tian@intel.com>"

RECIPE_STATUS_pn-eee-acpi-scripts = "red"
RECIPE_LATEST_VERSION_pn-eee-acpi-scripts = "1.1.10+eaaa266e8c3b91b19d8ac861334b41ce7530e8c5"
RECIPE_MAINTAINER_pn-eee-acpi-scripts = "Kevin Tian <kevin.tian@intel.com>"

RECIPE_STATUS_pn-gssdp = "red"
RECIPE_LATEST_VERSION_pn-gssdp = "0.7.2"
RECIPE_MAINTAINER_pn-gssdp = "Kevin Tian <kevin.tian@intel.com>"

RECIPE_STATUS_pn-insserv = "red"
RECIPE_LATEST_VERSION_pn-insserv = "1.14.0"
RECIPE_MAINTAINER_pn-insserv = "Kevin Tian <kevin.tian@intel.com>"

RECIPE_STATUS_pn-moblin-app-installer = "red"
RECIPE_LATEST_VERSION_pn-moblin-app-installer = "n/a"
RECIPE_MAINTAINER_pn-moblin-app-installer = "Kevin Tian <kevin.tian@intel.com>"

RECIPE_STATUS_pn-modutils-collateral = "red"
RECIPE_LATEST_VERSION_pn-modutils-collateral = "1"
RECIPE_MAINTAINER_pn-modutils-collateral = "Kevin Tian <kevin.tian@intel.com>"

RECIPE_STATUS_pn-monit = "red"
RECIPE_LATEST_VERSION_pn-monit = "5.1.1"
RECIPE_MAINTAINER_pn-monit = "Kevin Tian <kevin.tian@intel.com>"

RECIPE_STATUS_pn-mozilla-headless-services = "red"
RECIPE_LATEST_VERSION_pn-mozilla-headless-services = "0.1+git0+c679b95dd8c2807b70186d233b3833861a499315"
RECIPE_MAINTAINER_pn-mozilla-headless-services = "Kevin Tian <kevin.tian@intel.com>"

RECIPE_STATUS_pn-mtd-utils = "red"
RECIPE_LATEST_VERSION_pn-mtd-utils = "1.3.1+a67747b7a314e685085b62e8239442ea54959dbc"
RECIPE_MAINTAINER_pn-mtd-utils = "Kevin Tian <kevin.tian@intel.com>"

RECIPE_STATUS_pn-ohm = "red"
RECIPE_LATEST_VERSION_pn-ohm = "3cb3496846508929b9f2d05683ec93523de7947c"
RECIPE_MAINTAINER_pn-ohm = "Kevin Tian <kevin.tian@intel.com>"

RECIPE_STATUS_pn-pam = "red"
RECIPE_LATEST_VERSION_pn-pam = "1.1.1"
RECIPE_MAINTAINER_pn-pam = "Kevin Tian <kevin.tian@intel.com>"

RECIPE_STATUS_pn-procps = "red"
RECIPE_LATEST_VERSION_pn-procps = "3.2.8"
RECIPE_MAINTAINER_pn-procps = "Kevin Tian <kevin.tian@intel.com>"

RECIPE_STATUS_pn-gmime = "red"
RECIPE_LATEST_VERSION_pn-gmime = "2.5.3"
RECIPE_MAINTAINER_pn-gmime = "Kevin Tian <kevin.tian@intel.com>"

RECIPE_STATUS_pn-iso-codes = "red"
RECIPE_LATEST_VERSION_pn-iso-codes = "3.16"
RECIPE_MAINTAINER_pn-iso-codes = "Kevin Tian <kevin.tian@intel.com>"

RECIPE_STATUS_pn-libgsf = "red"
RECIPE_LATEST_VERSION_pn-libgsf = "1.14.18"
RECIPE_MAINTAINER_pn-libgsf = "Kevin Tian <kevin.tian@intel.com>"

RECIPE_STATUS_pn-libnotify = "red"
RECIPE_LATEST_VERSION_pn-libnotify = "0.4.5"
RECIPE_MAINTAINER_pn-libnotify = "Kevin Tian <kevin.tian@intel.com>"

RECIPE_STATUS_pn-beecrypt = "red"
RECIPE_LATEST_VERSION_pn-beecrypt = "4.2.1"
RECIPE_MAINTAINER_pn-beecrypt = "Kevin Tian <kevin.tian@intel.com>"

RECIPE_STATUS_pn-libacpi = "red"
RECIPE_LATEST_VERSION_pn-libacpi = "0.2"
RECIPE_MAINTAINER_pn-libacpi = "Kevin Tian <kevin.tian@intel.com>"

RECIPE_STATUS_pn-acpid = "red"
RECIPE_LATEST_VERSION_pn-acpid = "1.0.10"
RECIPE_MAINTAINER_pn-acpid = "Kevin Tian <kevin.tian@intel.com>"

RECIPE_STATUS_pn-consolekit = "red"
RECIPE_LATEST_VERSION_pn-consolekit = "0.4.1"
RECIPE_MAINTAINER_pn-consolekit = "Kevin Tian <kevin.tian@intel.com>"

RECIPE_STATUS_pn-console-tools = "red"
RECIPE_LATEST_VERSION_pn-console-tools = "0.3.2"
RECIPE_MAINTAINER_pn-console-tools = "Kevin Tian <kevin.tian@intel.com>"

RECIPE_STATUS_pn-dalston = "red"
RECIPE_LATEST_VERSION_pn-dalston = "?"
RECIPE_MAINTAINER_pn-dalston = "Kevin Tian <kevin.tian@intel.com>"

RECIPE_STATUS_pn-devicekit = "red"
RECIPE_LATEST_VERSION_pn-devicekit = "3"
RECIPE_MAINTAINER_pn-devicekit = "Kevin Tian <kevin.tian@intel.com>"

RECIPE_STATUS_pn-devicekit-power = "red"
RECIPE_LATEST_VERSION_pn-devicekit-power = "n/a"
RECIPE_MAINTAINER_pn-devicekit-power = "Kevin Tian <kevin.tian@intel.com>"

RECIPE_STATUS_pn-fuse = "red"
RECIPE_LATEST_VERSION_pn-fuse = "2.8.4"
RECIPE_MAINTAINER_pn-fuse = "Kevin Tian <kevin.tian@intel.com>"

RECIPE_STATUS_pn-msynctool = "red"
RECIPE_LATEST_VERSION_pn-msynctool = "0.38"
RECIPE_MAINTAINER_pn-msynctool = "Kevin Tian <kevin.tian@intel.com>"

RECIPE_STATUS_pn-mtools = "red"
RECIPE_LATEST_VERSION_pn-mtools = "4.0.13"
RECIPE_MAINTAINER_pn-mtools = "Kevin Tian <kevin.tian@intel.com>"

RECIPE_STATUS_pn-pm-utils = "red"
RECIPE_LATEST_VERSION_pn-pm-utils = "1.3.0"
RECIPE_MAINTAINER_pn-pm-utils = "Kevin Tian <kevin.tian@intel.com>"

RECIPE_STATUS_pn-psmisc = "red"
RECIPE_LATEST_VERSION_pn-psmisc = "22.11"
RECIPE_MAINTAINER_pn-psmisc = "Kevin Tian <kevin.tian@intel.com>"

RECIPE_STATUS_pn-boost = "red"
RECIPE_LATEST_VERSION_pn-boost = "1.43.0"
RECIPE_MAINTAINER_pn-boost = "Kevin Tian <kevin.tian@intel.com>"

RECIPE_STATUS_pn-libfribidi = "red"
RECIPE_LATEST_VERSION_pn-libfribidi = "0.19.2"
RECIPE_MAINTAINER_pn-libfribidi = "Kevin Tian <kevin.tian@intel.com>"
```

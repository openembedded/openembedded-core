## meta/conf/machine/eee901.conf
```bitbake
#@TYPE: Machine
#@NAME: Asus EEE 901 PC

#@DESCRIPTION: Machine configuration for the Asus EEE 901 PC

TARGET_ARCH = "i586"
PACKAGE_EXTRA_ARCHS = "x86"

include conf/machine/include/tune-atom.inc

MACHINE_FEATURES = "kernel26 screen keyboard pci usbhost ext2 ext3 x86 wifi \
                    acpi"

KERNEL_IMAGETYPE = "bzImage"

PREFERRED_PROVIDER_virtual/kernel = "linux-moblin"
PREFERRED_PROVIDER_virtual/libx11 = "libx11-trim"
PREFERRED_PROVIDER_virtual/libgl  = "mesa-dri"
PREFERRED_PROVIDER_virtual/xserver = "xserver-xf86-dri-lite"
XSERVER ?= "xserver-xf86-dri-lite \
           xf86-input-mouse \
           xf86-input-keyboard \
           xf86-input-synaptics \
           xf86-video-intel"
MACHINE_DRI_MODULES = "i915"

MACHINE_EXTRA_RDEPENDS = "rt2860"

MACHINE_EXTRA_RRECOMMENDS = "kernel-modules eee-acpi-scripts"

GUI_MACHINE_CLASS = "bigscreen"

IMAGE_ROOTFS_SIZE_ext3 = "250000"

IMAGE_FSTYPES += "ext3 jffs2 cpio.gz"

APPEND += "video=intelfb:mode=800x600,accel=0,hwcursor=0 vga=788 usbcore.autosuspend=1"

GLIBC_ADDONS = "nptl"
GLIBC_EXTRA_OECONF = "--with-tls"

EXTRA_OECONF_append_pn-matchbox-panel-2 = " --with-battery=acpi"
```

## meta/conf/machine/em-x270.conf
```bitbake
#@TYPE: Machine
#@NAME: EM-X270
#@DESCRIPTION: Machine configuration for the CompuLab EM-X270 with a pxa27x CPU

#
# Hardware-based properties
#
TARGET_ARCH = "arm"
GUI_MACHINE_CLASS ?= "bigscreen"

PREFERRED_PROVIDER_virtual/kernel = "linux"

require conf/machine/include/tune-xscale.inc

# Uncomment this to use iwmmxt optimizations. Remove the above xscale stuff first
# require conf/machine/include/tune-iwmmxt.inc

IMAGE_DEPENDS_jffs2 += " genext2fs-native "
ROOT_FLASH_SIZE = "128"
IMAGE_CMD_jffs2 = " \
          mkfs.jffs2 --root=${IMAGE_ROOTFS} \
             --output=${DEPLOY_DIR_IMAGE}/${IMAGE_NAME}.rootfs.jffs2 \
             --eraseblock=0x20000 --pad --faketime -n; \
          sumtool -i ${DEPLOY_DIR_IMAGE}/${IMAGE_NAME}.rootfs.jffs2 \
                  -o ${DEPLOY_DIR_IMAGE}/${IMAGE_NAME}.rootfs-summary.jffs2 \
                  -e 0x20000 -p; \
          mkdir -p ${WORKDIR}/img; \
          mkdir -p ${WORKDIR}/kern-img/; \
          install -m 0644 `readlink -f ${DEPLOY_DIR_IMAGE}/uImage-em-x270.bin` ${WORKDIR}/kern-img/uImage; \
          mkfs.jffs2 --root=${WORKDIR}/kern-img/ --eraseblock=0x20000 --pad \
	     --no-cleanmarkers --faketime --output=${WORKDIR}/img/em-x270-kernel.jffs2; \
          cd ${DEPLOY_DIR_IMAGE}; \
          ln -fs ${IMAGE_NAME}.rootfs-summary.jffs2 ${IMAGE_LINK_NAME}.rootfs-summary.jffs2; \
          install -m 0644 ${DEPLOY_DIR_IMAGE}/${IMAGE_LINK_NAME}.rootfs-summary.jffs2 \
                 ${WORKDIR}/img/em-x270-angstrom.jffs2; \
          size=`du -sk ${WORKDIR}/img | cut -f 1` ; ((size *= 120)) ; ((size /= 100)) ; \
          genext2fs -d ${WORKDIR}/img -b $size ${DEPLOY_DIR_IMAGE}/updater-em-x270.ext2 \
"

#VOLATILE_STORAGE_SIZE = "128"
MACHINE_DISPLAY_WIDTH_PIXELS ?= "480"
MACHINE_DISPLAY_HEIGHT_PIXELS ?= "640"
MACHINE_FEATURES = "kernel26 touchscreen apm alsa bluetooth wifi usbhost usbgadget screen phone "

#
# Software/packages selection
#

PREFERRED_PROVIDER_xserver = "xserver-kdrive"

#
# Modules autoload and other boot properties
#
module_autoload_evdev = "evdev"
module_autoload_mmc_block = "mmc_block"
module_autoload_pxa27x_udc = "pxa27x_udc"

#FIXME: this should be controlled by a userspace utility later.
module_autoload_g_ether = "g_ether"

SERIAL_CONSOLE = "115200 ttyS0"

KERNEL_IMAGETYPE = "uImage"
UBOOT_ENTRYPOINT = "a0008000"
```

## meta/conf/machine/fic-gta01.conf
```bitbake
#-----------------------------------------------------------------------------
#@TYPE: Machine
#@NAME: FIC GTA01 (Neo1973)
#@DESCRIPTION: Machine configuration for the FIC Neo1973 GSM phone
#-----------------------------------------------------------------------------

TARGET_ARCH = "arm"
PACKAGE_EXTRA_ARCHS = "armv4t"

PREFERRED_PROVIDER_virtual/kernel = "linux-gta01"

MACHINE_FEATURES = "kernel26 apm alsa bluetooth usbgadget usbhost phone"

# package gta01 specific modules
MACHINE_EXTRA_RRECOMMENDS = "\
  kernel-module-gta01-pm-bt  \
  kernel-module-gta01-pm-gps \
  kernel-module-gta01-pm-gsm \
  kernel-module-gta01kbd \
  kernel-module-s3cmci \
  kernel-module-ext2 "

# used by sysvinit_2
#SERIAL_CONSOLE = "115200 ttySAC0"

# used by some images
ROOT_FLASH_SIZE = "60"

# extra jffs2 tweaks
EXTRA_IMAGECMD_jffs2 = "--eraseblock=0x4000 -n"

# tune for S3C24x0
include conf/machine/include/tune-arm920t.conf
```

## meta/conf/machine/fic-gta02.conf
```bitbake
#-----------------------------------------------------------------------------
#@TYPE: Machine
#@NAME: FIC GTA02 (Neo1973)
#@DESCRIPTION: Machine configuration for the FIC Neo1973/2 GSM phone
#-----------------------------------------------------------------------------

TARGET_ARCH = "arm"
MACHINE_CLASS = "neo1973"
PACKAGE_EXTRA_ARCHS = "armv4t ${MACHINE_CLASS}"

PREFERRED_PROVIDER_virtual/kernel = "linux-openmoko"
UBOOT_ENTRYPOINT = "30008000"

MACHINE_FEATURES = "kernel26 apm alsa bluetooth gps usbgadget usbhost phone wifi vfat ext2"
MACHINE_DISPLAY_WIDTH_PIXELS = "480"
MACHINE_DISPLAY_HEIGHT_PIXELS = "640"
MACHINE_DISPLAY_ORIENTATION = "0"
MACHINE_DISPLAY_PPI = "285"
XSERVER = "xserver-kdrive-glamo xserver-kdrive-fbdev"

# package machine specific modules
MACHINE_EXTRA_RRECOMMENDS = "\
  kernel-module-gta01-pm-bt  \
  kernel-module-gta01-pm-gps \
  kernel-module-gta01-pm-gsm \
  kernel-module-gta01kbd \
  kernel-module-s3cmci \
  kernel-module-snd-soc-neo1973-gta02-wm8753 \
  kernel-module-snd-soc-smdk2440 \
"

SERIAL_CONSOLE = "115200 ttySAC2"

# used by some images
ROOT_FLASH_SIZE = "256"

# extra jffs2 tweaks
EXTRA_IMAGECMD_jffs2 = "--little-endian --eraseblock=0x20000 --pagesize=0x800 \
  --no-cleanmarkers --pad -n ; sumtool --eraseblock=0x20000 --no-cleanmarkers \
  --littleendian --pad \
  -i ${DEPLOY_DIR_IMAGE}/${IMAGE_NAME}.rootfs.jffs2 \
  -o ${DEPLOY_DIR_IMAGE}/${IMAGE_NAME}.rootfs.jffs2.summary"

# build / upload tools
EXTRA_IMAGEDEPENDS += "sjf2410-linux-native dfu-util-native"

# tune for S3C24x0
include conf/machine/include/tune-arm920t.inc

# build YAFFS2
IMAGE_FSTYPES ?= "jffs2 yaffs2"
```

## meta/conf/machine/htcuniversal.conf
```bitbake
#@TYPE: Machine
#@NAME: HTC Universal
#@DESCRIPTION: Machine configuration for the HTC Universal smartphone

#include conf/machine/include/tune-iwmmxt.inc
include conf/machine/include/tune-xscale.inc
PACKAGE_EXTRA_ARCHS += "iwmmxt"

TARGET_ARCH = "arm"

PREFERRED_PROVIDER_virtual/kernel = "linux-rp"

MACHINE_FEATURES = "kernel26 apm alsa bluetooth irda screen touchscreen keyboard usbhost usbgadget wifi phone"

MACHINE_EXTRA_RDEPENDS = "zaurusd"

MACHINE_EXTRA_RRECOMMENDS = " \
	kernel-module-htcuniversal-bt \
	kernel-module-htcuniversal-phone \
	kernel-module-i2c-pxa \
	kernel-module-htcuniversal-acx \
	kernel-module-acx \
	kernel-module-usbserial \
	"

module_autoload_acx = "acx"
module_autoload_htcuniversal_acx = "htcuniversal_acx"

IMAGE_FSTYPES ?= "tar.gz"

# Don't include kernels in standard images for Zaurus machines
RDEPENDS_kernel-base = ""
KERNEL_IMAGETYPE = "zImage"
```

## meta/conf/machine/hx2000.conf
```bitbake
#@TYPE: Machine
#@NAME: iPAQ hx2xxx
#@DESCRIPTION: Machine configuration for the hx2000 iPAQs with a pxa27x CPU 

TARGET_ARCH = "arm"
PACKAGE_EXTRA_ARCHS += "iwmmxt"

PREFERRED_PROVIDER_virtual/kernel = "linux-rp"

PREFERRED_VERSION_orinoco-modules = "0.15rc1"

ROOT_FLASH_SIZE = "80"

EXTRA_IMAGECMD_jffs2 = "; sumtool -i ${DEPLOY_DIR_IMAGE}/${IMAGE_NAME}.rootfs.jffs2 \
			  -o ${DEPLOY_DIR_IMAGE}/${IMAGE_NAME}.rootfs-summary.jffs2 \
			  -e 256KiB -p"

IMAGE_FSTYPES ?= "jffs2 tar.bz2"

MODUTILS = "26"	

MACHINE_FEATURES = "kernel26 touchscreen apm alsa pcmcia bluetooth irda wifi usbgadget usbhost screen vfat"

PCMCIA_MANAGER = "pcmciautils"

SERIAL_CONSOLE = "115200 ttyS0"

MACHINE_GUI_CLASS = "smallscreen"
MACHINE_DISPLAY_WIDTH_PIXELS = "240"
MACHINE_DISPLAY_HEIGHT_PIXELS = "320"

require conf/machine/include/tune-xscale.inc

# Uncomment this to use iwmmxt optimizations. Remove the above xscale stuff first
#require conf/machine/include/tune-iwmmxt.inc

module_autoload_evdev = "evdev"
module_autoload_pcmcia = "pcmcia"
module_autoload_mmc_block = "mmc_block"
module_autoload_snd-pcm-oss = "snd-pcm-oss"
module_autoload_snd-mixer-oss = "snd-mixer-oss"
module_autoload_pxa27x_udc = "pxa27x_udc"

#FIXME: this should be controlled by a userspace utility later.
module_autoload_g_ether = "g_ether"

# Don't include kernels in standard images
RDEPENDS_kernel-base = ""
KERNEL_IMAGETYPE = "zImage"
```

## meta/conf/machine/igep0030.conf
```bitbake
#@TYPE: Machine
#@NAME: OMAP3 IGEP module
#@DESCRIPTION: Machine configuration for the OMAP3 IGEP module (http://www.myigep.com)
TARGET_ARCH = "arm"

# Floating point option
TARGET_FPU_arm = "hard"

PREFERRED_PROVIDER_virtual/xserver = "xserver-xf86-lite"
XSERVER = "xserver-xf86-lite \
           xf86-input-evdev \
           xf86-input-mouse \
           xf86-input-keyboard \
           xf86-video-omapfb"


# Only has DVI connector for external screen
GUI_MACHINE_CLASS = "bigscreen"

#Ship all kernel modules till the board support has matured enough
MACHINE_EXTRA_RRECOMMENDS = " kernel-modules linux-firmware-sd8686"

include conf/machine/include/tune-cortexa8.inc

IMAGE_FSTYPES += "cpio ext3 jffs2"
EXTRA_IMAGECMD_jffs2 = "-lnp "

# Guesswork
SERIAL_CONSOLE = "115200 ttyS2"

PREFERRED_PROVIDER_virtual/kernel = "linux-igep"

KERNEL_IMAGETYPE = "uImage"

UBOOT_ENTRYPOINT = "0x80008000"
UBOOT_LOADADDRESS = "0x80008000"

MACHINE_FEATURES = "kernel26 apm alsa bluetooth usbgadget usbhost vfat wifi"

# EXTRA_IMAGEDEPENDS += "u-boot x-load"
```

## meta/conf/machine/include/arm/arch-armv4.inc
```bitbake
DEFAULTTUNE ?= "armv4"

ARMPKGARCH ?= "armv4"

TUNEVALID[armv4] = "Enable instructions for ARMv4"
TUNE_CCARGS += "${@bb.utils.contains("TUNE_FEATURES", "armv4", "-march=armv4${ARMPKGSFX_THUMB}", "", d)}"
MACHINEOVERRIDES .= "${@bb.utils.contains("TUNE_FEATURES", "armv4", ":armv4", "" ,d)}"

require conf/machine/include/arm/arch-arm.inc
require conf/machine/include/arm/feature-arm-thumb.inc

# Little Endian
AVAILTUNES += "armv4 armv4t"
TUNE_FEATURES_tune-armv4 ?= "armv4"
TUNE_FEATURES_tune-armv4t ?= "armv4 thumb"
PACKAGE_EXTRA_ARCHS_tune-armv4 = "arm armv4"
PACKAGE_EXTRA_ARCHS_tune-armv4t = "${PACKAGE_EXTRA_ARCHS_tune-armv4} armv4t"

# Big Endian
AVAILTUNES += "armv4b armv4tb"
TUNE_FEATURES_tune-armv4b ?= "${TUNE_FEATURES_tune-armv4} bigendian"
TUNE_FEATURES_tune-armv4tb ?= "${TUNE_FEATURES_tune-armv4t} bigendian"
PACKAGE_EXTRA_ARCHS_tune-armv4b = "armeb armv4b"
PACKAGE_EXTRA_ARCHS_tune-armv4tb = "${PACKAGE_EXTRA_ARCHS_tune-armv4} armv4tb"
```

## meta/conf/machine/include/arm/arch-armv5-dsp.inc
```bitbake
ARMPKGSFX_DSP = "${@bb.utils.contains("TUNE_FEATURES", [ "armv5", "dsp" ], "e", "", d)}"

require conf/machine/include/arm/arch-armv5.inc

# Little Endian
AVAILTUNES += "armv5e armv5te"
TUNE_FEATURES_tune-armv5e ?= "armv5 dsp"
TUNE_FEATURES_tune-armv5te ?= "armv5 dsp thumb"
PACKAGE_EXTRA_ARCHS_tune-armv5e = "${PACKAGE_EXTRA_ARCHS_tune-armv5} armv5e"
PACKAGE_EXTRA_ARCHS_tune-armv5te = "${PACKAGE_EXTRA_ARCHS_tune-armv5t} armv5e armv5te"

# Little Endian + VFP/DSP
AVAILTUNES += "armv5e-vfp armv5te-vfp armv5ehf-vfp armv5tehf-vfp"
TUNE_FEATURES_tune-armv5e-vfp ?= "armv5 vfp dsp"
TUNE_FEATURES_tune-armv5te-vfp ?= "armv5 vfp dsp thumb"
TUNE_FEATURES_tune-armv5ehf-vfp ?= "${TUNE_FEATURES_tune-armv5e-vfp} callconvention-hard"
TUNE_FEATURES_tune-armv5tehf-vfp ?= "${TUNE_FEATURES_tune-armv5te-vfp} callconvention-hard"
PACKAGE_EXTRA_ARCHS_tune-armv5e-vfp = "${PACKAGE_EXTRA_ARCHS_tune-armv5-vfp} armv5e armv5e-vfp"
PACKAGE_EXTRA_ARCHS_tune-armv5te-vfp = "${PACKAGE_EXTRA_ARCHS_tune-armv5t-vfp} armv5e armv5te armv5e-vfp armv5te-vfp"
PACKAGE_EXTRA_ARCHS_tune-armv5ehf-vfp = "${PACKAGE_EXTRA_ARCHS_tune-armv5hf-vfp} armv5ehf-vfp"
PACKAGE_EXTRA_ARCHS_tune-armv5tehf-vfp = "${PACKAGE_EXTRA_ARCHS_tune-armv5thf-vfp} armv5ehf-vfp armv5tehf-vfp"

# Big Endian
AVAILTUNES += "armv5eb armv5teb"
TUNE_FEATURES_tune-armv5eb ?= "${TUNE_FEATURES_tune-armv5e} bigendian"
TUNE_FEATURES_tune-armv5teb ?= "${TUNE_FEATURES_tune-armv5te} bigendian"
PACKAGE_EXTRA_ARCHS_tune-armv5eb = "${PACKAGE_EXTRA_ARCHS_tune-armv5b} armv5eb"
PACKAGE_EXTRA_ARCHS_tune-armv5teb = "${PACKAGE_EXTRA_ARCHS_tune-armv5tb} armv5eb armv5teb"

# Big Endian + VFP/DSP
AVAILTUNES += "armv5eb-vfp armv5teb-vfp armv5ehfb-vfp armv5tehfb-vfp"
TUNE_FEATURES_tune-armv5eb-vfp ?= "${TUNE_FEATURES_tune-armv5e-vfp} bigendian"
TUNE_FEATURES_tune-armv5teb-vfp ?= "${TUNE_FEATURES_tune-armv5te-vfp} bigendian"
TUNE_FEATURES_tune-armv5ehfb-vfp ?= "${TUNE_FEATURES_tune-armv5eb-vfp} callconvention-hard"
TUNE_FEATURES_tune-armv5tehfb-vfp ?= "${TUNE_FEATURES_tune-armv5teb-vfp} callconvention-hard"
PACKAGE_EXTRA_ARCHS_tune-armv5eb-vfp = "${PACKAGE_EXTRA_ARCHS_tune-armv5b-vfp} armv5eb armv5eb-vfp"
PACKAGE_EXTRA_ARCHS_tune-armv5teb-vfp = "${PACKAGE_EXTRA_ARCHS_tune-armv5tb-vfp} armv5eb armv5teb armv5eb-vfp armv5teb-vfp"
PACKAGE_EXTRA_ARCHS_tune-armv5ehfb-vfp = "${PACKAGE_EXTRA_ARCHS_tune-armv5hfb-vfp} armv5ehfb-vfp"
PACKAGE_EXTRA_ARCHS_tune-armv5tehfb-vfp = "${PACKAGE_EXTRA_ARCHS_tune-armv5thfb-vfp} armv5ehfb-vfp armv5tehfb-vfp"
```

## meta/conf/machine/include/arm/arch-armv6.inc
```bitbake
DEFAULTTUNE ?= "armv6"

ARMPKGARCH ?= "armv6"

TUNEVALID[armv6] = "Enable instructions for ARMv6"
TUNE_CONFLICTS[armv6] = "armv4 armv5"
TUNE_CCARGS += "${@bb.utils.contains("TUNE_FEATURES", "armv6", "-march=armv6", "", d)}"
MACHINEOVERRIDES .= "${@bb.utils.contains("TUNE_FEATURES", "armv6", ":armv6", "" ,d)}"

require conf/machine/include/arm/arch-armv5-dsp.inc

# Little Endian
AVAILTUNES += "armv6 armv6t armv6hf armv6thf"
TUNE_FEATURES_tune-armv6 ?= "armv6 vfp"
TUNE_FEATURES_tune-armv6t ?= "armv6 vfp thumb"
TUNE_FEATURES_tune-armv6hf ?= "${TUNE_FEATURES_tune-armv6} callconvention-hard"
TUNE_FEATURES_tune-armv6thf ?= "${TUNE_FEATURES_tune-armv6t} callconvention-hard"
PACKAGE_EXTRA_ARCHS_tune-armv6 = "${PACKAGE_EXTRA_ARCHS_tune-armv5e-vfp} armv6-vfp"
PACKAGE_EXTRA_ARCHS_tune-armv6t = "${PACKAGE_EXTRA_ARCHS_tune-armv5te-vfp} armv6-vfp armv6t-vfp"
PACKAGE_EXTRA_ARCHS_tune-armv6hf = "${PACKAGE_EXTRA_ARCHS_tune-armv5ehf-vfp} armv6hf-vfp"
PACKAGE_EXTRA_ARCHS_tune-armv6thf = "${PACKAGE_EXTRA_ARCHS_tune-armv5tehf-vfp} armv6hf-vfp armv6thf-vfp"

# Big Endian
AVAILTUNES += "armv6b armv6tb armv6hfb armv6thfb"
TUNE_FEATURES_tune-armv6b ?= "${TUNE_FEATURES_tune-armv6} bigendian"
TUNE_FEATURES_tune-armv6tb ?= "${TUNE_FEATURES_tune-armv6t} bigendian"
TUNE_FEATURES_tune-armv6hfb ?= "${TUNE_FEATURES_tune-armv6b} callconvention-hard"
TUNE_FEATURES_tune-armv6thfb ?= "${TUNE_FEATURES_tune-armv6tb} callconvention-hard"
PACKAGE_EXTRA_ARCHS_tune-armv6b = "${PACKAGE_EXTRA_ARCHS_tune-armv5eb-vfp} armv6b-vfp"
PACKAGE_EXTRA_ARCHS_tune-armv6tb = "${PACKAGE_EXTRA_ARCHS_tune-armv5teb-vfp} armv6b-vfp armv6tb-vfp"
PACKAGE_EXTRA_ARCHS_tune-armv6hfb = "${PACKAGE_EXTRA_ARCHS_tune-armv5ehfb-vfp} armv6hfb-vfp"
PACKAGE_EXTRA_ARCHS_tune-armv6thfb = "${PACKAGE_EXTRA_ARCHS_tune-armv5tehfb-vfp} armv6hfb-vfp armv6thfb-vfp"
```

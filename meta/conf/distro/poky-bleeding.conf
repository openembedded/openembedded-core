## meta/conf/distro/poky-bleeding.conf
```bitbake
require conf/distro/include/poky-floating-revisions.inc
require conf/distro/poky.conf
```

## meta/conf/distro/poky-lsb.conf
```bitbake
require conf/distro/poky.conf

DISTRO = "linuxstdbase"
DISTROOVERRIDES = "poky:linuxstdbase"

DISTRO_FEATURES += "pam largefile"
PREFERRED_PROVIDER_virtual/libx11 = "libx11"
```

## meta/conf/distro/poky.conf
```bitbake
DISTRO = "poky"
DISTRO_NAME = "Yocto (Built by Poky 5.0)"
DISTRO_VERSION = "1.0+snapshot-${DATE}"
SDK_VENDOR = "-pokysdk"
SDK_VERSION := "${@'${DISTRO_VERSION}'.replace('snapshot-${DATE}','snapshot')}"

MAINTAINER = "Poky <poky@yoctoproject.org>"

TARGET_VENDOR = "-poky"

LOCALCONF_VERSION = "1"

SDK_NAME = "${DISTRO}-${TCLIBC}-${SDK_ARCH}-${TARGET_ARCH}"
SDKPATH = "/opt/${DISTRO}/${SDK_VERSION}"

EXTRAOPKGCONFIG = "poky-feed-config-opkg"

QEMU_TARGETS ?= "arm i386 mips mipsel ppc x86_64"
# Other QEMU_TARGETS "mips64 mips64el sh4"

PREMIRRORS ?= "\
bzr://.*/.*   http://autobuilder.yoctoproject.org/sources/ \n \
cvs://.*/.*   http://autobuilder.yoctoproject.org/sources/ \n \
git://.*/.*   http://autobuilder.yoctoproject.org/sources/ \n \
hg://.*/.*    http://autobuilder.yoctoproject.org/sources/ \n \
osc://.*/.*   http://autobuilder.yoctoproject.org/sources/ \n \
p4://.*/.*    http://autobuilder.yoctoproject.org/sources/ \n \
svk://.*/.*   http://autobuilder.yoctoproject.org/sources/ \n \
svn://.*/.*   http://autobuilder.yoctoproject.org/sources/ \n"

MIRRORS =+ "\
ftp://.*/.*      http://autobuilder.yoctoproject.org/sources/ \n \
http://.*/.*     http://autobuilder.yoctoproject.org/sources/ \n \
https://.*/.*    http://autobuilder.yoctoproject.org/sources/ \n"
```

## meta/conf/distro/preferred-opie-versions.inc
```bitbake
#
# Default versions
QTE_VERSION ?= "2.3.10"
OPIE_VERSION ?= "1.2.2"
PALMTOP_USE_MULTITHREADED_QT ?= "yes"

#
#
# Opie libraries
#
PREFERRED_PROVIDER_virtual/libqte2 = '${@base_conditional("PALMTOP_USE_MULTITHREADED_QT", "yes", "qte-mt", "qte", d)}'
PREFERRED_PROVIDER_virtual/libqpe1 = "libqpe-opie"
PREFERRED_VERSION_qte-mt = "${QTE_VERSION}"
PREFERRED_VERSION_qte = "${QTE_VERSION}"
PREFERRED_VERSION_libopie2 = "${OPIE_VERSION}"
PREFERRED_VERSION_libopieobex0 = "${OPIE_VERSION}"
PREFERRED_VERSION_libopietooth1 = "${OPIE_VERSION}"
PREFERRED_VERSION_libqpe-opie = "${OPIE_VERSION}"
PREFERRED_VERSION_libqtaux2 = "${OPIE_VERSION}"
PREFERRED_VERSION_libmailwrapper = "${OPIE_VERSION}"
#
# Opie applications
#
PREFERRED_VERSION_opie-aboutapplet = "${OPIE_VERSION}"
PREFERRED_VERSION_opie-addressbook = "${OPIE_VERSION}"
PREFERRED_VERSION_opie-advancedfm = "${OPIE_VERSION}"
PREFERRED_VERSION_opie-alarm = "${OPIE_VERSION}"
PREFERRED_VERSION_opie-appearance = "${OPIE_VERSION}"
PREFERRED_VERSION_opie-aqpkg = "${OPIE_VERSION}"
PREFERRED_VERSION_opie-autorotateapplet = "${OPIE_VERSION}"
PREFERRED_VERSION_opie-backgammon = "${OPIE_VERSION}"
PREFERRED_VERSION_opie-backup = "${OPIE_VERSION}"
PREFERRED_VERSION_opie-bartender = "${OPIE_VERSION}"
PREFERRED_VERSION_opie-batteryapplet = "${OPIE_VERSION}"
PREFERRED_VERSION_opie-bluepin = "${OPIE_VERSION}"
PREFERRED_VERSION_opie-bluetoothapplet = "${OPIE_VERSION}"
PREFERRED_VERSION_opie-bluetoothmanager = "${OPIE_VERSION}"
PREFERRED_VERSION_opie-bounce = "${OPIE_VERSION}"
PREFERRED_VERSION_opie-brightnessapplet = "${OPIE_VERSION}"
PREFERRED_VERSION_opie-button-settings = "${OPIE_VERSION}"
PREFERRED_VERSION_opie-buzzword = "${OPIE_VERSION}"
PREFERRED_VERSION_opie-calculator = "${OPIE_VERSION}"
PREFERRED_VERSION_opie-calibrate = "${OPIE_VERSION}"
PREFERRED_VERSION_opie-camera = "${OPIE_VERSION}"
PREFERRED_VERSION_opie-cardmon = "${OPIE_VERSION}"
PREFERRED_VERSION_opie-checkbook = "${OPIE_VERSION}"
PREFERRED_VERSION_opie-citytime = "${OPIE_VERSION}"
PREFERRED_VERSION_opie-clipboardapplet = "${OPIE_VERSION}"
PREFERRED_VERSION_opie-clockapplet = "${OPIE_VERSION}"
PREFERRED_VERSION_opie-clock = "${OPIE_VERSION}"
PREFERRED_VERSION_opie-confeditor = "${OPIE_VERSION}"
PREFERRED_VERSION_opie-console = "${OPIE_VERSION}"
PREFERRED_VERSION_opie-dagger = "${OPIE_VERSION}"
PREFERRED_VERSION_opie-dasher = "${OPIE_VERSION}"
PREFERRED_VERSION_opie-datebook = "${OPIE_VERSION}"
PREFERRED_VERSION_opie-datebook-chrisholidayplugin = "${OPIE_VERSION}"
PREFERRED_VERSION_opie-datebook-nationalholidayplugin = "${OPIE_VERSION}"
PREFERRED_VERSION_opie-datebook-birthdayplugin = "${OPIE_VERSION}"
PREFERRED_VERSION_opie-deco-flat = "${OPIE_VERSION}"
PREFERRED_VERSION_opie-deco-liquid = "${OPIE_VERSION}"
PREFERRED_VERSION_opie-deco-polished = "${OPIE_VERSION}"
PREFERRED_VERSION_opie-doctab = "${OPIE_VERSION}"
PREFERRED_VERSION_opie-drawpad = "${OPIE_VERSION}"
PREFERRED_VERSION_opie-dvorak = "${OPIE_VERSION}"
PREFERRED_VERSION_opie-embeddedkonsole = "${OPIE_VERSION}"
PREFERRED_VERSION_opie-euroconv = "${OPIE_VERSION}"
PREFERRED_VERSION_opie-examples-python = "${OPIE_VERSION}"
PREFERRED_VERSION_opie-eye = "${OPIE_VERSION}"
PREFERRED_VERSION_opie-fifteen = "${OPIE_VERSION}"
PREFERRED_VERSION_opie-formatter = "${OPIE_VERSION}"
PREFERRED_VERSION_opie-freetype = "${OPIE_VERSION}"
PREFERRED_VERSION_opie-ftplib = "${OPIE_VERSION}"
PREFERRED_VERSION_opie-ftp = "${OPIE_VERSION}"
PREFERRED_VERSION_opie-go = "${OPIE_VERSION}"
PREFERRED_VERSION_opie-gutenbrowser = "${OPIE_VERSION}"
PREFERRED_VERSION_opie-handwriting = "${OPIE_VERSION}"
PREFERRED_VERSION_opie-helpbrowser = "${OPIE_VERSION}"
PREFERRED_VERSION_opie-help-en = "${OPIE_VERSION}"
PREFERRED_VERSION_opie-homeapplet = "${OPIE_VERSION}"
PREFERRED_VERSION_opie-i18n = "${OPIE_VERSION}"
PREFERRED_VERSION_opie-lrelease-native = "${OPIE_VERSION}"
PREFERRED_VERSION_opie-lupdate-native = "${OPIE_VERSION}"
PREFERRED_VERSION_opie-icon-reload = "${OPIE_VERSION}"
PREFERRED_VERSION_opie-irc = "${OPIE_VERSION}"
PREFERRED_VERSION_opie-irdaapplet = "${OPIE_VERSION}"
PREFERRED_VERSION_opie-jumpx = "${OPIE_VERSION}"
PREFERRED_VERSION_opie-kbill = "${OPIE_VERSION}"
PREFERRED_VERSION_opie-kcheckers = "${OPIE_VERSION}"
PREFERRED_VERSION_opie-keyboard = "${OPIE_VERSION}"
PREFERRED_VERSION_opie-keypebble = "${OPIE_VERSION}"
PREFERRED_VERSION_opie-keytabs = "${OPIE_VERSION}"
PREFERRED_VERSION_opie-keyview = "${OPIE_VERSION}"
PREFERRED_VERSION_opie-kjumpx = "${OPIE_VERSION}"
PREFERRED_VERSION_opie-kpacman = "${OPIE_VERSION}"
PREFERRED_VERSION_opie-language = "${OPIE_VERSION}"
PREFERRED_VERSION_opie-launcher-settings = "${OPIE_VERSION}"
PREFERRED_VERSION_opie-libqrsync = "${OPIE_VERSION}"
PREFERRED_VERSION_opie-light-and-power = "${OPIE_VERSION}"
PREFERRED_VERSION_opie-lockapplet = "${OPIE_VERSION}"
PREFERRED_VERSION_opie-login = "${OPIE_VERSION}"
PREFERRED_VERSION_opie-logoutapplet = "${OPIE_VERSION}"
PREFERRED_VERSION_opie-mailapplet = "${OPIE_VERSION}"
PREFERRED_VERSION_opie-mail = "${OPIE_VERSION}"
PREFERRED_VERSION_opie-mediaplayer1-libmadplugin = "${OPIE_VERSION}"
PREFERRED_VERSION_opie-mediaplayer1-libmodplugin = "${OPIE_VERSION}"
PREFERRED_VERSION_opie-mediaplayer1-libtremorplugin = "${OPIE_VERSION}"
PREFERRED_VERSION_opie-mediaplayer1-libwavplugin = "${OPIE_VERSION}"
PREFERRED_VERSION_opie-mediaplayer1 = "${OPIE_VERSION}"
PREFERRED_VERSION_opie-mediaplayer2 = "${OPIE_VERSION}"
PREFERRED_VERSION_opie-mediaplayer2-skin-default = "${OPIE_VERSION}"
PREFERRED_VERSION_opie-mediaplayer2-skin-default-landscape = "${OPIE_VERSION}"
PREFERRED_VERSION_opie-mediaplayer2-skin-pod = "${OPIE_VERSION}"
PREFERRED_VERSION_opie-mediaplayer2-skin-techno = "${OPIE_VERSION}"
PREFERRED_VERSION_opie-mediummount = "${OPIE_VERSION}"
PREFERRED_VERSION_opie-memoryapplet = "${OPIE_VERSION}"
PREFERRED_VERSION_opie-mindbreaker = "${OPIE_VERSION}"
PREFERRED_VERSION_opie-minesweep = "${OPIE_VERSION}"
PREFERRED_VERSION_opie-mobilemsg = "${OPIE_VERSION}"
PREFERRED_VERSION_opie-multikeyapplet = "${OPIE_VERSION}"
PREFERRED_VERSION_opie-multikey = "${OPIE_VERSION}"
PREFERRED_VERSION_opie-networkapplet = "${OPIE_VERSION}"
PREFERRED_VERSION_opie-networksettings = "${OPIE_VERSION}"
PREFERRED_VERSION_opie-notesapplet = "${OPIE_VERSION}"
PREFERRED_VERSION_opie-odict = "${OPIE_VERSION}"
PREFERRED_VERSION_opie-osearch = "${OPIE_VERSION}"
PREFERRED_VERSION_opie-oxygen = "${OPIE_VERSION}"
PREFERRED_VERSION_opie-oyatzee = "${OPIE_VERSION}"
PREFERRED_VERSION_opie-packagemanager = "${OPIE_VERSION}"
PREFERRED_VERSION_opie-parashoot = "${OPIE_VERSION}"
PREFERRED_VERSION_opie-pcmciaapplet = "${OPIE_VERSION}"
PREFERRED_VERSION_opie-performance = "${OPIE_VERSION}"
PREFERRED_VERSION_opie-pickboard = "${OPIE_VERSION}"
PREFERRED_VERSION_opie-pics = "${OPIE_VERSION}"
PREFERRED_VERSION_opie-pimconverter = "${OPIE_VERSION}"
PREFERRED_VERSION_opie-powerchord = "${OPIE_VERSION}"
PREFERRED_VERSION_opie-pyquicklaunchapplet = "${OPIE_VERSION}"
PREFERRED_VERSION_opie-qasteroids = "${OPIE_VERSION}"
PREFERRED_VERSION_opie-qcop = "${OPIE_VERSION}"
PREFERRED_VERSION_opie-quicklauncher = "${OPIE_VERSION}"
PREFERRED_VERSION_opie-qss = "${OPIE_VERSION}"
PREFERRED_VERSION_opie-rdesktop = "${OPIE_VERSION}"
PREFERRED_VERSION_opie-reader = "${OPIE_VERSION}"
PREFERRED_VERSION_opie-recorder = "${OPIE_VERSION}"
PREFERRED_VERSION_opie-remote = "${OPIE_VERSION}"
PREFERRED_VERSION_opie-restartapplet2 = "${OPIE_VERSION}"
PREFERRED_VERSION_opie-restartapplet = "${OPIE_VERSION}"
PREFERRED_VERSION_opie-restartapplet = "${OPIE_VERSION}"
PREFERRED_VERSION_opie-rotateapplet = "${OPIE_VERSION}"
PREFERRED_VERSION_opie-screenshotapplet = "${OPIE_VERSION}"
PREFERRED_VERSION_opie-search = "${OPIE_VERSION}"
PREFERRED_VERSION_opie-security = "${OPIE_VERSION}"
PREFERRED_VERSION_opie-securityplugin-blueping = "${OPIE_VERSION}"
PREFERRED_VERSION_opie-securityplugin-dummy = "${OPIE_VERSION}"
PREFERRED_VERSION_opie-securityplugin-notice = "${OPIE_VERSION}"
PREFERRED_VERSION_opie-securityplugin-pin = "${OPIE_VERSION}"
PREFERRED_VERSION_opie-sfcave = "${OPIE_VERSION}"
PREFERRED_VERSION_opie-sheet = "${OPIE_VERSION}"
PREFERRED_VERSION_opie-sh = "${OPIE_VERSION}"
PREFERRED_VERSION_opie-showimg = "${OPIE_VERSION}"
PREFERRED_VERSION_opie-snake = "${OPIE_VERSION}"
PREFERRED_VERSION_opie-solitaire = "${OPIE_VERSION}"
PREFERRED_VERSION_opie-sshkeys = "${OPIE_VERSION}"
PREFERRED_VERSION_opie-style-flat = "${OPIE_VERSION}"
PREFERRED_VERSION_opie-style-fresh = "${OPIE_VERSION}"
PREFERRED_VERSION_opie-style-liquid = "${OPIE_VERSION}"
PREFERRED_VERSION_opie-style-metal = "${OPIE_VERSION}"
PREFERRED_VERSION_opie-style-phase = "${OPIE_VERSION}"
PREFERRED_VERSION_opie-style-web = "${OPIE_VERSION}"
PREFERRED_VERSION_opie-sounds = "${OPIE_VERSION}"
PREFERRED_VERSION_opie-suspendapplet = "${OPIE_VERSION}"
PREFERRED_VERSION_opie-symlinker = "${OPIE_VERSION}"
PREFERRED_VERSION_opie-sysinfo = "${OPIE_VERSION}"
PREFERRED_VERSION_opie-systemtime = "${OPIE_VERSION}"
PREFERRED_VERSION_opie-tableviewer = "${OPIE_VERSION}"
PREFERRED_VERSION_opie-tabmanager = "${OPIE_VERSION}"
PREFERRED_VERSION_opie-taskbar = "${OPIE_VERSION}"
PREFERRED_VERSION_opie-tetrix = "${OPIE_VERSION}"
PREFERRED_VERSION_opie-textedit = "${OPIE_VERSION}"
PREFERRED_VERSION_opie-theme = "${OPIE_VERSION}"
PREFERRED_VERSION_opie-tictac = "${OPIE_VERSION}"
PREFERRED_VERSION_opie-tinykate = "${OPIE_VERSION}"
PREFERRED_VERSION_opie-today-addressbookplugin = "${OPIE_VERSION}"
PREFERRED_VERSION_opie-today-datebookplugin = "${OPIE_VERSION}"
PREFERRED_VERSION_opie-today-fortuneplugin = "${OPIE_VERSION}"
PREFERRED_VERSION_opie-today-mailplugin = "${OPIE_VERSION}"
PREFERRED_VERSION_opie-today = "${OPIE_VERSION}"
PREFERRED_VERSION_opie-today-stocktickerplugin = "${OPIE_VERSION}"
PREFERRED_VERSION_opie-today-todolistplugin = "${OPIE_VERSION}"
PREFERRED_VERSION_opie-today-weatherplugin = "${OPIE_VERSION}"
PREFERRED_VERSION_opie-todo = "${OPIE_VERSION}"
PREFERRED_VERSION_opie-tonleiter = "${OPIE_VERSION}"
PREFERRED_VERSION_opie-unikeyboard = "${OPIE_VERSION}"
PREFERRED_VERSION_opie-usermanager = "${OPIE_VERSION}"
PREFERRED_VERSION_opie-vmemo = "${OPIE_VERSION}"
PREFERRED_VERSION_opie-vmemo-settings = "${OPIE_VERSION}"
PREFERRED_VERSION_opie-volumeapplet = "${OPIE_VERSION}"
PREFERRED_VERSION_opie-vtapplet = "${OPIE_VERSION}"
PREFERRED_VERSION_opie-wellenreiter = "${OPIE_VERSION}"
PREFERRED_VERSION_opie-wirelessapplet = "${OPIE_VERSION}"
PREFERRED_VERSION_opie-wordgame = "${OPIE_VERSION}"
PREFERRED_VERSION_opie-write = "${OPIE_VERSION}"
PREFERRED_VERSION_opie-zkbapplet = "${OPIE_VERSION}"
PREFERRED_VERSION_opie-zlines = "${OPIE_VERSION}"
PREFERRED_VERSION_opie-zsafe = "${OPIE_VERSION}"
PREFERRED_VERSION_opie-zsame = "${OPIE_VERSION}"
PREFERRED_VERSION_konqueror-embedded = "20060404"
```

## meta/conf/layer.conf
```bitbake
# We have a conf and classes directory, add to BBPATH
BBPATH .= ":${LAYERDIR}"
# We have recipes-* directories, add to BBFILES
BBFILES += "${LAYERDIR}/recipes-*/*/*.bb"

BBFILE_COLLECTIONS += "core"
BBFILE_PATTERN_core = "^${LAYERDIR}/"
BBFILE_PRIORITY_core = "5"

# This should only be incremented on significant changes that will
# cause compatibility issues with other layers
LAYERVERSION_core = "4"

# Set a variable to get to the top of the metadata location
COREBASE = '${@os.path.normpath("${LAYERDIR}/../")}'

SIGGEN_EXCLUDERECIPES_ABISAFE += " \
  sysvinit-inittab \
  shadow-securetty \
  opkg-config-base \
  netbase \
  init-ifupdown \
  connman-conf \
  formfactor \
  xserver-xf86-config \
  pointercal \
  pointercal-xinput \
  base-files \
  keymaps \
  udev-extraconf \
  packagegroup-x11-xserver \
  systemd-serialgetty \
"
```

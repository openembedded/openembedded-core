## meta/conf/local.conf.sample
```bitbake
# CONF_VERSION is increased each time build/conf/ changes incompatibly
CONF_VERSION = "1"

# Uncomment and change to cache the files Poky downloads in an alternative
# location, default it ${TOPDIR}/downloads
#DL_DIR ?= "${TOPDIR}/downloads"
# Uncomment and change to cache Poky's built staging output in an alternative
# location, default ${TOPDIR}/sstate-cache
#SSTATE_DIR ?= "${TOPDIR}/sstate-cache"

# Uncomment and set to allow bitbake to execute multiple tasks at once.
# For a quadcore, BB_NUMBER_THREADS = "4", PARALLEL_MAKE = "-j 4" would
# be appropriate.
# BB_NUMBER_THREADS = "4"
# Also, make can be passed flags so it run parallel threads e.g.:
# PARALLEL_MAKE = "-j 4"

# The machine to target
MACHINE ?= "qemux86"

# Other supported machines
#MACHINE ?= "qemuarm"
#MACHINE ?= "qemux86-64"
#MACHINE ?= "atom-pc"
#MACHINE ?= "c7x0"
#MACHINE ?= "akita"
#MACHINE ?= "spitz"
#MACHINE ?= "cm-x270"
#MACHINE ?= "em-x270"
#MACHINE ?= "htcuniversal"
#MACHINE ?= "mx31ads"
#MACHINE ?= "mx31litekit"
#MACHINE ?= "mx31phy"
#MACHINE ?= "zylonite"
#MACHINE ?= "igep0020"
#MACHINE ?= "igep0030"

DISTRO ?= "poky"
# For bleeding edge / experimental / unstable package versions
# DISTRO ?= "poky-bleeding"

BBMASK = ""

# EXTRA_IMAGE_FEATURES allows extra packages to be added to the generated images 
# (Some of these are automatically added to certain image types)
# "dbg-pkgs"     - add -dbg packages for all installed packages
#                  (adds symbol information for debugging/profiling)
# "dev-pkgs"     - add -dev packages for all installed packages
#                  (useful if you want to develop against libs in the image)
# "tools-sdk"      - add development tools (gcc, make, pkgconfig etc.)
# "tools-debug"    - add debugging tools (gdb, strace)
# "tools-profile"  - add profiling tools (oprofile, exmap, lttng valgrind (x86 only))
# "tools-testapps" - add useful testing tools (ts_print, aplay, arecord etc.)
# "debug-tweaks"   - make an image for suitable of development
#                    e.g. ssh root access has a blank password
# There are other application targets too, see meta/classes/poky-image.bbclass 
# and meta/packages/tasks/task-poky.bb for more details.

EXTRA_IMAGE_FEATURES = "tools-debug tools-profile tools-testapps debug-tweaks"

# The default IMAGE_FEATURES above are too large for the mx31phy and 
# c700/c750 machines which have limited space. The code below limits
# the default features for those machines.
EXTRA_IMAGE_FEATURES_c7x0 = "tools-testapps debug-tweaks"
EXTRA_IMAGE_FEATURES_mx31phy = "debug-tweaks"
EXTRA_IMAGE_FEATURES_mx31ads = "tools-testapps debug-tweaks"

# A list of packaging systems used in generated images
# The first package type listed will be used for rootfs generation
# include 'package_deb' for debs
# include 'package_ipk' for ipks
# include 'package_rpm' for rpms
#PACKAGE_CLASSES ?= "package_rpm package_deb package_ipk"
PACKAGE_CLASSES ?= "package_rpm package_ipk"

# A list of additional classes to use when building the system
# include 'image-prelink' in order to prelink the filesystem image
# include 'image-swab' to perform host system intrusion detection
USER_CLASSES ?= "image-prelink"

# POKYMODE controls the characteristics of the generated packages/images by
# telling poky which type of toolchain to use.
#
# Options include several different EABI combinations and a compatibility 
# mode for the OABI mode poky previously used. 
#
# The default is "eabi"
# Use "oabi" for machines with kernels < 2.6.18 on ARM for example.
# Use "external-MODE" to use the precompiled external toolchains where MODE
# is the type of external toolchain to use e.g. eabi.
# POKYMODE = "external-eabi"

# Uncomment this to specify where BitBake should create its temporary files.
# Note that a full build of everything in OpenEmbedded will take GigaBytes of hard
# disk space, so make sure to free enough space. The default TMPDIR is
# <build directory>/tmp
#TMPDIR = "${POKYBASE}/build/tmp"


# Uncomment this if you are using the Openedhand provided qemu deb - see README
# ASSUME_PROVIDED += "qemu-native"

# Comment this out if you don't have a 3.x gcc version available and wish
# poky to build one for you. The 3.x gcc is required to build qemu-native.
# ASSUME_PROVIDED += "gcc3-native"

# Uncomment these two if you want BitBake to build images useful for debugging.
# DEBUG_BUILD = "1"
# INHIBIT_PACKAGE_STRIP = "1"

# Uncomment these to build a package such that you can use gprof to profile it.
# NOTE: This will only work with 'linux' targets, not
# 'linux-uclibc', as uClibc doesn't provide the necessary
# object files.  Also, don't build glibc itself with these
# flags, or it'll fail to build.
#
# PROFILE_OPTIMIZATION = "-pg"
# SELECTED_OPTIMIZATION = "${PROFILE_OPTIMIZATION}"
# LDFLAGS =+ "-pg"

# Uncomment this if you want BitBake to emit debugging output
# BBDEBUG = "yes"
# Uncomment this if you want BitBake to emit the log if a build fails.
BBINCLUDELOGS = "yes"

# Set this if you wish to make pkgconfig libraries from your system available 
# for native builds. Combined with extra ASSUME_PROVIDEDs this can allow 
# native builds of applications like oprofileui-native (unsupported feature).
#EXTRA_NATIVE_PKGCONFIG_PATH = ":/usr/lib/pkgconfig"
#ASSUME_PROVIDED += "gtk+-native libglade-native"

ENABLE_BINARY_LOCALE_GENERATION = "1"

# The architecture to build SDK items for, by setting this you can build SDK
# packages for architectures other than the host i.e. building i686 packages
# on an x86_64 host.
# Supported values are i686 and x86_64
#SDKMACHINE ?= "i686"

# Poky can try and fetch packaged-staging packages from a http, https or ftp
# mirror. Set this variable to the root of a pstage directory on a server.
#SSTATE_MIRRORS ?= "\
#file://.* http://someserver.tld/share/sstate/ \n \
#file://.* file:///some/local/dir/sstate/"

# Set IMAGETEST to qemu if you want to build testcases and start 
# testing in qemu after do_rootfs.
#IMAGETEST = "qemu"

# By default test cases in sanity suite will be ran. If you want to run other 
# test suite or specific test case(e.g. bat or boot test case under sanity suite), 
# list them like following.
#TEST_SCEN = "sanity bat sanity:boot"

#Because of the QEMU booting slowness issue(see bug #646 and #618), autobuilder
#may suffer a timeout issue when running sanity test. We introduce variable
#TEST_SERIALIZE here to reduce the time on sanity test. It is by default set 
#to 1. Poky will start image and run cases in the same image without reboot 
#or kill. If it is set to 0, the image will be copied and tested for each 
#case, which will take much time.
#TEST_SERIALIZE = "1"

# Set GLIBC_GENERATE_LOCALES to the locales you wish to generate should you not
# wish to perform the time-consuming step of generating all LIBC locales.
# NOTE: If removing en_US.UTF-8 you will also need to uncomment, and set
# appropriate values for IMAGE_LINGUAS and LIMIT_BUILT_LOCALES
# WARNING: this may break localisation!
#GLIBC_GENERATE_LOCALES = "en_GB.UTF-8 en_US.UTF-8"
# See message above as to whether setting these is required
#IMAGE_LINGUAS ?= "en-gb"
#LIMIT_BUILT_LOCALES ?= "POSIX en_GB"

# This value is currently used by PSEUDO to determine if the recipe should
# build both the 32-bit and 64-bit wrapper libraries on a 64-bit build system.
#
# PSEUDO will attempt to determine if a 32-bit wrapper is necessary, but 
# it doesn't always guess properly.  If you have 32-bit executables on 
# your 64-bit build system, you likely want to set this to "0", 
# otherwise you could end up with incorrect file attributes on the 
# target filesystem.
#
# Default to not build 32 bit libs on 64 bit systems, comment this
# out if that is desired
NO32LIBS = "1"

# If you do not use (or have installed) gnome-terminal you will need to
# uncomment these variables and set them to the terminal you wish to use
# when resolving patches which cannot be applied
# Supported shell prefixes for *_TERMCMD and *_TERMCMDRUN ARE:
# GNOME, SCREEN, XTERM and KONSOLE
#TERMCMD = "${KONSOLE_TERMCMD}"
#TERMCMDRUN = "${KONSOLE_TERMCMDRUN}"
```

## meta/conf/machine/akita.conf
```bitbake
#@TYPE: Machine
#@NAME: Sharp Zaurus SL-C1000
#@DESCRIPTION: Machine configuration for the Sharp Zaurus SL-C1000 device

require conf/machine/include/zaurus-2.6.inc
require conf/machine/include/zaurus-clamshell.inc

PACKAGE_EXTRA_ARCHS += "iwmmxt" 
MACHINE_FEATURES += "iwmmxt"

IMAGE_FSTYPES ?= "jffs2"

ROOT_FLASH_SIZE = "58"
```

## meta/conf/machine/atom-pc.conf
```bitbake
#@TYPE: Machine
#@NAME: Atom-PC

#@DESCRIPTION: Machine configuration for Intel Atom based PCs. Currently supported machines are the Asus eee901, Acer Aspire One, Toshiba NB305, and Intel BlackSand development board.

TARGET_ARCH = "i586"

include conf/machine/include/tune-atom.inc

MACHINE_FEATURES = "kernel26 screen keyboard pci usbhost ext2 ext3 x86 wifi \
                    acpi"

KERNEL_IMAGETYPE = "bzImage"

PREFERRED_PROVIDER_virtual/kernel ?= "linux-yocto-stable"
#PREFERRED_PROVIDER_linux-libc-headers ?= "linux-libc-headers-yocto"
PREFERRED_PROVIDER_virtual/libx11 ?= "libx11-trim"
PREFERRED_PROVIDER_virtual/libgl  ?= "mesa-dri"
PREFERRED_PROVIDER_virtual/xserver ?= "xserver-xf86-dri-lite"
PREFERRED_PROVIDER_virtual/xserver-xf86 ?= "xserver-xf86-dri-lite"
XSERVER ?= "xserver-xf86-dri-lite \
           xf86-input-mouse \
           xf86-input-keyboard \
           xf86-input-evdev \
           xf86-input-synaptics \
           xf86-video-intel \
           mesa-dri-driver-i915"

#MACHINE_EXTRA_RDEPENDS = "rt2860"

MACHINE_EXTRA_RRECOMMENDS = "kernel-modules eee-acpi-scripts"

GUI_MACHINE_CLASS = "bigscreen"

IMAGE_ROOTFS_SIZE_ext3 = "500000"

IMAGE_FSTYPES ?= "ext3 cpio.gz"

APPEND += "usbcore.autosuspend=1"

GLIBC_ADDONS = "nptl"
GLIBC_EXTRA_OECONF = "--with-tls"

EXTRA_OECONF_append_pn-matchbox-panel-2 = " --with-battery=acpi"

ROOTLESS_X = "1"
```

## meta/conf/machine/beagleboard.conf
```bitbake
#@TYPE: Machine
#@NAME: Beagleboard machine
#@DESCRIPTION: Machine configuration for the http://beagleboard.org/ board 
TARGET_ARCH = "arm"

PREFERRED_PROVIDER_virtual/xserver = "xserver-kdrive"
XSERVER = "xserver-kdrive-fbdev"

# Only has DVI connector for external screen
GUI_MACHINE_CLASS = "bigscreen"

#Ship all kernel modules till the board support has matured enough
MACHINE_EXTRA_RRECOMMENDS = " kernel-modules"

#include conf/machine/include/tune-arm1136jf-s.inc
include conf/machine/include/tune-cortexa8.inc

IMAGE_FSTYPES += "tar.bz2 jffs2"
EXTRA_IMAGECMD_jffs2 = "-lnp "

# Guesswork
SERIAL_CONSOLE = "115200 ttyS2"

PREFERRED_PROVIDER_virtual/kernel = "linux-yocto-stable"
#PREFERRED_PROVIDER_linux-libc-headers ?= "linux-libc-headers-yocto"

KERNEL_IMAGETYPE = "uImage"

UBOOT_ENTRYPOINT = "0x80008000"
UBOOT_LOADADDRESS = "0x80008000"


# and sdio
MACHINE_FEATURES = "kernel26 apm usbgadget usbhost vfat alsa"
```

## meta/conf/machine/bootcdx86.conf
```bitbake
#@TYPE: Machine
#@NAME: Bootable CD x86 setup
#@DESCRIPTION: Machine configuration for running an x86 system from bootable CD

require conf/machine/qemux86.conf

MACHINE_FEATURES = "kernel26 alsa screen"

EXTRA_IMAGE_FEATURES = ""
IMAGE_ROOTFS_SIZE_ext2 = "70000"
```

## meta/conf/machine/cm-x270.conf
```bitbake
#@TYPE: Machine
#@Name: Compulab cm-x270
#@DESCRIPTION: Machine configuration for Compulab cm-x270 computer module
#OLDEST_KERNEL = "2.6.16"
TARGET_ARCH = "arm"
GUI_MACHINE_CLASS ?= "bigscreen"

PREFERRED_PROVIDER_virtual/kernel = "linux"
PREFERRED_VERSION_linux ?= "2.6.23"

PACKAGE_EXTRA_ARCHS = "armv4 armv4t armv5te iwmmxt"

require conf/machine/include/tune-xscale.inc

# console serial port.  If you have a L module
# the below works.  If you have a W module, add
# the following line to your local.conf:
#   CMX270_CONSOLE_SERIAL_PORT = "ttyS0"

# NAND flash eraseblock size
# most of the older cm-x270 modules are populated with NAND flash
# that have 128KiB eraseblocks.  Recently, a user encounted
# a device that has 16KiB eraseblocks.  The following define
# can be overridden in local.conf if you have one of these devices.
CMX270_NAND_ERASEBLOCK_SIZE ?= "0x20000"

# the following is for the cm-x270 L module
CMX270_CONSOLE_SERIAL_PORT ?= "ttyS1"

# used by sysvinit_2 package, so rebuild this
# package if you change the SERIAL_CONSOLE setting
# the following is the port for the cm-x270 L module
# I think the W module would use ttyS0, but has
# not been tested.  This can be overwritten in 
# local.conf
SERIAL_CONSOLE ?= "38400 ${CMX270_CONSOLE_SERIAL_PORT}"

# used by opie-collections.inc
ROOT_FLASH_SIZE ?= "32"

# for NAND flash.
EXTRA_IMAGECMD_jffs2 = "--little-endian --eraseblock=${CMX270_NAND_ERASEBLOCK_SIZE} --pad --no-cleanmarkers;\
	sumtool -i ${DEPLOY_DIR_IMAGE}/${IMAGE_NAME}.rootfs.jffs2 \
	-o ${DEPLOY_DIR_IMAGE}/${IMAGE_NAME}.rootfs-summary.jffs2 \
	-e ${CMX270_NAND_ERASEBLOCK_SIZE} -p; \
	cd ${DEPLOY_DIR_IMAGE}; \
	rm -f ${DEPLOY_DIR_IMAGE}/${IMAGE_LINK_NAME}.rootfs-summary.jffs2; \
	ln -s ${IMAGE_NAME}.rootfs-summary.jffs2 ${IMAGE_LINK_NAME}.rootfs-summary.jffs2 \
	"

MACHINE_FEATURES = "kernel26 pcmcia usbhost usbgadget pcmcia touchscreen alsa iwmmxt"

# to program the compulab NAND flash, the following scheme is suggested.  Create
# a small rootfs that can fit in NOR flash using the following config:
#   - Angstrom distro
#   - uclibc (set ANGSTROM_MODE = "uclibc" in local.conf)
#   - angstrom-minimal-image-with-mtd-utils bitbake target
#   - put the following in your local.conf
#     - IMAGE_FSTYPES = "jffs2 tar cpio.gz"
# now, when you build the image, a cpio.gz will be generated
# that can be used as an initramfs.  You can boot into this image and then
# program the main rootfs jffs2 image in NAND flash using mtd-utils
# you can select booting the initramfs, or the main nand rootfs by using
# the "ramdisk on", or "ramdisk off" commands in the bootloader
#
```

## meta/conf/machine/cmx270.conf
```bitbake
#@TYPE: Machine
#@NAME: Nokia 770 internet tablet
#@DESCRIPTION: Machine configuration for the Compulab CM-X270
TARGET_ARCH = "arm"
IPKG_EXTRA_ARCHS = "armv4 armv5te"

EXTRA_IMAGECMD_jffs2 = "--pad --little-endian --eraseblock=0x4000 -n"

IMAGE_CMD_jffs2 = "mkdir -p ${DEPLOY_DIR_IMAGE}; \
                  mkfs.jffs2 --root=${IMAGE_ROOTFS} --faketime \
                   --output=${DEPLOY_DIR_IMAGE}/${IMAGE_NAME}.rootfs.img ${EXTRA_IMAGECMD}; "

IMAGE_FSTYPES ?= "jffs2 tar.bz2"

PREFERRED_PROVIDER_virtual/bootloader = ""

# 800x480 is big enough for me
GUI_MACHINE_CLASS = "bigscreen"

include conf/machine/include/tune-xscale.conf

#size of the root partition (yes, it is 123 MB)
ROOT_FLASH_SIZE = "128"

# serial console port on devboard rev. B3
SERIAL_CONSOLE = "115200 ttyS0"

PREFERRED_PROVIDER_virtual/kernel = "linux-cmx270"

MACHINE_FEATURES = "kernel26 apm alsa pcmcia bluetooth irda usbgadget"
```

## meta/conf/machine/depicture.conf
```bitbake
#@TYPE: Machine
#@NAME: Simtec BBD20EUROU + IM2440D20 (Combination known as: Depicture)
#@DESCRIPTION: Machine configuration for running an ARM 920t in the BBD20EUROU board.

TARGET_ARCH = "arm"

require conf/machine/include/qemu.inc
require conf/machine/include/tune-arm920t.inc

KERNEL_IMAGETYPE = "zImage"

SERIAL_CONSOLE = "115200 ttySAC0"

PREFERRED_PROVIDER_virtual/kernel = "linux-simtec"
PREFERRED_PROVIDER_virtual/xserver = "xserver-kdrive-fbdev"

MACHINE_FEATURES = "kernel26 alsa usbhost"
XSERVER = "xserver-kdrive-fbdev"

SERIAL_CONSOLE = "115200 ttySAC0"

# used by some images
ROOT_FLASH_SIZE = "28"

# Ensure the JFFS2 has summary nodes...
IMAGE_FSTYPES += " jffs2"
EXTRA_IMAGECMD_jffs2 = "--little-endian --eraseblock=0x20000 --pagesize=0x800 \
  --no-cleanmarkers --pad -n -x lzo ; sumtool --eraseblock=0x20000 --no-cleanmarkers \
  --littleendian --pad \
  -i ${DEPLOY_DIR_IMAGE}/${IMAGE_NAME}.rootfs.jffs2 \
  -o ${DEPLOY_DIR_IMAGE}/${IMAGE_NAME}.rootfs.jffs2.summary"
```

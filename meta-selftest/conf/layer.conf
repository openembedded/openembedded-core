## meta-selftest/conf/layer.conf
```bitbake
LAYERNAME = "selftest"

addpylib ${LAYERDIR}/lib oeqa

LAYERSERIES_COMPAT_selftest = "garburn"

OE_FRAGMENTS_BUILTIN += " selftest-fragment:SELFTEST_BUILTIN_FRAGMENT_VARIABLE"
```

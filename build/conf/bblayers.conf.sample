## build/conf/bblayers.conf.sample
```bitbake
# LAYER_CONF_VERSION is increased each time build/conf/bblayers.conf
# changes incompatibly
LCONF_VERSION = "1"

BBFILES ?= ""
BBLAYERS = " \
  ${OEROOT}/meta \
  ${OEROOT}/meta-moblin \
  "
```

## build/conf/local.conf
```bitbake
# Where to cache the files OE downloads
DL_DIR = "/usr/oe/sources"
BBFILES := "/usr/ohoe/openembedded/packages/*/*.bb"

BBMASK = ""
PREFERRED_PROVIDERS = "virtual/qte:qte-for-opie virtual/libqpe:libqpe-opie"
PREFERRED_PROVIDERS += " virtual/libsdl:libsdl-qpe"
PREFERRED_PROVIDERS += " virtual/${TARGET_PREFIX}gcc-initial:gcc-cross-initial"
PREFERRED_PROVIDERS += " virtual/${TARGET_PREFIX}gcc:gcc-cross"
PREFERRED_PROVIDERS += " virtual/${TARGET_PREFIX}g++:gcc-cross"

# Uncomment this to specify where BitBake should create its temporary files.
# Note that a full build of everything in OpenEmbedded will take GigaBytes of hard
# disk space, so make sure to free enough space. The default TMPDIR is
# <build directory>/tmp
# TMPDIR = /usr/local/projects/oetmp
# Uncomment this to disable the parse cache (not recommended).
# CACHE = ""
# Uncomment this if you want BitBake to emit debugging output
# BBDEBUG = "yes"

MACHINE = "c7x0"

DISTRO = "openzaurus-3.5.4"

DISTRO_TYPE = "debug"
KERNEL_VERSION = "2.6"

IMAGE_FSTYPES = "jffs2 tar"


# Uncomment these two if you want BitBake to build images useful for debugging.
# DEBUG_BUILD = "1"
# INHIBIT_PACKAGE_STRIP = "1"

# Uncomment these to build a package such that you can use gprof to profile it.
# NOTE: This will only work with 'linux' targets, not
# 'linux-uclibc', as uClibc doesn't provide the necessary
# object files.  Also, don't build glibc itself with these
# flags, or it'll fail to build.
#
# PROFILE_OPTIMIZATION = "-pg"
# SELECTED_OPTIMIZATION = "${PROFILE_OPTIMIZATION}"
# LDFLAGS =+ "-pg"

# Uncomment this if you want BitBake to emit the log if a build fails.
BBINCLUDELOGS = "yes"

# Specifies a location to search for pre-generated tarballs when fetching
# a cvs:// URI.  Uncomment this, if you not want to pull directly from CVS.
CVS_TARBALL_STASH = "http://www.oesources.org/source/current/"

PREFERRED_VERSION_gcc-cross= "3.4.3"
PREFERRED_VERSION_gcc-cross-initial= "3.4.3"
```

## build/conf/local.conf.sample
```bitbake
# Where to cache the files Poky downloads
DL_DIR ?= "${OEROOT}/sources"
BBFILES += "\
    ${OEROOT}/meta/packages/*/*.bb \
    ${OEROOT}/meta-moblin/packages/*/*.bb"

BBFILE_COLLECTIONS = "normal moblin"
BBFILE_PATTERN_normal = "^${OEROOT}/meta/"
BBFILE_PATTERN_moblin = "^${OEROOT}/meta-moblin/"

BBFILE_PRIORITY_normal = "5"
BBFILE_PRIORITY_moblin = "5"

# Uncomment and set to allow bitbake to execute multiple tasks at once.
# For a quadcore, BB_NUMBER_THREADS = "4", PARALLEL_MAKE = "-j 4" would
# be appropriate.
# BB_NUMBER_THREADS = "4"
# Also, make can be passed flags so it run parallel threads e.g.:
# PARALLEL_MAKE = "-j 4"

# The machine to target
MACHINE ?= "qemux86"

# Other supported machines
#MACHINE ?= "qemuarm"
#MACHINE ?= "netbook"
#MACHINE ?= "c7x0"
#MACHINE ?= "akita"
#MACHINE ?= "spitz"
#MACHINE ?= "nokia770"
#MACHINE ?= "nokia800"
#MACHINE ?= "fic-gta01"
#MACHINE ?= "bootcdx86"
#MACHINE ?= "cm-x270"
#MACHINE ?= "em-x270"
#MACHINE ?= "htcuniversal"
#MACHINE ?= "mx31ads"
#MACHINE ?= "mx31litekit"
#MACHINE ?= "mx31phy"
#MACHINE ?= "zylonite"

DISTRO ?= "poky"
# For bleeding edge / experimental / unstable package versions
# DISTRO ?= "poky-bleeding"

# Poky has various extra metadata collections (openmoko, extras).
# To enable these, uncomment all (or some of) the following lines:
# BBFILES = "\
#    ${OEROOT}/meta/packages/*/*.bb \
#    ${OEROOT}/meta-extras/packages/*/*.bb \
#    ${OEROOT}/meta-openmoko/packages/*/*.bb \
#    ${OEROOT}/meta-moblin/packages/*/*.bb \
#    "
# BBFILE_COLLECTIONS = "normal extras openmoko moblin"
# BBFILE_PATTERN_normal = "^${OEROOT}/meta/"
# BBFILE_PATTERN_extras = "^${OEROOT}/meta-extras/"
# BBFILE_PATTERN_openmoko = "^${OEROOT}/meta-openmoko/"
# BBFILE_PATTERN_moblin = "^${OEROOT}/meta-moblin/"
# BBFILE_PRIORITY_normal = "5"
# BBFILE_PRIORITY_extras = "5"
# BBFILE_PRIORITY_openmoko = "5"
# BBFILE_PRIORITY_moblin = "5"

BBMASK = ""

# EXTRA_IMAGE_FEATURES allows extra packages to be added to the generated images 
# (Some of these are automatically added to certain image types)
# "dbg-pkgs"     - add -dbg packages for all installed packages
#                  (adds symbol information for debugging/profiling)
# "dev-pkgs"     - add -dev packages for all installed packages
#                  (useful if you want to develop against libs in the image)
# "tools-sdk"      - add development tools (gcc, make, pkgconfig etc.)
# "tools-debug"    - add debugging tools (gdb, strace)
# "tools-profile"  - add profiling tools (oprofile, exmap, lttng valgrind (x86 only))
# "tools-testapps" - add useful testing tools (ts_print, aplay, arecord etc.)
# "debug-tweaks"   - make an image for suitable of development
#                    e.g. ssh root access has a blank password
# There are other application targets too, see meta/classes/poky-image.bbclass 
# and meta/packages/tasks/task-poky.bb for more details.

EXTRA_IMAGE_FEATURES = "tools-debug tools-profile tools-testapps debug-tweaks"

# The default IMAGE_FEATURES above are too large for the mx31phy and 
# c700/c750 machines which have limited space. The code below limits
# the default features for those machines.
EXTRA_IMAGE_FEATURES_c7x0 = "tools-testapps debug-tweaks"
EXTRA_IMAGE_FEATURES_mx31phy = "debug-tweaks"
EXTRA_IMAGE_FEATURES_mx31ads = "tools-testapps debug-tweaks"

# A list of packaging systems used in generated images
# The first package type listed will be used for rootfs generation
# include 'package_deb' for debs
# include 'package_ipk' for ipks
#PACKAGE_CLASSES ?= "package_deb package_ipk"
PACKAGE_CLASSES ?= "package_ipk"

# POKYMODE controls the characteristics of the generated packages/images by
# telling poky which type of toolchain to use.
#
# Options include several different EABI combinations and a compatibility 
# mode for the OABI mode poky previously used. 
#
# The default is "eabi"
# Use "oabi" for machines with kernels < 2.6.18 on ARM for example.
# Use "external-MODE" to use the precompiled external toolchains where MODE
# is the type of external toolchain to use e.g. eabi.
# POKYMODE = "external-eabi"

# Uncomment this to specify where BitBake should create its temporary files.
# Note that a full build of everything in OpenEmbedded will take GigaBytes of hard
# disk space, so make sure to free enough space. The default TMPDIR is
# <build directory>/tmp
TMPDIR = "${OEROOT}/build/tmp"


# Uncomment this if you are using the Openedhand provided qemu deb - see README
# ASSUME_PROVIDED += "qemu-native"

# Comment this out if you don't have a 3.x gcc version available and wish
# poky to build one for you. The 3.x gcc is required to build qemu-native.
# ASSUME_PROVIDED += "gcc3-native"

# Uncomment these two if you want BitBake to build images useful for debugging.
# DEBUG_BUILD = "1"
# INHIBIT_PACKAGE_STRIP = "1"

# Uncomment these to build a package such that you can use gprof to profile it.
# NOTE: This will only work with 'linux' targets, not
# 'linux-uclibc', as uClibc doesn't provide the necessary
# object files.  Also, don't build glibc itself with these
# flags, or it'll fail to build.
#
# PROFILE_OPTIMIZATION = "-pg"
# SELECTED_OPTIMIZATION = "${PROFILE_OPTIMIZATION}"
# LDFLAGS =+ "-pg"

# Uncomment this if you want BitBake to emit debugging output
# BBDEBUG = "yes"
# Uncomment this if you want BitBake to emit the log if a build fails.
BBINCLUDELOGS = "yes"

# Specifies a location to search for pre-generated tarballs when fetching
# a cvs:// or svn:// URI.  Uncomment this, if you do not want to pull directly
# from CVS or Subversion
SRC_TARBALL_STASH = "http://pokylinux.org/sources/"

# Set this if you wish to make pkgconfig libraries from your system available 
# for native builds. Combined with extra ASSUME_PROVIDEDs this can allow 
# native builds of applications like oprofileui-native (unsupported feature).
#EXTRA_NATIVE_PKGCONFIG_PATH = ":/usr/lib/pkgconfig"
#ASSUME_PROVIDED += "gtk+-native libglade-native"

ENABLE_BINARY_LOCALE_GENERATION = "1"
```

## meta-emenlow/conf/layer.conf
```bitbake
# We have a conf and classes directory, add to BBPATH
BBPATH := "${BBPATH}:${LAYERDIR}"

# We have a packages directory, add to BBFILES
BBFILES := "${BBFILES} ${LAYERDIR}/recipes-*/*/*.bb \
	${LAYERDIR}/recipes-*/*/*.bbappend"

BBFILE_COLLECTIONS += "emenlow"
BBFILE_PATTERN_emenlow := "^${LAYERDIR}/"
BBFILE_PRIORITY_emenlow = "6"
```

## meta-emenlow/conf/machine/emenlow.conf
```bitbake
#@TYPE: Machine
#@NAME: emenlow

#@DESCRIPTION: Machine configuration for eMenlow based systems, like the
# Webs-2120 box.

TARGET_ARCH = "i586"
PACKAGE_EXTRA_ARCHS = "x86 core2"

include conf/machine/include/tune-atom.inc

BASE_PACKAGE_ARCH="core2"

MACHINE_FEATURES = "kernel26 screen keyboard pci usbhost ext2 ext3 x86 \
                    acpi serial usbgadget"

KERNEL_IMAGETYPE = "bzImage"

PREFERRED_PROVIDER_virtual/kernel = "linux-yocto-stable"
#PREFERRED_PROVIDER_linux-libc-headers ?= "linux-libc-headers-yocto"
PREFERRED_PROVIDER_libdrm = "libdrm-poulsbo"
PREFERRED_PROVIDER_drm = "libdrm-poulsbo"
PREFERRED_PROVIDER_virtual/libx11 = "libx11-trim"
PREFERRED_PROVIDER_virtual/libgl = "xpsb-glx"
PREFERRED_PROVIDER_virtual/xserver = "xserver-psb"
PREFERRED_PROVIDER_virtual/xserver-xf86 = "xserver-psb"
PREFERRED_PROVIDER_xserver-xf86-dri-lite = "xserver-psb"

XSERVER ?= "xserver-psb \
           xf86-input-mouse \
           xf86-input-keyboard \
           xf86-input-evdev"

SERIAL_CONSOLE = "115200 ttyS0"

MACHINE_EXTRA_RRECOMMENDS = "kernel-modules eee-acpi-scripts"

GUI_MACHINE_CLASS = "bigscreen"

IMAGE_ROOTFS_SIZE_ext3 = "2000000"

IMAGE_FSTYPES ?= "ext3 cpio.gz"

GLIBC_ADDONS = "nptl"
GLIBC_EXTRA_OECONF = "--with-tls"

SRCREV_machine_pn-linux-yocto-stable_emenlow ?= "aae69fdf104b0a9d7b3710f808aac6ab303490f7"
SRCREV_meta_pn-linux-yocto-stable_emenlow ?= "50ccd2b3213b6a1bacb3f898c035119802dac420"
```

## meta-emenlow/packages/linux/linux-wrs/defconfig
```kconfig
CONFIG_X86_32=y
CONFIG_PRINTK=y

# Basic hardware support for the box - network, USB, PCI, sound
CONFIG_NETDEVICES=y
CONFIG_NETDEV_1000=y
CONFIG_ATA=y
CONFIG_ATA_GENERIC=y
CONFIG_ATA_SFF=y
CONFIG_PCI=y
CONFIG_MMC=y
CONFIG_MMC_SDHCI=y
CONFIG_USB_SUPPORT=y
CONFIG_USB=y
CONFIG_USB_ARCH_HAS_EHCI=y
CONFIG_E1000E=y
CONFIG_R8169=y
CONFIG_PATA_SCH=y
CONFIG_MMC_SDHCI_PCI=y
CONFIG_USB_EHCI_HCD=y
CONFIG_PCIEPORTBUS=y
CONFIG_NET=y
CONFIG_USB_UHCI_HCD=y
CONFIG_BLK_DEV_SD=y
CONFIG_CHR_DEV_SG=y
CONFIG_SOUND=y
CONFIG_SND=y
CONFIG_SND_HDA_INTEL=y

# Make sure these are on, otherwise the bootup won't be fun
CONFIG_EXT3_FS=y
CONFIG_UNIX=y
CONFIG_INET=y
CONFIG_MODULES=y
CONFIG_SHMEM=y
CONFIG_TMPFS=y
CONFIG_PACKET=y

# These are needed for the Poulsbo kernel modules
CONFIG_I2C=y
CONFIG_AGP=y
CONFIG_VFAT_FS=y
CONFIG_PM=y
CONFIG_ACPI=y
CONFIG_FB=y
CONFIG_BACKLIGHT_LCD_SUPPORT=y
CONFIG_BACKLIGHT_CLASS_DEVICE=y
CONFIG_INPUT=y
CONFIG_VIDEO_V4L2=y
CONFIG_VIDEO_IVTV=y
CONFIG_MEDIA_SUPPORT=y
CONFIG_VIDEO_CAPTURE_DRIVERS=y
CONFIG_VIDEO_DEV=y
CONFIG_VIDEO_V4L2_COMMON=y
CONFIG_I2C_ALGOBIT=y
CONFIG_FB_CFB_COPYAREA=y
CONFIG_FB_CFB_IMAGEBLIT=y
CONFIG_FB_CFB_FILLRECT=y
CONFIG_VIDEO_FB_IVTV=y

# Needed for booting (and using) USB memory sticks
CONFIG_USB_STORAGE=y
CONFIG_BLK_DEV_RAM=y
CONFIG_BLK_DEV_LOOP=y
CONFIG_BLK_DEV_INITRD=y
CONFIG_RD_GZIP=y
CONFIG_NLS_CODEPAGE_437=y
CONFIG_NLS_ISO8859_1=y
```

## meta-extras/conf/distro/include/poky-extras-src-revisions.inc
```bitbake
SRCREV_pn-evince ??= "2437"
SRCDATE_maemo-mapper-nohildon ??= "20061114"
SRCREV_pn-libxosd ??= "627"
SRCREV_pn-matchbox-applet-light ??= "1548"
SRCREV_pn-matchbox-common ??= "1561"
```

## meta-extras/conf/layer.conf
```bitbake
# We have a conf and classes directory, add to BBPATH
BBPATH := "${BBPATH}:${LAYERDIR}"

# We have a packages directory, add to BBFILES
BBFILES := "${BBFILES} ${LAYERDIR}/packages/*/*.bb"

BBFILE_COLLECTIONS += "extras"
BBFILE_PATTERN_extras := "^${LAYERDIR}/"
BBFILE_PRIORITY_extras = "5"

require conf/distro/include/poky-extras-src-revisions.inc
```

## meta-extras/conf/machine/android-goldfish.conf
```bitbake
#@TYPE: Machine
#@NAME: Android Machine setup
#@DESCRIPTION: Machine configuration for the Android platform

TARGET_ARCH = "arm"
PACKAGE_EXTRA_ARCHS = "armv4 armv4t armv5te"

require conf/machine/include/qemu.inc
require conf/machine/include/tune-arm926ejs.inc

KERNEL_IMAGETYPE = "zImage"

IMAGE_FSTYPES = "tar.bz2 yaffs2"
EXTRA_IMAGECMD_yaffs2 = "0"

SERIAL_CONSOLE = "115200 ttyS0"

PREFERRED_PROVIDER_virtual/kernel = "linux-android-goldfish"
```

## meta-hob/conf/layer.conf
```bitbake
# We have a conf and classes directory, add to BBPATH
BBPATH .= ":${LAYERDIR}"

# We have recipes-* directories, add to BBFILES
BBFILES += "${LAYERDIR}/recipes-*/*/*.bb"

BBFILE_COLLECTIONS += "hob"
BBFILE_PATTERN_hob = "^${LAYERDIR}/"
BBFILE_PRIORITY_hob = "1"

# This should only be incremented on significant changes that will
# cause compatibility issues with other layers
LAYERVERSION_hob = "1"

LAYERDEPENDS_hob = "core"
```

## meta-lsb/conf/layer.conf
```bitbake
# We have a conf and classes directory, add to BBPATH
BBPATH := "${BBPATH}:${LAYERDIR}"

# We have a packages directory, add to BBFILES
BBFILES := "${BBFILES} ${LAYERDIR}/packages/*/*.bb"

BBFILE_COLLECTIONS += "lsb"
BBFILE_PATTERN_lsb := "^${LAYERDIR}/"
BBFILE_PRIORITY_lsb = "5"
```

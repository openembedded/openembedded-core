## meta-openmoko/conf/distro/include/meta-openmoko-scm-revisions.inc
```bitbake
SRCREV_pn-dfu-util-native ??= "3139"
SRCREV_pn-dfu-util ??= "3139"
SRCREV_pn-dialer ??= "42a2b4dd62cf94dc905caeb087f5e7e9f418bf93"
SRCREV_pn-gsm0710muxd ??= "6fecc78198dd821bbe29efd096bd8fecd855179d"
SRCREV_pn-gsmd2 ??= "963f34df8fa3ff4b301079dcf86e9acea6b6fe0f"
SRCREV_pn-libmokogsmd2 ??= "4334"
SRCREV_pn-libmokojournal2 ??= "3473"
SRCREV_pn-libmokopanelui2 ??= "3349"
SRCREV_pn-libmokoui2 ??= "4342"
SRCREV_pn-moko-gtk-engine ??= "3612"
SRCREV_pn-openmoko-alsa-scenarios ??= "4406"
SRCREV_pn-openmoko-appearance ??= "3262"
SRCREV_pn-openmoko-appmanager2 ??= "3442"
SRCREV_pn-openmoko-browser2 ??= "4172"
SRCREV_pn-openmoko-calculator2 ??= "3655"
SRCREV_pn-openmoko-common2 ??= "3259"
SRCREV_pn-openmoko-contacts2 ??= "418"
SRCREV_pn-openmoko-dates2 ??= "673"
SRCREV_pn-openmoko-dialer2 ??= "4448"
SRCREV_pn-openmoko-panel-gsm ??= "4335"
SRCREV_pn-openmoko-dialer3 ??= "111"
SRCREV_pn-openmoko-feedreader2 ??= "3645"
SRCREV_pn-openmoko-firststart2 ??= "3158"
SRCREV_pn-openmoko-icon-theme-standard2 ??= "4232"
SRCREV_pn-openmoko-mediaplayer2 ??= "4173"
SRCREV_pn-openmoko-messages2 ??= "4340"
SRCREV_pn-openmoko-sample2 ??= "3537"
SRCREV_pn-openmoko-sound-theme-standard2 ??= "4271"
SRCREV_pn-openmoko-tasks2 ??= "403"
SRCREV_pn-openmoko-terminal2 ??= "4039"
SRCREV_pn-openmoko-theme-standard2 ??= "4338"
SRCREV_pn-openmoko-today2-folders ??= "3704"
SRCREV_pn-openmoko-today2 ??= "4168"
SRCREV_pn-openmoko-worldclock2 ??= "3365"
SRCREV_pn-usbpath-native ??= "3172"
SRCREV_pn-usbpath ??= "3172"
```

## meta-rt/conf/layer.conf
```bitbake
# Default to first disk/first partition
RSP_ROOT ?= "sda1"

# We have a conf and classes directory, add to BBPATH
BBPATH := "${BBPATH}:${LAYERDIR}"

# We have an images and various recipe-* directories, add to BBFILES
BBFILES := "${BBFILES} ${LAYERDIR}/images/*.bb ${LAYERDIR}/images/*.bbappend \
            ${LAYERDIR}/recipes-*/*/*.bb ${LAYERDIR}/recipes-*/*/*.bbappend"

BBFILE_COLLECTIONS += "rt"
BBFILE_PATTERN_rt := "^${LAYERDIR}/"
BBFILE_PRIORITY_rt = "8"

# This layer builds images using a PREEMPT_RT kernel. Override any machine
# specified kernel providers and leave it up to the kernel recipe to 
# determine COMPATIBLE_MACHINE.
PREFERRED_PROVIDER_virtual/kernel = "linux-yocto-rt"
```

## meta-yocto/conf/distro/poky-tiny.conf
```bitbake
# Distribution definition for: poky-tiny
#
# Copyright (c) 2011, Intel Corporation.
# All rights reserved.
#
# Poky-tiny is intended to define a tiny Linux system comprised of a
# Linux kernel tailored to support each specific MACHINE and busybox.
# Poky-tiny sets some basic policy to ensure a usable system while still
# keeping the rootfs and kernel image as small as possible.
#
# The policies defined are intended to meet the following goals:
# o Serial consoles only (no framebuffer or VGA console)
# o Basic support for IPV4 networking
# o Single user ash shell
# o Static images (no support for adding packages or libraries later)
# o Read-only or RAMFS root filesystem
# o Combined Linux kernel + rootfs in under 4MB
# o Allow the user to select between eglibc or uclibc with the TCLIBC variable
#
# This is currently a partial definition, the following tasks remain:
# [ ] Integrate linux-yocto-tiny ktype into linux-yocto
# [ ] Define linux-yocto-tiny configs for all supported BSPs
# [ ] Drop ldconfig from the installation
# [ ] Modify the runqemu scripts to work with ext2 parameter:
#     runqemu qemux86 qemuparams="-nographic" bootparams="console=ttyS0,115200 root=0800" 
# [ ] Modify busybox to allow for DISTRO_FEATURES-like confiruration

require conf/distro/poky.conf
DISTRO = "poky-tiny"

# FIXME: consider adding a new "tiny" feature
#DISTRO_FEATURES_append = " tiny"

# Distro config is evaluated after the machine config, so we have to explicitly
# set the kernel provider to override a machine config.
PREFERRED_PROVIDER_virtual/kernel = "linux-yocto-tiny"
PREFERRED_VERSION_linux-yocto-tiny = "3.0%"

# We can use task-core-boot, but in the future we may need a new task-core-tiny
#POKY_DEFAULT_EXTRA_RDEPENDS += "task-core-boot"
# Drop kernel-module-af-packet from RRECOMMENDS
POKY_DEFAULT_EXTRA_RRECOMMENDS = ""

# FIXME: what should we do with this?
TCLIBCAPPEND = ""

# Disable wide char support for ncurses as we don't include it in
# in the LIBC features below.
ENABLE_WIDEC="false"

# Reconfigure eglibc for a smaller installation
# Comment out any of the lines below to disable them in the build
DISTRO_FEATURES_LIBC_TINY = "libc-libm libc-crypt"
# Required for "who"
DISTRO_FEATURES_LIBC_MINIMAL = "libc-utmp libc-getlogin"
DISTRO_FEATURES_LIBC_REGEX = "libc-posix-regexp"
DISTRO_FEATURES_LIBC_NET = "libc-inet libc-nis"

DISTRO_FEATURES_LIBC = "${DISTRO_FEATURES_LIBC_TINY} \
                        ${DISTRO_FEATURES_LIBC_MINIMAL} \
                        ${DISTRO_FEATURES_LIBC_REGEX} \
                        ${DISTRO_FEATURES_LIBC_NET} \
                       "

# Comment out any of the lines below to disable them in the build
# DISTRO_FEATURES options:
# alsa bluetooth ext2 irda pcmcia usbgadget usbhost wifi nfs zeroconf pci
DISTRO_FEATURES_TINY = "pci"
DISTRO_FEATURES_NET = "ipv4"
DISTRO_FEATURES_USB = "usbhost"
#DISTRO_FEATURES_USBGADGET = "usbgadget"
#DISTRO_FEATURES_WIFI = "wifi"

DISTRO_FEATURES = "${DISTRO_FEATURES_TINY} \
                   ${DISTRO_FEATURES_NET} \
                   ${DISTRO_FEATURES_USB} \
                   ${DISTRO_FEATURES_USBGADGET} \
                   ${DISTRO_FEATURES_WIFI} \
                   ${DISTRO_FEATURES_LIBC} \
                  "

# Use tmpdevfs and the busybox runtime services
VIRTUAL-RUNTIME_dev_manager = ""
VIRTUAL-RUNTIME_login_manager = ""
VIRTUAL-RUNTIME_init_manager = ""
VIRTUAL-RUNTIME_keymaps = ""

# FIXME: Consider adding "modules" to MACHINE_FEATURES and using that in
# task-core-base to select modutils-initscripts or not.  Similar with "net" and
# netbase.

# By default we only support ext2 and initramfs. We don't build live as that
# pulls in a lot of dependencies for the live image and the installer, like
# udev, grub, etc.  These pull in gettext, which fails to build with wide
# character support.
IMAGE_FSTYPES = "ext2 cpio.gz"

# Drop v86d from qemu dependency list (we support serial)
# Drop grub from meta-intel BSPs
# FIXME: A different mechanism is needed here. We could define -tiny
#        variants of all compatible machines, but that leads to a lot
#        more machine configs to maintain long term.
MACHINE_ESSENTIAL_EXTRA_RDEPENDS = ""
```

## meta/conf/bblayers.conf.sample
```bitbake
# LAYER_CONF_VERSION is increased each time build/conf/bblayers.conf
# changes incompatibly
LCONF_VERSION = "5"

BBPATH = "${TOPDIR}"
BBFILES ?= ""

BBLAYERS ?= " \
  ##OEROOT##/meta \
  "

BBLAYERS_NON_REMOVABLE ?= " \
  ##OEROOT##/meta \
  "
```

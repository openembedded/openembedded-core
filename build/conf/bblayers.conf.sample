## meta-moblin/conf/distro/include/meta-moblin-scm-revisions.inc
```bitbake
SRCREV_pn-anerley ??= "20c6ceffda21595d8894293700006fe3a4cb33ba"
SRCREV_pn-bickley ??= "3cbd5ef693c117ad5c094ddd1678a1a04d0feae3"
SRCREV_pn-bisho ??= "53cc5951be36cee818bef3beb5770f10aabdc7f1"
SRCREV_pn-bognor-regis ??= "c52c7f7013b4b62d7c59d25fc809ce951a5556af"
SRCREV_pn-carrick ??= "9bd8f987b27d95694b1e63efe198b2dffbd4c5b0"
SRCREV_pn-clutter-imcontext ??= "2cb6f0ff153db639a489e58e36802e0e928b1968"
SRCREV_pn-dalston ??= "b4d03283cb8aa2b76014eeb20e78cd13c14012ae"
SRCREV_pn-gnet = "495"
SRCREV_pn-hornsey ??= "39cb0cd0ee3526cba27aeebcc3e28dee6add136a"
SRCREV_pn-json-glib ??= "7411cadc0fdd9ffc2bd7004c9980913ac857a495"
SRCREV_pn-libccss ??= "62697eb84fe190f9b8c65fcbaae10ec3d9edfffd"
SRCREV_pn-libjana ??= "9ec1da8a534e87a83a6d729b48a41ca7b9cfb7b7"
SRCREV_pn-librest ??= "fe5048c92199afc9a7e9aef0add7f0e2b004bb47"
SRCREV_pn-libsocialweb ??= "da8d57ea8dcd348d956715000ded39aa26c7f0f5"
SRCREV_pn-libsynthesis ??= "70f0065aa3b085bdf059830f95e5b5766eecb0bb"
SRCREV_pn-mobile-broadband-provider-info ?= "35ef359c591cccd99380225fa431855b16a12edc"
SRCREV_pn-moblin-app-installer ??= "bc65c884d3a1ae37e69431417888126b2a3ea021"
SRCREV_pn-moblin-gtk-engine ??= "dff58e5f1b6c111a6c06e2385624e40d687ebf4f"
SRCREV_pn-moblin-icon-theme ??= "36b7ac1e57ea6d95e6432779c4769c14fce24899"
SRCREV_pn-moblin-menus ??= "1edfdab8234ec0b4bbc83fb706a15e08aa8a957a"
SRCREV_pn-moblin-proto ??= "8f2cb524fe06555182c25b4ba3202d7b368ac0ce"
SRCREV_pn-moblin-user-skel ??= "356851e174085b874adb909e664aca321a047bcb"
SRCREV_pn-moblin-panel-applications ??= "ba6b5f353203bb02728addb08da3d249f26eedbe"
SRCREV_pn-moblin-panel-media ??= "4e93c6da0bbae8d1d0a5d3b1410761679aa7b83b"
SRCREV_pn-moblin-panel-myzone ??= "54d9bee3a40a7700a69582a76aba89e213410046"
SRCREV_pn-moblin-panel-pasteboard ??= "44411a4516e6ae22767662430fa37ed6a7d27a15"
SRCREV_pn-moblin-panel-people ??= "0766282d120587919718b3bcb91553af1a1a00da"
SRCREV_pn-moblin-panel-status ??= "fb10eaf16bbd064c12587ec8c734abe72a9841d3"
SRCREV_pn-moblin-web-browser ??= "78ddd155cc297811720e4c4835d468ac6c4d9666"
SRCREV_pn-mojito ??= "cfad50252a4ad60f28b12d21e2fdb35db56984f5"
SRCREV_pn-mutter-moblin ??= "7a23e0d63cc31c12dab9de517de04b0ecf41b28a"
SRCREV_pn-mx ??= "94934b5d03a31ce76c4f9eea8dcfb1d94b396906"
SRCREV_pn-nbtk ??= "635f9b4f1a2897aaa85ec1285e57dc5478517c2f"
SRCREV_pn-syncevolution ??= "29972357bf6582c318258b7bdf1feb13c0fef824"
SRCREV_pn-twitter-glib ??= "62b262bf7892b629f7de67498d58f549ffeb704e"
```

## meta-moblin/conf/distro/include/moblin-2.0-fixed-revisions.inc
```bitbake
#
# Known good source dates/revisions/tags to use, *only* for where Moblin deviates
# from Poky (or to lock down SCM based packages):
#
PREFERRED_VERSION_eds-dbus ?= "2.20.0"
PREFERRED_VERSION_dbus ?= "1.2.14"
PREFERRED_VERSION_dbus-native ?= "1.2.14"
PREFERRED_VERSION_gtk+ ?= "2.16.4"
PREFERRED_VERSION_udev ?= "145"

PREFERRED_VERSION_mesa-dri ?= "7.5"
PREFERRED_VERSION_xf86-video-intel ?= "2.12.0"
PREFERRED_VERSION_xserver-xf86-dri-lite ?= "1.6.0"
PREFERRED_VERSION_libxcb ?= "1.3"
PREFERRED_VERSION_xcb-proto ?= "1.5"
PREFERRED_VERSION_libx11-trim ?= "1.2.1"

PREFERRED_VERSION_libdrm ?= ""
PREFERRED_VERSION_xf86-input-keyboard ?= ""
PREFERRED_VERSION_dri2proto ?= ""
SRCREV_pn-libdrm ?= "3f3c5be6f908272199ccf53f108b1124bfe0a00e"
SRCREV_pn-xf86-input-keyboard ?= "3e28d68b50d291938734e9684b8296ca864f3892"
SRCREV_pn-dri2proto ?= "66c56ab10d917e3f47f93178d7eac6430970d3c4"

SRCREV_pn-anerley ?= "0cb9ac6b82ff6658ae10d603bdfba04ef3df979e"
SRCREV_pn-bickley ?= "761816f24e2aeb329d4f7270a2af324f85b7be8f"
SRCREV_pn-bisho ?= "53cc5951be36cee818bef3beb5770f10aabdc7f1"
SRCREV_pn-bognor-regis ?= "6b6cce0cb90ea47a3cc4ac2804c8b5664530ca80"
SRCREV_pn-carrick ?= "0451a081309f11dd5e9b6e41778ab878d862cbd0"


SRCREV_pn-connman ?= "6af0b24817b8712c755ef24ed0ee4c5e84550657"
SRCREV_pn-connman-gnome ?= "857b149c7febe9b0ffd9790050a288f018644eda"
SRCREV_pn-contacts ?= "c8e6b16222d5bc9d8f60ae6594af4933613a4e25"


# Still tosort:

SRCREV_pn-clutter ?= "e860d939f9d9611dcf5b8c6e70272b6318a4ba94"
1.0.0
SRCREV_pn-clutter-1.0 ?= "420ed353b53bd624331bd249d7df98d14714b504"
1.0.0
SRCREV_pn-clutter-box2d ?= "2bcf5b836548dc4909e13b8ae7f60dc64c93d559"
clutter-box2d-0.9~20090609
SRCREV_pn-clutter-gst ?= "db9bcf9d6f3a7d0f34747bed0f3ab28d7eb8f6ab"
gst-0.10~20090729
SRCREV_pn-clutter-gtk ?= "5dfc07761adf3ab3d1c9ee97b92bc4a65473db36"
0.10.2
SRCREV_pn-clutter-imcontext ?= "2cb6f0ff153db639a489e58e36802e0e928b1968"
0.1
SRCREV_pn-clutter-mozembed ?= "5a5329425aec7fe7749e97fd8c430457259f6165"
0.0~20090731


SRCREV_pn-dalston ?= "b4d03283cb8aa2b76014eeb20e78cd13c14012ae"
SRCREV_pn-dates ?= "966969063535da0786b7483c1bcd427df8a0d87d"
SRCREV_pn-gconnman ?= "3d951640146d08249e0219cbae6a4c2da787a878"
SRCREV_pn-hornsey ?= "39cb0cd0ee3526cba27aeebcc3e28dee6add136a"
SRCREV_pn-json-glib ?= "7411cadc0fdd9ffc2bd7004c9980913ac857a495"
SRCREV_pn-libccss ?= "62697eb84fe190f9b8c65fcbaae10ec3d9edfffd"
SRCREV_pn-librest ?= "ff4561e2a8c38f49127f6e3b2ce7c238a29e1571"
SRCREV_pn-libsynthesis ?= "70f0065aa3b085bdf059830f95e5b5766eecb0bb"
SRCREV_pn-moblin-gtk-engine ?= "dff58e5f1b6c111a6c06e2385624e40d687ebf4f"
SRCREV_pn-moblin-icon-theme ?= "36b7ac1e57ea6d95e6432779c4769c14fce24899"
SRCREV_pn-moblin-menus ?= "1edfdab8234ec0b4bbc83fb706a15e08aa8a957a"
SRCREV_pn-moblin-proto ?= "8f2cb524fe06555182c25b4ba3202d7b368ac0ce"
SRCREV_pn-moblin-user-skel ?= "356851e174085b874adb909e664aca321a047bcb"
SRCREV_pn-moblin-panel-applications ?= "ba6b5f353203bb02728addb08da3d249f26eedbe"
SRCREV_pn-moblin-panel-media ?= "4e93c6da0bbae8d1d0a5d3b1410761679aa7b83b"
SRCREV_pn-moblin-panel-myzone ?= "54d9bee3a40a7700a69582a76aba89e213410046"
SRCREV_pn-moblin-panel-pasteboard ?= "44411a4516e6ae22767662430fa37ed6a7d27a15"
SRCREV_pn-moblin-panel-people ?= "0766282d120587919718b3bcb91553af1a1a00da"
SRCREV_pn-moblin-panel-status ?= "fb10eaf16bbd064c12587ec8c734abe72a9841d3"
SRCREV_pn-moblin-web-browser ?= "a3ea71159bef93dc03762195bd5404a51db5e4a6"
SRCREV_pn-mojito ?= "cfad50252a4ad60f28b12d21e2fdb35db56984f5"
SRCREV_pn-mozilla-headless-services ?= "9091da493c679c546ec7312b653e63f9701d5c8f"
SRCREV_pn-mutter ?= "c96345dd81176f171c2d15dd9d5c5b20f334f842"
SRCREV_pn-mutter-moblin ?= "7a23e0d63cc31c12dab9de517de04b0ecf41b28a"
SRCREV_pn-mux ?= "72460e890dbb15edbf7dc193116be0dcf9794a8b"
SRCREV_pn-nbtk ?= "635f9b4f1a2897aaa85ec1285e57dc5478517c2f"
SRCREV_pn-mtpfs = "17"
SRCREV_pn-qemugl ?= "d888bbc723c00d197d34a39b5b7448660ec1b1c0"
SRCREV_pn-syncevolution ?= "29972357bf6582c318258b7bdf1feb13c0fef824"
SRCREV_pn-tasks ?= "a3c6109973c2f39190f554b49dacda7ec5231ef4"
SRCREV_pn-twitter-glib ?= "9dfca7cf38e3dddbda6dc82d0164f65814b8783e"

SRCREVMOZILLAHEADLESS ?= "1a622cb7c384"
```

## meta-moblin/conf/distro/include/moblin-fixed-revisions.inc
```bitbake
#
# Known good source dates/revisions/tags to use, *only* for where Moblin deviates
# from Poky (or to lock down SCM based packages):
#
PREFERRED_VERSION_eds-dbus ?= "2.20.0"
PREFERRED_VERSION_dbus ?= "1.2.14"
PREFERRED_VERSION_dbus-native ?= "1.2.14"
PREFERRED_VERSION_gtk+ ?= "2.18.5"
PREFERRED_VERSION_pango = "1.26.0"
PREFERRED_VERSION_udev ?= "145"

PREFERRED_VERSION_mesa-dri ?= "7.8.2"
PREFERRED_VERSION_xf86-video-intel ?= "2.12.0"
PREFERRED_VERSION_xserver-xf86-dri-lite ?= "1.7.99.2"
PREFERRED_VERSION_libxcb ?= "1.3"
PREFERRED_VERSION_xcb-proto ?= "1.5"
PREFERRED_VERSION_libx11-trim ?= "1.3"

PREFERRED_VERSION_libdrm ?= "2.4.17"
PREFERRED_VERSION_xf86-input-keyboard ?= ""
PREFERRED_VERSION_dri2proto ?= ""


PREFERRED_VERSION_anerley ?= "0.1.7"
PREFERRED_VERSION_bickley ?= "0.4"
PREFERRED_VERSION_bisho ?= "0.17.1"
PREFERRED_VERSION_bognor-regis ?= "0.5.0"
PREFERRED_VERSION_carrick ?= "1.1.13"
PREFERRED_VERSION_dalston ?= "0.1.12"
PREFERRED_VERSION_gupnp-av ?= "0.4"
PREFERRED_VERSION_hornsey ?= "1.0"
PREFERRED_VERSION_mojito ?= "0.21.7"
PREFERRED_VERSION_nbtk ?= "1.2.3"
PREFERRED_VERSION_moblin-panel-applications ?= "0.1.2"
PREFERRED_VERSION_moblin-panel-media ?= "0.0.7"
PREFERRED_VERSION_moblin-panel-myzone ?= "0.0.12"
PREFERRED_VERSION_moblin-panel-pasteboard ?= "0.0.2"
PREFERRED_VERSION_moblin-panel-people ?= "0.0.9"
PREFERRED_VERSION_moblin-panel-status ?= "0.0.9"
PREFERRED_VERSION_mutter ?= "2.28.1"
PREFERRED_VERSION_mutter-moblin ?= "0.43.8"
```

## meta-moblin/conf/distro/include/moblin-floating-revisions.inc
```bitbake
SRCREV_pn-libccss ?= "62697eb84fe190f9b8c65fcbaae10ec3d9edfffd"
SRCREV_pn-clutter-gtk ?= "5dfc07761adf3ab3d1c9ee97b92bc4a65473db36"
SRCREV_pn-clutter-gst ?= "24c84abf0cdd24b6f4696c5a920673a55218cfd4"
SRCREV_pn-bisho ?= "7b97cf8a9e2ef228be71e549e622df5d59869b39"

SRCREV_pn-ashford ?= "${AUTOREV}"
SRCREV_pn-anerley ?= "${AUTOREV}"
PREFERRED_VERSION_anerley ?= "0.1.7+git%"
SRCREV_pn-bickley ?= "${AUTOREV}"
PREFERRED_VERSION_bickley ?= "0.4+git%"
SRCREV_pn-bisho ?= "${AUTOREV}"
PREFERRED_VERSION_bisho ?= "0.17.1+git%"
SRCREV_pn-bognor-regis ?= "${AUTOREV}"
PREFERRED_VERSION_bognor-regis ?= "0.5.0+git%"
SRCREV_pn-carrick ?= "${AUTOREV}"
PREFERRED_VERSION_carrick ?= "1.2.0+git%"
SRCREV_pn-clutter ?= "${AUTOREV}"
SRCREV_pn-clutter-1.0 ?= "${AUTOREV}"
SRCREV_pn-clutter-gtk ?= "${AUTOREV}"
SRCREV_pn-clutter-gst ?= "${AUTOREV}"
SRCREV_pn-clutter-imcontext ?= "${AUTOREV}"
SRCREV_pn-clutter-mozembed ?= "${AUTOREV}"
SRCREV_pn-connman ?= "${AUTOREV}"
SRCREV_pn-connman-gnome ?= "${AUTOREV}"
SRCREV_pn-contacts ?= "${AUTOREV}"
SRCREV_pn-dalston ?= "${AUTOREV}"
PREFERRED_VERSION_dalston ?= "0.1.12+git%"
SRCREV_pn-dates ?= "${AUTOREV}"
SRCREV_pn-gconnman ?= "${AUTOREV}"
PREFERRED_VERSION_gupnp-av ?= "0.5.2"
SRCREV_pn-hornsey ?= "${AUTOREV}"
PREFERRED_VERSION_hornsey ?= "1.0+git%"
SRCREV_pn-json-glib ?= "${AUTOREV}"
SRCREV_pn-libccss ?= "${AUTOREV}"
SRCREV_pn-librest ?= "${AUTOREV}"
SRCREV_pn-libsocialweb ?= "${AUTOREV}"
PREFERRED_VERSION_libsocialweb ?= "0.0+git%"
SRCREV_pn-libsynthesis ?= "${AUTOREV}"
SRCREV_pn-linux-moblin ?= "${AUTOREV}"
SRCREV_pn-mobile-broadband-provider-info ?= "${AUTOREV}"
SRCREV_pn-moblin-app-installer ?= "${AUTOREV}"
SRCREV_pn-moblin-gtk-engine ?= "${AUTOREV}"
SRCREV_pn-moblin-menus ?= "${AUTOREV}"
SRCREV_pn-moblin-web-browser ?= "${AUTOREV}"
SRCREV_pn-moblin-icon-theme ?= "${AUTOREV}"
SRCREV_pn-moblin-user-skel ?= "${AUTOREV}"
SRCREV_pn-moblin-panel-applications ?= "${AUTOREV}"
PREFERRED_VERSION_moblin-panel-applications ?= "0.1.2+git%"
SRCREV_pn-moblin-panel-media ?= "${AUTOREV}"
PREFERRED_VERSION_moblin-panel-media ?= "0.0.7+git%"
SRCREV_pn-moblin-panel-myzone ?= "${AUTOREV}"
PREFERRED_VERSION_moblin-panel-myzone ?= "0.0.12+git%"
SRCREV_pn-moblin-panel-pasteboard ?= "${AUTOREV}"
PREFERRED_VERSION_moblin-panel-pasteboard ?= "0.0.2+git%"
SRCREV_pn-moblin-panel-people ?= "${AUTOREV}"
PREFERRED_VERSION_moblin-panel-people ?= "0.0.9+git%"
SRCREV_pn-moblin-panel-status ?= "${AUTOREV}"
PREFERRED_VERSION_moblin-panel-status ?= "0.0.9+git%"
SRCREV_pn-mojito ?= "${AUTOREV}"
PREFERRED_VERSION_mojito ?= "0.21.7+git%"
SRCREV_pn-mozilla-headless ?= "${AUTOREV}"
SRCREV_pn-mozilla-headless-services ?= "${AUTOREV}"
SRCREV_pn-mutter ?= "${AUTOREV}"
PREFERRED_VERSION_mutter ?= "2.28.1+git%"
SRCREV_pn-mutter-moblin ?= "${AUTOREV}"
PREFERRED_VERSION_mutter-moblin ?= "0.43.8+git%"
SRCREV_pn-mux ?= "${AUTOREV}"
SRCREV_pn-nbtk ?= "${AUTOREV}"
PREFERRED_VERSION_nbtk ?= "1.2.3+git%"
SRCREV_pn-mx ?= "${AUTOREV}"
SRCREV_pn-qemugl ?= "${AUTOREV}"
SRCREV_pn-sample-media ?= "${AUTOREV}"
SRCREV_pn-syncevolution ?= "${AUTOREV}"
SRCREV_pn-tasks ?= "${AUTOREV}"
SRCREV_pn-twitter-glib ?= "${AUTOREV}"
SRCREV_pn-xf86-video-gma500 ?= "${AUTOREV}"

SRCREV_pn-libdrm ?= "${AUTOREV}"
PREFERRED_VERSION_libdrm ?= "2.4.15+git%"
SRCREV_pn-mesa-dri ?= "${AUTOREV}"
PREFERRED_VERSION_mesa-dri ?= "7.5+git%"
SRCREV_pn-xf86-video-intel ?= "${AUTOREV}"
PREFERRED_VERSION_xf86-video-intel ?= "2.10.0+git%"
SRCREV_pn-xserver-xf86-dri-lite ?= "${AUTOREV}"
PREFERRED_VERSION_xserver-xf86-dri-lite ?= "1.6.0+git%"
SRCREV_pn-xf86-input-keyboard ?= "${AUTOREV}"
PREFERRED_VERSION_xf86-input-keyboard ?= "1.3.2+git%"
SRCREV_pn-dri2proto ?= "${AUTOREV}"
PREFERRED_VERSION_dri2proto ?= "1.99.3+git%"
SRCREV_pn-libx11-trim ?= "${AUTOREV}"
PREFERRED_VERSION_libx11-trim ?= "1.2.1+git%"

PREFERRED_VERSION_libxcb ?= "1.3"
PREFERRED_VERSION_xcb-proto ?= "1.5"
```

## meta-moblin/conf/distro/include/poky-moblin.inc
```bitbake
TARGET_VENDOR = "-poky"

PREFERRED_PROVIDER_virtual/${TARGET_PREFIX}libc-for-gcc = "glibc"
PREFERRED_PROVIDER_virtual/${TARGET_PREFIX}binutils = "binutils-cross"
PREFERRED_PROVIDER_virtual/${TARGET_PREFIX}gcc-initial = "gcc-cross-initial"
PREFERRED_PROVIDER_virtual/${TARGET_PREFIX}gcc-intermediate = "gcc-cross-intermediate"
PREFERRED_PROVIDER_virtual/${TARGET_PREFIX}gcc = "gcc-cross"
PREFERRED_PROVIDER_virtual/${TARGET_PREFIX}g++ = "gcc-cross"

GCCVERSION ?= "4.3.3"
BINUVERSION = "2.20"

PREFERRED_VERSION_gcc ?= "${GCCVERSION}"
PREFERRED_VERSION_gcc-cross ?= "${GCCVERSION}"
PREFERRED_VERSION_gcc-cross-initial ?= "${GCCVERSION}"
PREFERRED_VERSION_gcc-cross-intermediate ?= "${GCCVERSION}"
PREFERRED_VERSION_gcc-cross-sdk ?= "4.3.1"
PREFERRED_VERSION_binutils ?= "${BINUVERSION}"
PREFERRED_VERSION_binutils-cross ?= "${BINUVERSION}"
PREFERRED_VERSION_linux-libc-headers ?= "2.6.30"
PREFERRED_VERSION_glibc ?= "2.9"
PREFERRED_VERSION_glibc-initial ?= "2.9"
PREFERRED_VERSION_elfutils ?= "0.131"

require conf/distro/include/as-needed.inc
```

## meta-moblin/conf/distro/moblin-bleeding.conf
```bitbake
require conf/distro/include/moblin-floating-revisions.inc
require conf/distro/moblin.conf
```

## meta-moblin/conf/distro/moblin.conf
```bitbake
require conf/distro/poky.conf

DISTRO = "moblin"
DISTRO_NAME = "Moblin (Poky Powered)"
DISTRO_VERSION = "1.99+snapshot-${DATE}"

require conf/distro/include/moblin-fixed-revisions.inc

POKY_EXTRA_RDEPENDS = "task-moblin-boot"

TOOLCHAIN_TARGET_SDKTASK ?= "task-moblin-standalone-sdk-target"
#No debug info for now " task-moblin-standalone-sdk-target-dbg"
```

## meta-moblin/conf/layer.conf
```bitbake
# We have a conf and classes directory, add to BBPATH
BBPATH := "${BBPATH}${LAYERDIR}"

# We have a packages directory, add to BBFILES
BBFILES := "${BBFILES} ${LAYERDIR}/packages/*/*.bb"

BBFILE_COLLECTIONS += "moblin"
BBFILE_PATTERN_moblin := "^${OEROOT}/meta-moblin/"
BBFILE_PRIORITY_moblin = "5"
```

## meta-moblin/conf/machine/menlow.conf
```bitbake
#@TYPE: Machine
#@NAME: Netbook

#@DESCRIPTION: Machine configuration for Menlow platforms. Currently supported machines are the Compal JAX10

TARGET_ARCH = "i586"
PACKAGE_EXTRA_ARCHS = "x86 core2"

include conf/machine/include/tune-atom.inc

MACHINE_FEATURES = "kernel26 screen keyboard pci usbhost ext2 ext3 x86 wifi \
                    acpi"

KERNEL_IMAGETYPE = "bzImage"

PREFERRED_PROVIDER_virtual/kernel ?= "linux-moblin"
PREFERRED_PROVIDER_virtual/libx11 ?= "libx11-trim"
PREFERRED_PROVIDER_virtual/libgl  ?= "mesa-dri"
PREFERRED_PROVIDER_virtual/xserver ?= "xserver-xf86-dri-lite"
PREFERRED_PROVIDER_virtual/xserver-xf86 ?= "xserver-xf86-dri-lite"
XSERVER ?= "xserver-xf86-dri-lite \
           xf86-video-psb \
           xf86-input-mouse \
           xf86-input-keyboard \
           xf86-input-evdev"

#MACHINE_EXTRA_RDEPENDS = "rt2860"

MACHINE_EXTRA_RRECOMMENDS = "kernel-modules eee-acpi-scripts"

GUI_MACHINE_CLASS = "bigscreen"

IMAGE_ROOTFS_SIZE_ext3 = "500000"

IMAGE_FSTYPES ?= "ext3 jffs2 cpio.gz"

APPEND += "video=intelfb:mode=800x600,accel=0,hwcursor=0 vga=788 usbcore.autosuspend=1"

GLIBC_ADDONS = "nptl"
GLIBC_EXTRA_OECONF = "--with-tls"

EXTRA_OECONF_append_pn-matchbox-panel-2 = " --with-battery=acpi"
```

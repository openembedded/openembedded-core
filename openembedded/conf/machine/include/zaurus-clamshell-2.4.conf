## openembedded/conf/machine/zaurus-clamshell-2.6.conf
```bitbake
# Zaurus Clamshell specific configuration for kernel 2.6
# Don't forget to include zaurus-clamshell.conf as well

PREFERRED_PROVIDER_virtual/kernel = "linux-openzaurus"

BOOTSTRAP_EXTRA_DEPENDS  += "virtual/kernel udev sysfsutils hostap-modules spectrum-fw \
pcmcia-cs apmd wireless-tools console-tools irda-utils lrzsz hostap-utils prism3-firmware prism3-support \
ppp ppp-dialin openswan wpa-supplicant-nossl"

BOOTSTRAP_EXTRA_RDEPENDS += "kernel udev sysfsutils hostap-modules-cs spectrum-fw \
pcmcia-cs apm  wireless-tools irda-utils udev-utils console-tools hostap-utils prism3-firmware prism3-support \
ppp ppp-dialin openswan wpa-supplicant-nossl"

# Ethernet modules
BOOTSTRAP_EXTRA_RDEPENDS += "kernel-module-pcnet-cs"
# NFS Modules
BOOTSTRAP_EXTRA_RDEPENDS += "kernel-module-nfs kernel-module-lockd kernel-module-sunrpc"
# Crypto Modules
BOOTSTRAP_EXTRA_RDEPENDS += "kernel-module-des kernel-module-md5"
# SMB and CRAMFS
BOOTSTRAP_EXTRA_RDEPENDS += "kernel-module-smbfs kernel-module-cramfs"
# Serial Modules
BOOTSTRAP_EXTRA_RDEPENDS += "kernel-module-8250 kernel-module-serial-cs"
# Bluetooth Modules
BOOTSTRAP_EXTRA_RDEPENDS += "kernel-module-bluetooth kernel-module-l2cap kernel-module-rfcomm kernel-module-hci-vhci \
                             kernel-module-bnep kernel-module-hidp kernel-module-hci-uart kernel-module-sco \
                             kernel-module-bt3c-cs kernel-module-bluecard-cs kernel-module-btuart-cs kernel-module-dtl1-cs"
# Infrared Modules
BOOTSTRAP_EXTRA_RDEPENDS += "kernel-module-pxaficp-ir kernel-module-irda kernel-module-ircomm \
                             kernel-module-ircomm-tty kernel-module-irlan kernel-module-irnet kernel-module-ir-usb"

# USB Gadget Modules
BOOTSTRAP_EXTRA_RDEPENDS += "kernel-module-gadgetfs kernel-module-g-file-storage \
                             kernel-module-g-serial kernel-module-g-ether"

# Wireless Modules
BOOTSTRAP_EXTRA_RDEPENDS += "kernel-module-orinoco-cs kernel-module-spectrum-cs"
```

## openembedded/packages/wpa-supplicant/wpa-supplicant-ssl/wpa-defconfig
```kconfig
# CONFIG_DRIVER_HOSTAP is not set
CONFIG_DRIVER_WEXT=y
CONFIG_WIRELESS_EXTENSION=y
CONFIG_DRIVER_HOSTAP=y
CONFIG_IEEE8021X_EAPOL=y
CONFIG_EAP_MD5=y
CONFIG_MSCHAPV2=y
CONFIG_EAP_TLS=y
CONFIG_EAP_PEAP=y
CONFIG_EAP_TTLS=y
CONFIG_EAP_GTC=y
CONFIG_EAP_OTP=y
CONFIG_EAP_SIM=y
CONFIG_EAP_LEAP=y
#CONFIG_PCSC=y
```

## scripts/lib/wic/canned-wks/directdisk-bootloader-config.wks
```
# short-description: Create a 'pcbios' direct disk image with custom bootloader config
# long-description: Creates a partitioned legacy BIOS disk image that the user
# can directly dd to boot media. The bootloader configuration source is a user file.


part /boot --source bootimg-pcbios --ondisk sda --label boot --active --align 1024
part / --source rootfs --ondisk sda --fstype=ext4 --label platform --align 1024

bootloader --configfile="directdisk-bootloader-config.cfg"
```

## scripts/lib/wic/canned-wks/mpc8315e-rdb.wks
```
# short-description: Create SD card image with a boot partition
# long-description: Creates a partitioned SD card image. Boot files
# are located in the first partition.

part /boot --source bootimg-partition --ondisk sdb --fstype=ext3 --label boot
part / --source rootfs --ondisk sdb --fstype=ext3 --label root
```

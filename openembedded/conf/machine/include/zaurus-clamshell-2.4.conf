## openembedded/conf/machine/include/zaurus-clamshell-2.4.conf
```bitbake
# Zaurus Clamshell specific configuration for kernel 2.4
# Don't forget to include zaurus-clamshell.conf as well

PREFERRED_PROVIDERS_append_c7x0   = " virtual/kernel:c7x0-kernels-2.4-embedix"
PREFERRED_PROVIDERS_append_akita  = " virtual/kernel:openzaurus-pxa27x"
PREFERRED_PROVIDERS_append_spitz  = " virtual/kernel:openzaurus-pxa27x"
PREFERRED_PROVIDERS_append_borzoi = " virtual/kernel:openzaurus-pxa27x"

# Later versions are broken on kernel 2.4
PREFERRED_VERSION_orinoco-modules = "0.13e"

BOOTSTRAP_EXTRA_RDEPENDS += "kernel hostap-modules-cs orinoco-modules-cs sharp-sdmmc-support \
pcmcia-cs apmd apm wireless-tools console-tools irda-utils hostap-utils prism3-firmware prism3-support \
wpa-supplicant-nossl ppp ppp-dialin openswan"

# Misc Modules
BOOTSTRAP_EXTRA_RDEPENDS += "kernel-module-net-fd kernel-module-registers"

# USB Client Modules
BOOTSTRAP_EXTRA_RDEPENDS += "kernel-module-usbdcore kernel-module-usbdmonitor"

# Bluetooth Modules
BOOTSTRAP_EXTRA_RDEPENDS += "kernel-module-bluez kernel-module-l2cap kernel-module-rfcomm kernel-module-hci-vhci \
                             kernel-module-bnep kernel-module-hidp kernel-module-hci-uart kernel-module-sco \
                             kernel-module-bluecard-cs kernel-module-btuart-cs kernel-module-dtl1-cs \
                             kernel-module-firmware-class kernel-module-bt3c-cs"

# BI Module
BOOTSTRAP_EXTRA_RDEPENDS_append_c7x0   = " kernel-module-pxa-bi"
BOOTSTRAP_EXTRA_RDEPENDS_append_spitz  = " kernel-module-pxa27x-bi"
BOOTSTRAP_EXTRA_RDEPENDS_append_akita  = " kernel-module-pxa27x-bi"
BOOTSTRAP_EXTRA_RDEPENDS_append_borzoi = " kernel-module-pxa27x-bi"

# USB Host Modules
BOOTSTRAP_EXTRA_RDEPENDS_append_spitz  = " kernel-module-usbcore kernel-module-usbmouse kernel-module-usb-monitor \
                                           kernel-module-usbkbd kernel-module-usb-storage kernel-module-hci-usb \
                                           kernel-module-usb-ohci-pxa27x kernel-module-bfusb"
BOOTSTRAP_EXTRA_RDEPENDS_append_akita  = " kernel-module-usbcore kernel-module-usbmouse kernel-module-usb-monitor \
                                           kernel-module-usbkbd kernel-module-usb-storage kernel-module-hci-usb \
                                           kernel-module-usb-ohci-pxa27x kernel-module-bfusb"
BOOTSTRAP_EXTRA_RDEPENDS_append_borzoi = " kernel-module-usbcore kernel-module-usbmouse kernel-module-usb-monitor \
                                           kernel-module-usbkbd kernel-module-usb-storage kernel-module-hci-usb \
                                           kernel-module-usb-ohci-pxa27x kernel-module-bfusb"
```

## openembedded/conf/machine/include/zaurus-clamshell-2.6.conf
```bitbake
# Zaurus Clamshell specific configuration for kernel 2.6
# Don't forget to include zaurus-clamshell.conf as well

PREFERRED_PROVIDER_virtual/kernel = "linux-openzaurus"
PREFERRED_VERSION_wpa_supplicant = "0.4.7"

PCMCIA_MANAGER ?= "pcmciautils"

BOOTSTRAP_EXTRA_RDEPENDS += "kernel udev sysfsutils spectrum-fw \
${PCMCIA_MANAGER} apm  wireless-tools irda-utils udev-utils keymaps hostap-utils prism3-firmware prism3-support \
ppp ppp-dialin openswan wpa-supplicant-nossl alsa-utils-alsactl alsa-utils-alsamixer module-init-tools alsa-conf zaurusd"

# Ethernet modules
BOOTSTRAP_EXTRA_RDEPENDS += "kernel-module-pcnet-cs"
# NFS Modules
BOOTSTRAP_EXTRA_RDEPENDS += "kernel-module-nfs kernel-module-lockd kernel-module-sunrpc"
# Crypto Modules
BOOTSTRAP_EXTRA_RDEPENDS += "kernel-module-des kernel-module-md5"
# SMB and CRAMFS
BOOTSTRAP_EXTRA_RDEPENDS += "kernel-module-smbfs kernel-module-cramfs"
# Serial Modules
BOOTSTRAP_EXTRA_RDEPENDS += "kernel-module-8250 kernel-module-serial-cs"
# Bluetooth Modules
BOOTSTRAP_EXTRA_RDEPENDS += "kernel-module-bluetooth kernel-module-l2cap kernel-module-rfcomm kernel-module-hci-vhci \
                             kernel-module-bnep kernel-module-hidp kernel-module-hci-uart kernel-module-sco \
                             kernel-module-bt3c-cs kernel-module-bluecard-cs kernel-module-btuart-cs kernel-module-dtl1-cs"
# Infrared Modules
BOOTSTRAP_EXTRA_RDEPENDS += "kernel-module-pxaficp-ir kernel-module-irda kernel-module-ircomm \
                             kernel-module-ircomm-tty kernel-module-irlan kernel-module-irnet kernel-module-ir-usb"

# USB Gadget Modules
BOOTSTRAP_EXTRA_RDEPENDS += "kernel-module-gadgetfs kernel-module-g-file-storage \
                             kernel-module-g-serial kernel-module-g-ether"

# Wireless Modules
BOOTSTRAP_EXTRA_RDEPENDS += "kernel-module-hostap kernel-module-hostap-cs \
                             kernel-module-hermes kernel-module-orinoco \
                             kernel-module-orinoco-cs kernel-module-spectrum-cs \
                             hostap-conf orinoco-conf"

# Sound Modules
BOOTSTRAP_EXTRA_RDEPENDS += "kernel-module-snd-mixer-oss kernel-module-snd-pcm-oss"
BOOTSTRAP_EXTRA_SOUND 	  = "kernel-module-soundcore kernel-module-snd kernel-module-snd-page-alloc kernel-module-snd-timer \
                             kernel-module-snd-pcm  \
                             kernel-module-snd-soc-core kernel-module-snd-soc-pxa2xx kernel-module-snd-soc-pxa2xx-i2s"
			     
BOOTSTRAP_EXTRA_RDEPENDS_append_c7x0 += "${BOOTSTRAP_EXTRA_SOUND} kernel-module-snd-soc-corgi kernel-module-snd-soc-wm8731 "
BOOTSTRAP_EXTRA_RDEPENDS_append_akita += "${BOOTSTRAP_EXTRA_SOUND} kernel-module-snd-soc-spitz kernel-module-snd-soc-wm8750 "
BOOTSTRAP_EXTRA_RDEPENDS_append_spitz += "${BOOTSTRAP_EXTRA_SOUND} kernel-module-snd-soc-spitz kernel-module-snd-soc-wm8750 "
```

## openembedded/conf/machine/include/zaurus-clamshell.conf
```bitbake
TARGET_ARCH = "arm"
IPKG_ARCHS = "all arm armv4 armv5te c7x0"

PREFERRED_PROVIDER_xserver = "xserver-kdrive"

EXTRA_IMAGECMD_jffs2 = "--pad --little-endian --eraseblock=0x4000 -n"
EXTRA_IMAGEDEPENDS += "sharp-flash-header-c700 zaurus-updater"

IMAGE_CMD_jffs2 = "mkfs.jffs2 --root=${IMAGE_ROOTFS} --faketime \
		   --output=${T}/${IMAGE_NAME}.rootfs.jffs2 ${EXTRA_IMAGECMD}; \
		   cat ${STAGING_LIBDIR}/sharp-flash-header/header-c700.bin \
		   ${T}/${IMAGE_NAME}.rootfs.jffs2 > ${DEPLOY_DIR_IMAGE}/${IMAGE_NAME}.rootfs.img"

GUI_MACHINE_CLASS = "bigscreen"
GPE_EXTRA_INSTALL += "gaim sylpheed chkhinge"

include conf/machine/include/handheld-common.conf

# Use tune-xscale per default. Machine independent feeds should be built with tune-strongarm.
include conf/machine/include/tune-xscale.conf

SERIAL_CONSOLE = "115200 ttyS0"
```

## openembedded/conf/machine/ipaq-common.conf
```bitbake
IPAQ_MODULES = "apm h3600_generic_sleeve ipaq-sleeve ipaq-mtd-asset nvrd atmelwlandriver sa1100-rtc ipaq-hal h3600_ts usb-eth wavelan_cs keybdev" 

BOOTSTRAP_EXTRA_DEPENDS += "kbdd bl hostap-modules orinoco-modules atmelwlandriver"
BOOTSTRAP_EXTRA_DEPENDS_append_kernel24 += "mipv6"
BOOTSTRAP_EXTRA_RRECOMMENDS += "kbdd bl hostap-modules-cs orinoco-modules-cs atmelwlandriver ${@linux_module_packages('${IPAQ_MODULES}', d)}"
BOOTSTRAP_EXTRA_RRECOMMENDS_append_kernel24 += "mipv6"

PREFERRED_PROVIDER_virtual/xserver = "xserver-kdrive"
```

## openembedded/conf/machine/ipaq-pxa270.conf
```bitbake
#@TYPE: Machine
#@NAME: iPAQ hx47xx hx2xxx
#@DESCRIPTION: Machine configuration for the iPAQ with a pxa27x CPU  devices

TARGET_ARCH = "arm"
IPKG_EXTRA_ARCHS = "armv4 armv5te ipaqpxa hx4700"
#use this for a hx47xx ipaq
PREFERRED_PROVIDER_virtual/kernel = "handhelds-pxa-2.6"

#use this for a hx2xxx ipaq
#PREFERRED_PROVIDER_virtual/kernel = "linux-openzaurus"

PREFERRED_VERSION_orinoco-modules = "0.15rc1"

ROOT_FLASH_SIZE = "80"

EXTRA_IMAGECMD_jffs2 = "; sumtool -i ${DEPLOY_DIR_IMAGE}/${IMAGE_NAME}.rootfs.jffs2 \
			  -o ${DEPLOY_DIR_IMAGE}/${IMAGE_NAME}.rootfs-summary.jffs2 \
			  -e 256KiB -p"

MODUTILS = "26"	
PCMCIA_MANAGER = "pcmciautils"
BOOTSTRAP_EXTRA_RDEPENDS = "kernel ipaq-boot-params "
BOOTSTRAP_EXTRA_RRECOMMENDS += "${@linux_module_packages('${PXA270_MODULES}', d)}" 
BOOTSTRAP_EXTRA_RDEPENDS_append = " udev module-init-tools"

PXA270_MODULES = "g_ether g_file_storage g_serial gadgetfs pxa27x_udc \
		  snd_pcm_oss snd_mixer_oss evdev mmc_block pcmcia hidp \
		  nls_cp437 nls_iso8859-1 nls_utf8 af_key"

SERIAL_CONSOLE = "115200 ttyS0"

include conf/machine/include/handheld-common.conf

GUI_MACHINE_CLASS = "bigscreen"

# Use tune-xscale per default. Machine independent feeds should be built with tune-strongarm.
include conf/machine/include/tune-xscale.conf

# Uncomment this to use iwmmxt optimizations. Remove the above xscale stuff first
#include conf/machine/include/tune-iwmmxt.conf

BOOTSTRAP_EXTRA_RRECOMMENDS += "${@linux_module_packages('${HX4700_MODULES}', d)}"
HX4700_MODULES = "i2c-pxa asic3_mmc hx4700_bt hx4700_leds hx4700_navpt hx4700_pcmcia \
                  hx4700_ts hx4700_wlan snd_hx4700_audio hx4700_power"


module_autoload_evdev = "evdev"
module_autoload_hx4700_power = "hx4700_power"
module_autoload_pcmcia = "pcmcia"
module_autoload_hx4700_pcmcia = "hx4700_pcmcia"
module_autoload_asic3_mmc = "asic3_mmc"
module_autoload_mmc_block = "mmc_block"
module_autoload_hx4700_ts = "hx4700_ts"
module_autoload_hx4700_navpt = "hx4700_navpt"
module_autoload_hx4700_bt = "hx4700_bt"
module_autoload_snd-hx4700_audio = "snd-hx4700_audio"
module_autoload_snd-pcm-oss = "snd-pcm-oss"
module_autoload_snd-mixer-oss = "snd-mixer-oss"
module_autoload_pxa27x_udc = "pxa27x_udc"

#FIXME: this should be controlled by a userspace utility later.
module_autoload_g_ether = "g_ether"
```

## openembedded/conf/machine/jornada7xx.conf
```bitbake
#@TYPE: Machine
#@NAME: HP Jornada 7xx 
#@DESCRIPTION: Machine configuration for the SA1100 based HP Jornada 7xx palmtop computer

TARGET_ARCH = "arm"

include conf/machine/include/tune-strongarm.conf
```

## openembedded/conf/machine/nokia770.conf
```bitbake
#@TYPE: Machine
#@NAME: Nokia 770 internet tablet
#@DESCRIPTION: Machine configuration for the Nokia 770, an omap 1710 based tablet
TARGET_ARCH = "arm"
IPKG_ARCHS = "all arm armv4 armv5te"

PREFERRED_PROVIDER_virtual/xserver = "xserver-kdrive-omap"
PREFERRED_PROVIDER_virtual/bootloader = ""

XSERVER = "xserver-kdrive-omap"

# 800x480 is big enough for me
GUI_MACHINE_CLASS = "bigscreen"
GPE_EXTRA_INSTALL += "gaim sylpheed gpe-mini-browser tscalib"

# Use tune-arm926 per default. Machine independent feeds should be built with tune-strongarm.
include conf/machine/include/tune-arm926ejs.conf


#size of the root partition (yes, it is 123 MB)
ROOT_FLASH_SIZE = "123"
EXTRA_IMAGECMD_jffs2_nokia770 = "--pad --little-endian --eraseblock=0x20000 --no-cleanmarkers"

# serial console port on devboard rev. B3
#SERIAL_CONSOLE = "115200 tts/0"
SERIAL_CONSOLE = "115200 ttyS0"


#build omap1 till nokia releases the patches
PREFERRED_PROVIDER_virtual/kernel = "linux-omap1"

BOOTSTRAP_EXTRA_RDEPENDS += "sysfsutils  nokia770-init \
pcmcia-cs apm  ppp wireless-tools console-tools"

# NFS Modules
#BOOTSTRAP_EXTRA_RDEPENDS += "kernel-module-nfs kernel-module-lockd kernel-module-sunrpc"
# Crypto Modules
#BOOTSTRAP_EXTRA_RDEPENDS += "kernel-module-des kernel-module-md5"
# SMB and CRAMFS
#BOOTSTRAP_EXTRA_RDEPENDS += "kernel-module-smbfs kernel-module-cramfs"
# Serial Modules
#BOOTSTRAP_EXTRA_RDEPENDS += "kernel-module-8250 "
# Bluetooth Modules
#BOOTSTRAP_EXTRA_RDEPENDS += "kernel-module-bluetooth kernel-module-l2cap kernel-module-rfcomm kernel-module-hci-vhci \
#                             kernel-module-bnep kernel-module-hidp kernel-module-hci-uart kernel-module-sco"
# PPP Modules
#BOOTSTRAP_EXTRA_RDEPENDS += "kernel-module-ppp-generic kernel-module-ppp-async"

#USB Gadget Modules
#BOOTSTRAP_EXTRA_RDEPENDS += "kernel-module-gadgetfs kernel-module-g-file-storage kernel-module-g-serial \
#							 kernel-module-g-ether"

ROOTFS_POSTPROCESS_COMMAND += " remove_init_link; "

include conf/machine/include/handheld-common.conf
```

## openembedded/conf/machine/qemuarm.conf
```bitbake
#@TYPE: Machine
#@NAME: qemu ARM Emulator setup
#@DESCRIPTION: Machine configuration for running an ARM system under qemu emulation

TARGET_ARCH = "arm"
IPKG_EXTRA_ARCHS = "armv4 armv5te"

PCMCIA_MANAGER = "pcmciautils"
PREFERRED_PROVIDER_xserver = "xserver-kdrive"
GUI_MACHINE_CLASS = "bigscreen"
GPE_EXTRA_INSTALL += "gaim sylpheed"

include conf/machine/include/handheld-common.conf
include conf/machine/include/tune-arm926ejs.conf

SERIAL_CONSOLE = "115200 ttyAMA0"

PREFERRED_PROVIDER_virtual/kernel = "linux-openzaurus"

BOOTSTRAP_EXTRA_RDEPENDS += "kernel udev sysfsutils spectrum-fw \
pcmciautils apm  wireless-tools irda-utils udev-utils console-tools hostap-utils prism3-firmware prism3-support \
ppp ppp-dialin openswan wpa-supplicant-nossl alsa-utils-alsactl alsa-utils-alsamixer module-init-tools alsa-conf"

# Ethernet modules
#BOOTSTRAP_EXTRA_RDEPENDS += "kernel-module-pcnet-cs"
# NFS Modules
#BOOTSTRAP_EXTRA_RDEPENDS += "kernel-module-nfs kernel-module-lockd kernel-module-sunrpc"
# Crypto Modules
#BOOTSTRAP_EXTRA_RDEPENDS += "kernel-module-des kernel-module-md5"
# SMB and CRAMFS
#BOOTSTRAP_EXTRA_RDEPENDS += "kernel-module-smbfs kernel-module-cramfs"
# Serial Modules
#BOOTSTRAP_EXTRA_RDEPENDS += "kernel-module-8250 kernel-module-serial-cs"
# Bluetooth Modules
#BOOTSTRAP_EXTRA_RDEPENDS += "kernel-module-bluetooth kernel-module-l2cap kernel-module-rfcomm kernel-module-hci-vhci \
#                             kernel-module-bnep kernel-module-hidp kernel-module-hci-uart kernel-module-sco \
#                             kernel-module-bt3c-cs kernel-module-bluecard-cs kernel-module-btuart-cs kernel-module-dtl1-cs"
# Infrared Modules
#BOOTSTRAP_EXTRA_RDEPENDS += "kernel-module-irda kernel-module-ircomm \
#                             kernel-module-ircomm-tty kernel-module-irlan kernel-module-irnet kernel-module-ir-usb"

IMAGE_FSTYPES = "tar.bz2"

ROOT_FLASH_SIZE = "100"
# actually that should really read ROOTFS_SIZE = "100", because with modern kernels,
# we boot from the built-in harddisk in C3000. ROOT_FLASH_SIZE is really 5 MegaByte
```

## openembedded/conf/machine/spitz.conf
```bitbake
#@TYPE: Machine
#@NAME: Sharp Zaurus SL-C3000
#@DESCRIPTION: Machine configuration for the Sharp Zaurus SL-C3000 device

include conf/machine/include/zaurus-clamshell.conf
include conf/machine/include/zaurus-clamshell-2.6.conf

PIVOTBOOT_EXTRA_RDEPENDS += "pivotinit ${PCMCIA_MANAGER}"
PIVOTBOOT_EXTRA_RRECOMMENDS += ""

# Useful things for the built-in Harddisk
BOOTSTRAP_EXTRA_RDEPENDS += "hdparm e2fsprogs e2fsprogs-e2fsck e2fsprogs-mke2fs"

IMAGE_FSTYPES = "jffs2 tar.gz"

ROOT_FLASH_SIZE = "100"
# actually that should really read ROOTFS_SIZE = "100", because with modern kernels,
# we boot from the built-in harddisk in C3000. ROOT_FLASH_SIZE is really 5 MegaByte
```

## openembedded/conf/machine/tune-arm926ejs.conf
```bitbake
#if gcc breaks change arm926ejs to arm926ej-s
TARGET_CC_ARCH = "-march=armv5te -mtune=arm926ejs"
PACKAGE_ARCH = "armv5te"
```

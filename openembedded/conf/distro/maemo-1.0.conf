## openembedded/conf/distro/maemo-1.0.conf
```bitbake
include conf/distro/familiar.conf

DISTRO = "maemo"
DISTRO_NAME = "Maemo Linux"
DISTRO_VERSION = "v1.0b-${DATE}"

DISTRO_TYPE = "debug"
#DISTRO_TYPE = "release"

FEED_URIS += " \
        base##http://familiar.handhelds.org/releases/${DISTRO_VERSION}/feed/base \
	updates##http://familiar.handhelds.org/releases/${DISTRO_VERSION}/feed/updates"

#CVSDATE = 20050331

PREFERRED_PROVIDERS += "virtual/${TARGET_PREFIX}gcc-initial:gcc-cross-initial"
PREFERRED_PROVIDERS += "virtual/${TARGET_PREFIX}gcc:gcc-cross"
PREFERRED_PROVIDERS += "virtual/${TARGET_PREFIX}g++:gcc-cross"

#PREFERRED_VERSION_binutils-cross = "2.15.91.0.2"
#PREFERRED_VERSION_gcc-cross = "3.4.4"
#PREFERRED_VERSION_gcc-cross-initial = "3.4.4
#PREFERRED_VERSION_libtool-native = "1.5.6"
#PREFERRED_VERSION_libtool-cross= "1.5.6"

#
# GPE
#

PREFERRED_PROVIDERS += "virtual/xserver:xserver-kdrive"
PREFERRED_PROVIDERS += "virtual/gconf:gconf-dbus"
PREFERRED_PROVIDER_x11 = "diet-x11"

include conf/distro/preferred-gpe-versions.inc

#
# Maemo
#

include conf/distro/maemo-preferred.inc
```

## openembedded/conf/distro/maemo-preferred.inc
```bitbake
PREFERRED_PROVIDER_gconf = "gconf-osso"
PREFERRED_PROVIDER_tslib = "tslib-maemo"
PREFERRED_VERSION_dbus = "0.23.1-osso5"
PREFERRED_VERSION_audiofile = "0.2.6-3osso4"
PREFERRED_PROVIDER_esd = "osso-esd"
PREFERRED_VERSION_gtk+ = "2.6.4-1.osso7"
PREFERRED_VERSION_glib-2.0 = "2.6.4"
PREFERRED_VERSION_pango = "1.8.1"
PREFERRED_VERSION_atk = "1.9.0"
PREFERRED_VERSION_diet-x11 ?= "6.2.1"
```

## openembedded/conf/distro/openzaurus-unstable.conf
```bitbake
DISTRO_VERSION = ".dev-snapshot-${DATE}"

include conf/distro/openzaurus.conf

DISTRO_TYPE = "debug"
# DISTRO_TYPE = "release"

#FEED_URIS += " \
#           upgrades##http://openzaurus.org/official/unstable/${DISTRO_VERSION}/upgrades/ \
#upgrades-${MACHINE}##http://openzaurus.org/official/unstable/${DISTRO_VERSION}/upgrades/${MACHINE} \
#            machine##http://openzaurus.org/official/unstable/${DISTRO_VERSION}/feed/machine/${MACHINE} \
#               base##http://openzaurus.org/official/unstable/${DISTRO_VERSION}/feed/base/ \
#               libs##http://openzaurus.org/official/unstable/${DISTRO_VERSION}/feed/libs/ \
#            console##http://openzaurus.org/official/unstable/${DISTRO_VERSION}/feed/console \
#              devel##http://openzaurus.org/official/unstable/${DISTRO_VERSION}/feed/devel"

# SRCDATE = "20050704"

#
# Zaurus
#

ASSUME_PROVIDED += "virtual/arm-linux-gcc-2.95"

KERNEL_CONSOLE = "ttyS0"
#DEBUG_OPTIMIZATION = "-O -g3"
#DEBUG_BUILD = "1"
#INHIBIT_PACKAGE_STRIP = "1"

PREFERRED_VERSION_gcc-cross ?= "3.4.4"
PREFERRED_VERSION_gcc-cross-initial ?= "3.4.4"

PREFERRED_VERSION_hostap-modules ?= "0.3.9"

#fix some iconv issues, needs to be adjusted when doing uclibc builds
PREFERRED_PROVIDER_virtual/libiconv = "glibc"
PREFERRED_PROVIDER_virtual/libintl = "glibc"


#
# Base
#
PREFERRED_VERSION_binutils-cross ?= "2.15.94.0.1"
PREFERRED_PROVIDERS += " virtual/${TARGET_PREFIX}gcc-initial:gcc-cross-initial"
PREFERRED_PROVIDERS += " virtual/${TARGET_PREFIX}gcc:gcc-cross"
PREFERRED_PROVIDERS += " virtual/${TARGET_PREFIX}g++:gcc-cross"

#
# Opie
#
PREFERRED_PROVIDERS += " virtual/libqpe:libqpe-opie"

#OPIE_VERSION = "1.2.1"
#include conf/distro/preferred-opie-versions.inc

#
# GPE
#
PREFERRED_PROVIDERS += "virtual/xserver:xserver-kdrive"
PREFERRED_PROVIDER_x11 = "diet-x11"
include conf/distro/preferred-gpe-versions-2.8.inc

#
# E
#
include conf/distro/preferred-e-versions.inc
```

## openembedded/conf/distro/openzaurus.conf
```bitbake
#@TYPE: Distribution
#@NAME: OpenZaurus
#@DESCRIPTION: Distribution configuration for OpenZaurus (http://www.openzaurus.org)

DISTRO = "openzaurus"
DISTRO_NAME = "OpenZaurus"

INHERIT += " package_ipk debian"
# For some reason, this doesn't work
# TARGET_OS ?= "linux"
TARGET_OS = "linux"
TARGET_FPU = "soft"

BOOTSTRAP_EXTRA_RDEPENDS += "openzaurus-version"

PARALLEL_INSTALL_MODULES = "1"

DISTRO_CHECK := "${@bb.data.getVar("DISTRO_VERSION",d,1) or bb.fatal('Remove this line or set a dummy DISTRO_VERSION if you really want to build an unversioned distro')}"

include conf/distro/include/multimachine.conf
```

## openembedded/conf/distro/poky-additions.inc
```bitbake
# Overide some bits

DISTRO = "openzaurus"
DISTRO_NAME = "OpenedHand PokyLinux" # Bad?
DISTRO_VERSION = "0.0-snapshot-${DATE}"

DISTRO_TYPE = "debug"
# DISTRO_TYPE = "release"

#PREFERRED_PROVIDER_gconf=gconf-dbus

CVSDATE_ipkg-utils-native = "20050930"
CVSDATE_ipkg-link-1 = "20050930"
CVSDATE_ipkg-utils = "20050930"
CVSDATE_ipkg-link = "20050930"
CVSDATE_matchbox-common = "20051101"
CVSDATE_matchbox-config-gtk = "20051101"
CVSDATE_matchbox-desktop = "20051101"
CVSDATE_matchbox-keyboard = "20051101"
CVSDATE_matchbox-panel = "20051101"
CVSDATE_matchbox-panel-manager = "20051101"
CVSDATE_matchbox-stroke = "20051101"
CVSDATE_matchbox-themes-extra = "20051101"
CVSDATE_matchbox-wm = "20051101"
CVSDATE_libmatchbox = "20051101"
CVSDATE_tslib = "20051101"
CVSDATE_xext = "20051101"
CVSDATE_renderext = "20051101"
CVSDATE_libxrender = "20051101"
CVSDATE_fixesext = "20051101"
CVSDATE_damageext = "20051101"
CVSDATE_compositeext = "20051101"
CVSDATE_xcalibrateext = "20051101"
CVSDATE_recordext = "20051101"


#PREFERRED_VERSION_matchbox = "0.9.1"
#PREFERRED_VERSION_matchbox-applet-inputmanager = "0.6"
#PREFERRED_VERSION_matchbox-applet-startup-monitor = "0.1"
#PREFERRED_VERSION_matchbox-common = "0.9.1+cvs-${CVSDATE}"
#PREFERRED_VERSION_matchbox-config-gtk = "0.0+cvs-${CVSDATE}"
#PREFERRED_VERSION_matchbox-desktop = "0.9.1+cvs-${CVSDATE}"
#PREFERRED_VERSION_matchbox-keyboard = "0.0+cvs-${CVSDATE}"
#PREFERRED_VERSION_matchbox-panel = "0.9.2+cvs-${CVSDATE}"
#PREFERRED_VERSION_matchbox-panel-manager = "0.0+cvs-${CVSDATE}"
#PREFERRED_VERSION_matchbox-stroke = "0.0+cvs-${CVSDATE}"
#PREFERRED_VERSION_matchbox-themes-extra = "0.3+cvs-${CVSDATE}"
#PREFERRED_VERSION_matchbox-wm = "0.9.5+cvs-${CVSDATE}"
#PREFERRED_VERSION_libmatchbox = "1.7+cvs-${CVSDATE}"


PREFERRED_VERSION_atk = "1.10.0"
PREFERRED_VERSION_cairo = "1.0.0"
PREFERRED_VERSION_glib-2.0 = "2.8.1"
PREFERRED_VERSION_gtk+ = "2.6.7"
PREFERRED_VERSION_pango = "1.10.0"

PREFERRED_VERSION_dbus = "0.50"
```

## openembedded/conf/distro/poky-oabi.conf
```bitbake
#
# Poky configuration to use its Original ABI
#
PREFERRED_VERSION_binutils ?= "2.16"
PREFERRED_VERSION_binutils-cross ?= "2.15.94.0.1"
PREFERRED_VERSION_gcc ?= "3.4.4"
PREFERRED_VERSION_gcc-cross ?= "3.4.4"
PREFERRED_VERSION_gcc-cross-initial ?= "3.4.4"
PREFERRED_VERSION_linux-libc-headers ?= "2.6.11.1"
PREFERRED_VERSION_glibc ?= "2.3.5+cvs20050627"
PREFERRED_VERSION_glibc-intermediate ?= "2.3.5+cvs20050627"
```

## openembedded/conf/distro/poky.conf
```bitbake
#@TYPE: Distribution#@NAME: Poky
#@DESCRIPTION: Distribution configuration for OpenedHand (Poky)

DISTRO = "poky"
DISTRO_NAME = "OpenedHand Linux (Poky)"
DISTRO_VERSION = "0.0-snapshot-${DATE}"

# DISTRO_VERSION = "3.5.4"
DISTRO_TYPE = "debug"
# DISTRO_TYPE = "release"


INHERIT += " package_ipk debian multimachine poky "
# For some reason, this doesn't work
# TARGET_OS ?= "linux"
TARGET_OS = "linux"
TARGET_FPU ?= "soft"
IMAGE_ROOTFS_SIZE_ext2 = 131072

PARALLEL_INSTALL_MODULES = "1"

#FEED_URIS += " \
#           upgrades##http://openzaurus.org/official/unstable/${DISTRO_VERSION}/upgrades/ \
#upgrades-${MACHINE}##http://openzaurus.org/official/unstable/${DISTRO_VERSION}/upgrades/${MACHINE} \
#            machine##http://openzaurus.org/official/unstable/${DISTRO_VERSION}/feed/machine/${MACHINE} \
#               base##http://openzaurus.org/official/unstable/${DISTRO_VERSION}/feed/base/ \
#               libs##http://openzaurus.org/official/unstable/${DISTRO_VERSION}/feed/libs/ \
#            console##http://openzaurus.org/official/unstable/${DISTRO_VERSION}/feed/console \
#              devel##http://openzaurus.org/official/unstable/${DISTRO_VERSION}/feed/devel"

ASSUME_PROVIDED += "virtual/arm-linux-gcc-2.95"
OEINCLUDELOGS = "yes"
KERNEL_CONSOLE = "ttyS0"
#DEBUG_OPTIMIZATION = "-O -g3"
#DEBUG_BUILD = "1"
#INHIBIT_PACKAGE_STRIP = "1"

POKYMODE ?= "oabi"

include conf/distro/poky-${POKYMODE}.conf

#
# Preferred providers:
#
# Toolchain:
PREFERRED_PROVIDERS += " virtual/${TARGET_PREFIX}gcc-initial:gcc-cross-initial"
PREFERRED_PROVIDERS += " virtual/${TARGET_PREFIX}gcc:gcc-cross"
PREFERRED_PROVIDERS += " virtual/${TARGET_PREFIX}g++:gcc-cross"

# Libc/uclibc:
#fix some iconv issues, needs to be adjusted when doing uclibc builds
PREFERRED_PROVIDER_virtual/libiconv ?= glibc
PREFERRED_PROVIDER_virtual/libintl ?= glibc

# Virtuals:
PREFERRED_PROVIDER_virtual/db ?= "db"
PREFERRED_PROVIDER_virtual/db-native ?= "db-native"
PREFERRED_PROVIDER_virtual/xserver ?= xserver-kdrive

# Others:
PREFERRED_PROVIDER_libx11 ?= "diet-x11"
PREFERRED_PROVIDER_gconf ?= gconf-dbus
PREFERRED_PROVIDER_gnome-vfs ?= gnome-vfs-dbus
PREFERRED_PROVIDER_tslib ?= tslib


#
# CVS Dates to use:
#
#SRCDATE_gnome-vfs-dbus ?= "20051215"
SRCDATE_gconf-dbus ?= "20060119"
SRCDATE_gnome-vfs-dbus ?= "20060119"
SRCDATE_contacts ?= "20060207"
SRCDATE_dates ?= "20060502"
SRCDATE_gtkhtml2 ?= "20060323"
SRCDATE_web ?= "20060613"
SRCDATE_eds-dbus ?= "20060126"
SRCDATE_minimo ?= "20050401"
SRCDATE_ipkg-utils-native ?= "20050930"
SRCDATE_ipkg-link-1 ?= "20050930"
SRCDATE_ipkg-utils ?= "20050930"
SRCDATE_ipkg-link ?= "20050930"
SRCDATE_matchbox-common ?= "20060612"
SRCDATE_matchbox-config-gtk ?= "20060612"
SRCDATE_matchbox-desktop ?= "20060612"
SRCDATE_matchbox-keyboard ?= "20060612"
SRCDATE_matchbox-panel ?= "20060612"
SRCDATE_matchbox-panel-manager ?= "20060612"
SRCDATE_matchbox-stroke ?= "20060612"
SRCDATE_matchbox-themes-extra ?= "20060612"
SRCDATE_matchbox-wm ?= "20060612"
SRCDATE_libmatchbox ?= "20060612"
SRCDATE_tslib ?= "20051101"
SRCDATE_libxext ?= "20051101"
SRCDATE_renderext ?= "20051101"
SRCDATE_libxrender ?= "20051101"
SRCDATE_fixesext ?= "20051101"
SRCDATE_damageext ?= "20051101"
SRCDATE_compositeext ?= "20051101"
SRCDATE_xcalibrateext ?= "20051101"
SRCDATE_recordext ?= "20051101"
SRCDATE_libfakekey ?= "20051101"
SRCDATE_xmodmap ?= "20051101"
SRCDATE_libxrandr ?= "20051101"
SRCDATE_libxtst ?= "20051101"
SRCDATE_xcalibrate ?= "20051101"
SRCDATE_libxmu ?= "20051115"
SRCDATE_xdpyinfo ?= "20051115"
SRCDATE_xauth ?= "20060120"
SRCDATE_xserver-kdrive = "20050207"
SRCDATE_qemu-native ?= "20060526"
SRCDATE_oprofile ?= "20060214"
SRCDATE_zaurusd ?= "20060628"

#
# Preferred Versions:
#
PREFERRED_VERSION_matchbox ?= "0.9.1"
PREFERRED_VERSION_matchbox-applet-inputmanager ?= "0.6"
PREFERRED_VERSION_matchbox-applet-startup-monitor ?= "0.1"
PREFERRED_VERSION_matchbox-common ?= "0.9.1+svn${SRCDATE}"
PREFERRED_VERSION_matchbox-config-gtk ?= "0.0+svn${SRCDATE}"
PREFERRED_VERSION_matchbox-desktop ?= "0.9.1+svn${SRCDATE}"
PREFERRED_VERSION_matchbox-keyboard ?= "0.0+svn${SRCDATE}"
PREFERRED_VERSION_matchbox-panel ?= "0.9.2+svn${SRCDATE}"
PREFERRED_VERSION_matchbox-stroke ?= "0.0+svn${SRCDATE}"
PREFERRED_VERSION_matchbox-themes-extra ?= "0.3+svn${SRCDATE}"
PREFERRED_VERSION_matchbox-wm ?= "0.9.5+svn${SRCDATE}"
PREFERRED_VERSION_libmatchbox ?= "1.7+svn${SRCDATE}"
PREFERRED_VERSION_xserver-kdrive = "0.0+cvs${SRCDATE}"

PREFERRED_VERSION_glib-2.0 ?= "2.8.6"
PREFERRED_VERSION_atk ?= "1.10.1"
PREFERRED_VERSION_gtk+ ?= "2.6.7"
#PREFERRED_VERSION_gtk+ ?= "2.8.16"
#PREFERRED_VERSION_cairo ?= "1.0.0"
PREFERRED_VERSION_pango ?= "1.10.0"

PREFERRED_VERSION_dbus ?= "0.60"
PREFERRED_VERSION_gnome-vfs-dbus ?= "2.12.0+cvs${SRCDATE}"

PREFERRED_VERSION_diet-x11 ?= "6.2.1"
PREFERRED_VERSION_dillo2 ?= "0.6.6"
PREFERRED_VERSION_evince ?= "0.3.2"
PREFERRED_VERSION_firefox ?= "1.0"
PREFERRED_VERSION_gaim ?= "2.0.0-cvs-mco1-20050904"
PREFERRED_VERSION_gtk2-theme-angelistic ?= "0.3"
PREFERRED_VERSION_gsoko ?= "0.4.2-gpe6"
PREFERRED_VERSION_keylaunch ?= "2.0.7"
PREFERRED_VERSION_librsvg ?= "2.6.5"
PREFERRED_VERSION_libgsm ?= "1.0.10"
PREFERRED_VERSION_libschedule ?= "0.15"
PREFERRED_VERSION_linphone-hh ?= "0.12.2.hh1"
PREFERRED_VERSION_linphone ?= "0.12.2"
PREFERRED_VERSION_minilite ?= "0.49"
PREFERRED_VERSION_minimo ?= "0.0+cvs${SRCDATE_minimo}"
PREFERRED_VERSION_poppler ?= "0.3.3"
PREFERRED_VERSION_rosetta ?= "0.0+cvs${SRCDATE}"
PREFERRED_VERSION_rxvt-unicode ?= "5.6"
PREFERRED_VERSION_xcursor-transparent-theme ?= "0.1.1"
PREFERRED_VERSION_xdemineur ?= "2.1.1"
PREFERRED_VERSION_xextensions ?= "1.0.1"
PREFERRED_VERSION_xhost ?= "0.0+cvs20040413"
PREFERRED_VERSION_xmonobut ?= "0.4"
PREFERRED_VERSION_xprop ?= "0.0+cvs${SRCDATE}" 
PREFERRED_VERSION_xproto ?= "6.6.2"
PREFERRED_VERSION_xrdb ?= "0.0+cvs${SRCDATE}"
PREFERRED_VERSION_xst ?= "0.15"
PREFERRED_VERSION_oprofile ?= "0.9.1+cvs${SRCDATE}"

PCMCIA_MANAGER ?= "pcmciautils"

CVS_TARBALL_STASH += "http://www.o-hand.com/~richard/poky/sources/"

IMAGE_LINGUAS = "en-gb"
```

## openembedded/conf/distro/preferred-e-versions.inc
```bitbake
#
# Specify which versions of E-related libraries and applications to build
#

PREFERRED_VERSION_e = "0.16.999.023"
PREFERRED_VERSION_ecore-x11 = "0.9.9.023"
PREFERRED_VERSION_ecore-native = "0.9.9.023"
PREFERRED_VERSION_edb = "1.0.5.005"
PREFERRED_VERSION_edb-native = "1.0.5.005"
PREFERRED_VERSION_edje = "0.5.0.023"
PREFERRED_VERSION_edje-native = "0.5.0.023"
PREFERRED_VERSION_eet = "0.9.10.023"
PREFERRED_VERSION_eet-native = "0.9.10.023"
PREFERRED_VERSION_embryo = "0.9.1.023"
PREFERRED_VERSION_embryo-native = "0.9.1.023"
PREFERRED_VERSION_emotion = "0.0.1.004"
PREFERRED_VERSION_emotion-native = "0.0.1.004"
PREFERRED_VERSION_epeg = "0.9.0.005"
PREFERRED_VERSION_epsilon = "0.3.0.005"
PREFERRED_VERSION_esmart-x11 = "0.9.0.005"
PREFERRED_VERSION_evas-x11 = "0.9.9.023"
PREFERRED_VERSION_evas-native = "0.9.9.023"
PREFERRED_VERSION_ewl = "0.0.4.005"
PREFERRED_VERSION_imlib2-x11 = "1.2.1.010"
PREFERRED_VERSION_imlib2-native = "1.2.1.010"
PREFERRED_VERSION_e-wm = "0.16.999.023"
PREFERRED_VERSION_entrance = "0.9.0.005"

PREFERRED_PROVIDER_virtual/evas = "evas-x11"
PREFERRED_PROVIDER_virtual/ecore = "ecore-x11"
PREFERRED_PROVIDER_virtual/imlib2 = "imlib2-x11"

PREFERRED_VERSION_gnome-vfs-dbus = "svn"

PREFERRED_VERSION_gcc = "3.4.4"
```

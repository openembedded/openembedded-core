## openembedded/conf/distro/preferred-gpe-versions-2.6.inc
```bitbake
#
# Specify which versions of GPE (and related) applications to build
#

#work around some breakages
CVSDATE_xserver-kdrive=20050207
CVSDATE_minimo=20050401
CVSDATE_cairo=20050330
CVSDATE_xext=20050222

#set some preferred providers:
PREFERRED_PROVIDER_gconf=gconf-dbus

#specify versions, as the header says :)
PREFERRED_VERSION_libmatchbox ?= "1.6"
PREFERRED_VERSION_matchbox ?= "0.9.1"
PREFERRED_VERSION_matchbox-common ?= "0.9.1"
PREFERRED_VERSION_matchbox-desktop ?= "0.9.1"
PREFERRED_VERSION_matchbox-wm ?= "0.9.3"
PREFERRED_VERSION_matchbox-panel ?= "0.9.1"
PREFERRED_VERSION_matchbox-applet-inputmanager ?= "0.6"
PREFERRED_VERSION_gtk+ ?= "2.6.3"
PREFERRED_VERSION_libgpewidget ?= "0.97"
PREFERRED_VERSION_libgpepimc ?= "0.4"
PREFERRED_VERSION_libgpevtype ?= "0.11"
PREFERRED_VERSION_libschedule ?= "0.14"
PREFERRED_VERSION_gpe-icons ?= "0.24"
PREFERRED_VERSION_libgsm ?= "1.0.10"
PREFERRED_VERSION_diet-x11 ?= "6.2.1"
PREFERRED_VERSION_xproto ?= "6.6.2"
PREFERRED_VERSION_xcursor-transparent-theme ?= "0.1.1"
PREFERRED_VERSION_rxvt-unicode ?= "5.3"
PREFERRED_VERSION_gtk2-theme-angelistic ?= "0.3"
PREFERRED_VERSION_xst ?= "0.14"
#PREFERRED_VERSION_xextensions ?= "0.0cvs${CVSDATE}"
PREFERRED_VERSION_xprop ?= "0.0cvs${CVSDATE}" 
PREFERRED_VERSION_xhost ?= "0.0cvs20040413"
PREFERRED_VERSION_xrdb ?= "0.0cvs${CVSDATE}"
PREFERRED_VERSION_gpe-login ?= "0.76"
PREFERRED_VERSION_gpe-session-scripts ?= "0.62"
PREFERRED_VERSION_gpe-soundserver ?= "0.4-1"
PREFERRED_VERSION_gpe-todo ?= "0.50"
PREFERRED_VERSION_gpe-calendar ?= "0.61"
PREFERRED_VERSION_gpe-sketchbox ?= "0.2.8"
PREFERRED_VERSION_gpe-contacts ?= "0.36"
PREFERRED_VERSION_gpe-today ?= "0.08"
PREFERRED_VERSION_matchbox-panel-manager ?= "0.1"
PREFERRED_VERSION_dbus ?= "0.23"
PREFERRED_VERSION_gpe-bluetooth ?= "0.38"
PREFERRED_VERSION_gpe-su ?= "0.18"
PREFERRED_VERSION_gpe-conf ?= "0.1.23"
PREFERRED_VERSION_gpe-clock ?= "0.20"
PREFERRED_VERSION_gpe-mininet ?= "0.5"
PREFERRED_VERSION_gpe-mixer ?= "0.40"
PREFERRED_VERSION_gpe-shield ?= "0.7"
PREFERRED_VERSION_gpe-wlancfg ?= "0.2.6"
PREFERRED_VERSION_gpe-taskmanager ?= "0.17"
PREFERRED_VERSION_keylaunch ?= "2.0.7"
PREFERRED_VERSION_minilite ?= "0.47"
PREFERRED_VERSION_xmonobut ?= "0.4"
PREFERRED_VERSION_gpe-edit ?= "0.28"
PREFERRED_VERSION_gpe-gallery ?= "0.95"
PREFERRED_VERSION_gpe-calculator ?= "0.2"
PREFERRED_VERSION_gpe-package ?= "0.2"
PREFERRED_VERSION_gpe-soundbite ?= "1.0.5"
PREFERRED_VERSION_gpe-terminal ?= "1.1"
PREFERRED_VERSION_gpe-watch ?= "0.10"
PREFERRED_VERSION_gpe-what ?= "0.33"
PREFERRED_VERSION_gpe-filemanager ?= "0.20"
PREFERRED_VERSION_gpe-go ?= "0.05"
PREFERRED_VERSION_gpe-irc ?= "0.07"
PREFERRED_VERSION_gpe-lights ?= "0.13"
#PREFERRED_VERSION_gpe-nmf ?= "0.19"
PREFERRED_VERSION_gpe-othello ?= "0.2-1"
PREFERRED_VERSION_gpe-plucker ?= "0.2"
PREFERRED_VERSION_gpe-tetris ?= "0.6-2"
PREFERRED_VERSION_gsoko ?= "0.4.2-gpe6"
PREFERRED_VERSION_xdemineur ?= "2.1.1"
PREFERRED_VERSION_matchbox-panel-hacks ?= "0.3-1"
PREFERRED_VERSION_rosetta ?= "0.0cvs${CVSDATE}"
PREFERRED_VERSION_dillo2 ?= "0.6.6"
PREFERRED_VERSION_minimo ?= "0.0cvs${CVSDATE_minimo}"
PREFERRED_VERSION_linphone-hh ?= "0.12.2.hh1"
PREFERRED_VERSION_linphone ?= "0.12.2"
PREFERRED_VERSION_firefox ?= "1.0"
```

## openembedded/conf/distro/preferred-gpe-versions-2.7.inc
```bitbake
#
# Specify which versions of GPE (and related) applications to build
#

#work around some breakages
#CVSDATE_minimo=20050401

#set some preferred providers:
PREFERRED_PROVIDER_gconf=gconf-dbus
PREFERRED_PROVIDER_gnome-vfs=gnome-vfs-dbus

#specify versions, as the header says :)
PREFERRED_VERSION_libmatchbox ?= "1.7"
PREFERRED_VERSION_matchbox ?= "0.9.1"
PREFERRED_VERSION_matchbox-common ?= "0.9.1"
PREFERRED_VERSION_matchbox-desktop ?= "0.9.1"
PREFERRED_VERSION_matchbox-wm ?= "0.9.5+cvs-${CVSDATE}"
PREFERRED_VERSION_matchbox-panel ?= "0.9.2"
PREFERRED_VERSION_matchbox-applet-inputmanager ?= "0.6"
PREFERRED_VERSION_atk ?= "1.9.0"
PREFERRED_VERSION_cairo ?= "0.5.2"
PREFERRED_VERSION_glib-2.0 ?= "2.6.4"
PREFERRED_VERSION_gtk+ ?= "2.6.7"
PREFERRED_VERSION_pango ?= "1.8.1"
PREFERRED_VERSION_librsvg ?= "2.6.5"
PREFERRED_VERSION_libgpewidget ?= "0.103"
PREFERRED_VERSION_libgpepimc ?= "0.5"
PREFERRED_VERSION_libgpevtype ?= "0.12"
PREFERRED_VERSION_libschedule ?= "0.15"
PREFERRED_VERSION_gpe-icons ?= "0.24"
PREFERRED_VERSION_libgsm ?= "1.0.10"
PREFERRED_VERSION_diet-x11 ?= "6.2.1"
PREFERRED_VERSION_xproto ?= "6.6.2"
PREFERRED_VERSION_xcursor-transparent-theme ?= "0.1.1"
PREFERRED_VERSION_rxvt-unicode ?= "5.3"
PREFERRED_VERSION_gtk2-theme-angelistic ?= "0.3"
PREFERRED_VERSION_xst ?= "0.15"
#PREFERRED_VERSION_xextensions ?= "0.0cvs${CVSDATE}"
PREFERRED_VERSION_xprop ?= "0.0cvs${CVSDATE}" 
PREFERRED_VERSION_xhost ?= "0.0cvs20040413"
PREFERRED_VERSION_xrdb ?= "0.0cvs${CVSDATE}"
PREFERRED_VERSION_gpe-login ?= "0.82"
PREFERRED_VERSION_gpe-session-scripts ?= "0.66"
PREFERRED_VERSION_gpe-soundserver ?= "0.4-1"
PREFERRED_VERSION_gpe-todo ?= "0.54"
PREFERRED_VERSION_gpe-calendar ?= "0.65"
PREFERRED_VERSION_gpe-sketchbox ?= "0.2.8"
PREFERRED_VERSION_gpe-contacts ?= "0.42"
PREFERRED_VERSION_gpe-today ?= "0.09"
PREFERRED_VERSION_matchbox-panel-manager ?= "0.1"
PREFERRED_VERSION_dbus ?= "0.23.4"
PREFERRED_VERSION_gpe-beam ?= "0.2.8" 
PREFERRED_VERSION_gpe-bluetooth ?= "0.45"
PREFERRED_VERSION_gpe-su ?= "0.18"
PREFERRED_VERSION_gpe-conf ?= "0.1.25"
PREFERRED_VERSION_gpe-clock ?= "0.21"
PREFERRED_VERSION_gpe-mininet ?= "0.5"
PREFERRED_VERSION_gpe-mixer ?= "0.42"
PREFERRED_VERSION_gpe-shield ?= "0.7"
PREFERRED_VERSION_gpe-wlancfg ?= "0.2.6"
PREFERRED_VERSION_gpe-taskmanager ?= "0.18"
PREFERRED_VERSION_keylaunch ?= "2.0.7"
PREFERRED_VERSION_minilite ?= "0.49"
PREFERRED_VERSION_xmonobut ?= "0.4"
PREFERRED_VERSION_gpe-edit ?= "0.29"
PREFERRED_VERSION_gpe-gallery ?= "0.96"
PREFERRED_VERSION_gpe-calculator ?= "0.2"
PREFERRED_VERSION_gpe-package ?= "0.3"
PREFERRED_VERSION_gpe-soundbite ?= "1.0.6"
PREFERRED_VERSION_gpe-terminal ?= "1.1"
PREFERRED_VERSION_gpe-watch ?= "0.10"
PREFERRED_VERSION_gpe-what ?= "0.33"
PREFERRED_VERSION_gpe-filemanager ?= "0.23"
PREFERRED_VERSION_gpe-go ?= "0.05"
PREFERRED_VERSION_gpe-irc ?= "0.07"
PREFERRED_VERSION_gpe-lights ?= "0.13"
#PREFERRED_VERSION_gpe-nmf ?= "0.21"
PREFERRED_VERSION_gpe-othello ?= "0.2-1"
PREFERRED_VERSION_gpe-plucker ?= "0.2"
PREFERRED_VERSION_gpe-tetris ?= "0.6-4"
PREFERRED_VERSION_gsoko ?= "0.4.2-gpe6"
PREFERRED_VERSION_xdemineur ?= "2.1.1"
PREFERRED_VERSION_matchbox-panel-hacks ?= "0.3-1"
PREFERRED_VERSION_rosetta ?= "0.0cvs${CVSDATE}"
PREFERRED_VERSION_dillo2 ?= "0.6.6"
PREFERRED_VERSION_minimo ?= "0.0cvs${CVSDATE_minimo}"
PREFERRED_VERSION_linphone-hh ?= "0.12.2.hh1"
PREFERRED_VERSION_linphone ?= "0.12.2"
PREFERRED_VERSION_firefox ?= "1.0"
PREFERRED_VERSION_gaim ?= "2.0.0-cvs-mco1-20050904"
PREFERRED_VERSION_poppler ?= "0.3.3"
PREFERRED_VERSION_evince ?= "0.3.2"
PREFERRED_VERSION_gpe_mini_browser ?= "0.15"
```

## openembedded/conf/local.conf.sample
```bitbake
#
# OpenEmbedded local configuration file (sample)
#
# Please visit the Wiki at http://openembedded.org/ for more info.
#
#
# Be SURE to read this file in its entirety and the GettingStarted page on the
# wiki before proceeding.
#
# Once you have done that, remove the line at the end of this
# file and build away.
# 
# WARNING: lines starting with a space (' ') will result in parse failures.
# Remove '# ' from commented lines to activate them.
#
# NOTE: Do NOT use $HOME in your paths, BitBake does NOT expand ~ for you.  If you
# must have paths relative to your homedir use ${HOME} (note the {}'s there
# you MUST have them for the variable expansion to be done by BitBake).  Your
# paths should all be absolute paths (They should all start with a / after
# expansion.  Stuff like starting with ${HOME} or ${TOPDIR} is ok).

# Use this to specify where BitBake should place the downloaded sources into
DL_DIR = "${HOME}/sources"

# Delete the line below. Then specify which .bb files to consider for
# your build. Typically this will be something like BBFILES = "/path/to/openembedded/packages/*/*.bb"
BBFILES := "${@bb.fatal('Edit your conf/local.conf: BBFILES')}"

# Use the BBMASK below to instruct BitBake to _NOT_ consider some .bb files
# This is a regulary expression, so be sure to get your parenthesis balanced.
BBMASK = ""

# Uncomment this if you want to use a prebuilt toolchain. You will need to
# provide packages for toolchain and additional libraries yourself. You also
# have to set PATH in your environment to make sure BitBake finds additional binaries.
# Note: You will definitely need to say:
#     ASSUME_PROVIDED = "virtual/arm-linux-gcc-2.95"
# to build any of two Linux 2.4 Embedix kernels,
# i.e. openzaurus-sa-2.4.18 and openzaurus-pxa-2.4.18 - and don't forget
# to rename the binaries as instructed in the Wiki.
# ASSUME_PROVIDED = "virtual/${TARGET_PREFIX}gcc virtual/libc"

# Select between multiple alternative providers, if more than one is eligible.
PREFERRED_PROVIDERS = "virtual/qte:qte virtual/libqpe:libqpe-opie"
PREFERRED_PROVIDERS += " virtual/libsdl:libsdl-qpe"
PREFERRED_PROVIDERS += " virtual/${TARGET_PREFIX}gcc-initial:gcc-cross-initial"
PREFERRED_PROVIDERS += " virtual/${TARGET_PREFIX}gcc:gcc-cross"
PREFERRED_PROVIDERS += " virtual/${TARGET_PREFIX}g++:gcc-cross"

# Uncomment this to specify where BitBake should create its temporary files.
# Note that a full build of everything in OpenEmbedded will take GigaBytes of hard
# disk space, so make sure to free enough space. The default TMPDIR is
# <build directory>/tmp
# Don't use symlinks in in the path to avoid problems
# TMPDIR = /usr/local/projects/oetmp

# Uncomment this to specify a machine to build for. See the conf directory
# for machines currently known to OpenEmbedded.
# MACHINE = "collie"

# Use this to specify the target architecture. Note that this is only
# needed when building for a machine not known to OpenEmbedded. Better use
# the MACHINE attribute (see above)
# TARGET_ARCH = "arm"

# Use this to specify the target operating system.  The default is "linux",
# for a normal linux system with glibc. Set this to "linux-uclibc" if you want
# to build a uclibc based system.
# TARGET_OS = "linux"
# TARGET_OS = "linux-uclibc"

# Uncomment this to select a distribution policy. See the conf directory
# for distributions currently known to OpenEmbedded.
# DISTRO = "familiar"

# Uncomment this to select a particular kernel version if supported by 
# your MACHINE setting. Currently only supported on Zaurus Clamshells.
# KERNEL_VERSION = "2.6"

# Uncomment one of these to build packages during the build process.
# This is done automatically if you set DISTRO (see above)
# INHERIT = "package_ipk"
# INHERIT = "package_tar"

# Add the required image file system types below. Valid are jffs2, tar, cramfs
IMAGE_FSTYPES = "jffs2 tar"

# Uncomment this to disable the parse cache (not recommended).
# CACHE = ""

# Uncomment this if you want BitBake to emit debugging output
# BBDEBUG = "yes"

# Uncomment these two if you want BitBake to build images useful for debugging.
# DEBUG_BUILD = "1"
# INHIBIT_PACKAGE_STRIP = "1"

# Uncomment these to build a package such that you can use gprof to profile it.
# NOTE: This will only work with 'linux' targets, not
# 'linux-uclibc', as uClibc doesn't provide the necessary
# object files.  Also, don't build glibc itself with these
# flags, or it'll fail to build.
#
# PROFILE_OPTIMIZATION = "-pg"
# SELECTED_OPTIMIZATION = "${PROFILE_OPTIMIZATION}"
# LDFLAGS =+ "-pg"

# Uncomment this to enable parallel make.
# This allows make to spawn mutliple processes to take advantage of multiple 
# processors. Useful on SMP machines. This may break some packages - we're
# in the process of marking these so let us know if you find any.
# PARALLEL_MAKE = "-j 4"

# Uncomment this if you want BitBake to emit the log if a build fails.
BBINCLUDELOGS = "yes"

# Specifies a location to search for pre-generated tarballs when fetching
# a cvs:// URI. Outcomment this, if you always want to pull directly from CVS.
CVS_TARBALL_STASH = "http://www.oesources.org/source/current/"

# EDIT THIS FILE and then remove the line below before using!
REMOVE_THIS_LINE:="${@oe.fatal('Read the comments in your conf/local.conf')}"
```

## openembedded/conf/machine/akita.conf
```bitbake
#@TYPE: Machine
#@NAME: Sharp Zaurus SL-C1000
#@DESCRIPTION: Machine configuration for the Sharp Zaurus SL-C1000 device

include conf/machine/include/zaurus-clamshell.conf
include conf/machine/include/zaurus-clamshell-2.6.conf

ROOT_FLASH_SIZE = "58"
```

## openembedded/conf/machine/c7x0.conf
```bitbake
#@TYPE: Machine
#@NAME: Sharp Zaurus SL-C7x0
#@DESCRIPTION: Machine configuration for the Sharp Zaurus SL-C700, Sharp Zaurus SL-C750, Sharp Zaurus SL-C760, Sharp Zaurus SL-C860 devices

include conf/machine/include/zaurus-clamshell.conf
include conf/machine/include/zaurus-clamshell-2.6.conf

ROOT_FLASH_SIZE = "25"
# yes, we are aware that the husky (c760,c860) has 54MB rootfs, but we don't make a special image for it.
```

## openembedded/conf/machine/cmx270.conf
```bitbake
#@TYPE: Machine
#@NAME: Nokia 770 internet tablet
#@DESCRIPTION: Machine configuration for the Nokia 770, an omap 1710 based tablet
TARGET_ARCH = "arm"
IPKG_EXTRA_ARCHS = "armv4 armv5te"

EXTRA_IMAGECMD_jffs2 = "--pad --little-endian --eraseblock=0x4000 -n"

IMAGE_CMD_jffs2 = "mkdir -p ${DEPLOY_DIR_IMAGE}; \
                  mkfs.jffs2 --root=${IMAGE_ROOTFS} --faketime \
                   --output=${DEPLOY_DIR_IMAGE}/${IMAGE_NAME}.rootfs.img ${EXTRA_IMAGECMD}; "

PREFERRED_PROVIDER_virtual/bootloader = ""

# 800x480 is big enough for me
GUI_MACHINE_CLASS = "bigscreen"

# Use tune-arm926 per default. Machine independent feeds should be built with tune-strongarm.
include conf/machine/include/tune-xscale.conf

#size of the root partition (yes, it is 123 MB)
ROOT_FLASH_SIZE = "128"

# serial console port on devboard rev. B3
SERIAL_CONSOLE = "115200 ttyS0"

PREFERRED_PROVIDER_virtual/kernel = "linux-cmx270"


include conf/machine/include/handheld-common.conf
```

## openembedded/conf/machine/handheld-common.conf
```bitbake
HANDHELD_MODULES = "ipv6 \
ipsec \
nvrd \
mip6-mn \
tun \
ide-cs ide-disk ide-probe-mod \
loop \
vfat ext2 \
sunrpc nfs \
btuart-cs dtl1-cs bt3c-cs rfcomm bnep l2cap sco hci_uart \
pcnet-cs serial-cs airo-cs \
af_packet \
ppp-async ppp-deflate ppp-mppe \
ip-gre ip-tables ipip \
irda irlan irnet irport irtty ircomm-tty \
input uinput \
"

# Configuration bits for "generic handheld"
BOOTSTRAP_EXTRA_DEPENDS += "pcmcia-cs apmd ppp wireless-tools irda-utils openswan wpa-supplicant-nossl lrzsz ppp-dialin scap network-suspend-scripts"
BOOTSTRAP_EXTRA_RDEPENDS +=  "pcmcia-cs apm apmd network-suspend-scripts"
BOOTSTRAP_EXTRA_RRECOMMENDS += "ppp wireless-tools irda-utils openswan wpa-supplicant-nossl lrzsz ppp-dialin scap ${@linux_module_packages('${HANDHELD_MODULES}', d)}"

INHERIT += "linux_modules"
```
